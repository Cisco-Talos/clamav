//===- TableGen'erated file -------------------------------------*- C++ -*-===//
//
// Assembly Writer Source Fragment
//
// Automatically generated file, do not edit!
//
//===----------------------------------------------------------------------===//

/// printInstruction - This method is automatically generated by tablegen
/// from the instruction set description.
void PPCAsmPrinter::printInstruction(const MachineInstr *MI) {
  static const unsigned OpInfo[] = {
    0U,	// PHI
    0U,	// INLINEASM
    0U,	// DBG_LABEL
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    268450523U,	// XORIS8
    0U
  };

  const char *AsmStrs = 
    "DBG_VALUE\000add \000addc \000adde \000addi \000addic \000addic. \000ad"
    "dis \000addme \000addze \000\000and \000andc \000andis. \000andi. \000b"
    " \000b\000bctr\000bctrl\000bl \000bla \000cmpd \000cmpdi \000cmpld \000"
    "cmpldi \000cmplw \000cmplwi \000cmpw \000cmpwi \000cntlzd \000cntlzw \000"
    "creqv \000cror \000dcba \000dcbf \000dcbi \000dcbst \000dcbt \000dcbtst"
    " \000dcbz \000dcbzl \000divd \000divdu \000divw \000divwu \000dss \000d"
    "ssall\000dst \000dstst \000dststt \000dstt \000eqv \000extsb \000extsh "
    "\000extsw \000fabs \000fadd \000fadds \000fcfid \000fcmpu \000fctidz \000"
    "fctiwz \000fdiv \000fdivs \000fmadd \000fmadds \000fmr \000fmsub \000fm"
    "subs \000fmul \000fmuls \000fnabs \000fneg \000fnmadd \000fnmadds \000f"
    "nmsub \000fnmsubs \000frsp \000fsel \000fsqrt \000fsqrts \000fsub \000f"
    "subs \000la \000lbz \000lbzu \000lbzx \000ld \000ldarx \000ldu \000ldx "
    "\000ld 2, 8(\000ld 2, 40(1)\000lfd \000lfdx \000lfs \000lfsx \000lha \000"
    "lhau \000lhax \000lhbrx \000lhz \000lhzu \000lhzx \000li \000lis \000lv"
    "ebx \000lvehx \000lvewx \000lvsl \000lvsr \000lvx \000lvxl \000lwa \000"
    "lwarx \000lwax \000lwbrx \000lwz \000lwzu \000lwzx \000mcrf \000mfcr \000"
    "mfctr \000mffs \000mflr \000mfspr \000mfvscr \000mtcrf \000mtctr \000mt"
    "fsb0 \000mtfsb1 \000mtfsf \000mtlr \000mtspr 256, \000mtvscr \000mulhd "
    "\000mulhdu \000mulhw \000mulhwu \000mulld \000mulli \000mullw \000nand "
    "\000neg \000nop\000nor \000or \000orc \000ori \000oris \000rldcl \000rl"
    "dicl \000rldicr \000rldimi \000rlwimi \000rlwinm \000rlwinm. \000rlwnm "
    "\000sld \000slw \000srad \000sradi \000sraw \000srawi \000srd \000srw \000"
    "stb \000stbu \000stbx \000std \000stdcx. \000stdu \000stdux \000stdx \000"
    "stfd \000stfdu \000stfdx \000stfiwx \000stfs \000stfsu \000stfsx \000st"
    "h \000sthbrx \000sthu \000sthx \000stvebx \000stvehx \000stvewx \000stv"
    "x \000stvxl \000stw \000stwbrx \000stwcx. \000stwu \000stwux \000stwx \000"
    "subf \000subfc \000subfe \000subfic \000subfme \000subfze \000sync\000b"
    "a \000#TC_RETURNa \000#TC_RETURNa8 \000#TC_RETURNd \000#TC_RETURNd8 \000"
    "#TC_RETURNr \000#TC_RETURNr8 \000trap\000UPDATE_VRSAVE \000vaddcuw \000"
    "vaddfp \000vaddsbs \000vaddshs \000vaddsws \000vaddubm \000vaddubs \000"
    "vadduhm \000vadduhs \000vadduwm \000vadduws \000vand \000vandc \000vavg"
    "sb \000vavgsh \000vavgsw \000vavgub \000vavguh \000vavguw \000vcfsx \000"
    "vcfux \000vcmpbfp \000vcmpbfp. \000vcmpeqfp \000vcmpeqfp. \000vcmpequb "
    "\000vcmpequb. \000vcmpequh \000vcmpequh. \000vcmpequw \000vcmpequw. \000"
    "vcmpgefp \000vcmpgefp. \000vcmpgtfp \000vcmpgtfp. \000vcmpgtsb \000vcmp"
    "gtsb. \000vcmpgtsh \000vcmpgtsh. \000vcmpgtsw \000vcmpgtsw. \000vcmpgtu"
    "b \000vcmpgtub. \000vcmpgtuh \000vcmpgtuh. \000vcmpgtuw \000vcmpgtuw. \000"
    "vctsxs \000vctuxs \000vexptefp \000vlogefp \000vmaddfp \000vmaxfp \000v"
    "maxsb \000vmaxsh \000vmaxsw \000vmaxub \000vmaxuh \000vmaxuw \000vmhadd"
    "shs \000vmhraddshs \000vminfp \000vminsb \000vminsh \000vminsw \000vmin"
    "ub \000vminuh \000vminuw \000vmladduhm \000vmrghb \000vmrghh \000vmrghw"
    " \000vmrglb \000vmrglh \000vmrglw \000vmsummbm \000vmsumshm \000vmsumsh"
    "s \000vmsumubm \000vmsumuhm \000vmsumuhs \000vmulesb \000vmulesh \000vm"
    "uleub \000vmuleuh \000vmulosb \000vmulosh \000vmuloub \000vmulouh \000v"
    "nmsubfp \000vnor \000vor \000vperm \000vpkpx \000vpkshss \000vpkshus \000"
    "vpkswss \000vpkswus \000vpkuhum \000vpkuhus \000vpkuwum \000vpkuwus \000"
    "vrefp \000vrfim \000vrfin \000vrfip \000vrfiz \000vrlb \000vrlh \000vrl"
    "w \000vrsqrtefp \000vsel \000vsl \000vslb \000vsldoi \000vslh \000vslo "
    "\000vslw \000vspltb \000vsplth \000vspltisb \000vspltish \000vspltisw \000"
    "vspltw \000vsr \000vsrab \000vsrah \000vsraw \000vsrb \000vsrh \000vsro"
    " \000vsrw \000vsubcuw \000vsubfp \000vsubsbs \000vsubshs \000vsubsws \000"
    "vsububm \000vsububs \000vsubuhm \000vsubuhs \000vsubuwm \000vsubuws \000"
    "vsum2sws \000vsum4sbs \000vsum4shs \000vsum4ubs \000vsumsws \000vupkhpx"
    " \000vupkhsb \000vupkhsh \000vupklpx \000vupklsb \000vupklsh \000vxor \000"
    "xor \000xori \000xoris \000";

  O << "\t";

  // Emit the opcode for the instruction.
  unsigned Bits = OpInfo[MI->getOpcode()];
  assert(Bits != 0 && "Cannot print this instruction.");
  O << AsmStrs+(Bits & 4095)-1;


  // Fragment 0 encoded into 4 bits for 14 unique commands.
  switch ((Bits >> 28) & 15) {
  default:   // unreachable.
  case 0:
    // DBG_VALUE, BCTR, BCTRL8_Darwin, BCTRL8_ELF, BCTRL_Darwin, BCTRL_SVR4, ...
    return;
    break;
  case 1:
    // ADD4, ADD8, ADDC, ADDC8, ADDE, ADDE8, ADDI, ADDI8, ADDIC, ADDIC8, ADDI...
    printOperand(MI, 0); 
    break;
  case 2:
    // ADJCALLSTACKDOWN, ADJCALLSTACKUP, ATOMIC_CMP_SWAP_I16, ATOMIC_CMP_SWAP...
    PrintSpecial(MI, "comment"); 
    break;
  case 3:
    // B
    printBranchOperand(MI, 0); 
    return;
    break;
  case 4:
    // BCC, BLR
    printPredicateOperand(MI, 0, "cc"); 
    break;
  case 5:
    // BL8_Darwin, BL8_ELF, BL_Darwin, BL_SVR4, TAILB, TAILB8, TCRETURNdi, TC...
    printCallOperand(MI, 0); 
    break;
  case 6:
    // BLA8_Darwin, BLA8_ELF, BLA_Darwin, BLA_SVR4, TAILBA, TAILBA8, TCRETURN...
    printAbsAddrOperand(MI, 0); 
    break;
  case 7:
    // DCBA, DCBF, DCBI, DCBST, DCBT, DCBTST, DCBZ, DCBZL
    printMemRegReg(MI, 0); 
    return;
    break;
  case 8:
    // DSS
    printU5ImmOperand(MI, 1); 
    return;
    break;
  case 9:
    // DST, DST64, DSTST, DSTST64, DSTSTT, DSTSTT64, DSTT, DSTT64
    printOperand(MI, 2); 
    O << ", "; 
    printOperand(MI, 3); 
    O << ", "; 
    printU5ImmOperand(MI, 1); 
    return;
    break;
  case 10:
    // MTCRF
    printcrbitm(MI, 0); 
    O << ", "; 
    printOperand(MI, 1); 
    return;
    break;
  case 11:
    // MTFSB0, MTFSB1
    printU5ImmOperand(MI, 0); 
    return;
    break;
  case 12:
    // MTFSF, STBU, STBU8, STDU, STFDU, STFSU, STHU, STHU8, STWU
    printOperand(MI, 1); 
    O << ", "; 
    break;
  case 13:
    // MovePCtoLR, MovePCtoLR8
    printPICLabel(MI, 0); 
    return;
    break;
  }


  // Fragment 1 encoded into 6 bits for 47 unique commands.
  switch ((Bits >> 22) & 63) {
  default:   // unreachable.
  case 0:
    // ADD4, ADD8, ADDC, ADDC8, ADDE, ADDE8, ADDI, ADDI8, ADDIC, ADDIC8, ADDI...
    O << ", "; 
    break;
  case 1:
    // ADJCALLSTACKDOWN
    O << " ADJCALLSTACKDOWN"; 
    return;
    break;
  case 2:
    // ADJCALLSTACKUP
    O << " ADJCALLSTACKUP"; 
    return;
    break;
  case 3:
    // ATOMIC_CMP_SWAP_I16
    O << " ATOMIC_CMP_SWAP_I16 PSEUDO!"; 
    return;
    break;
  case 4:
    // ATOMIC_CMP_SWAP_I32
    O << " ATOMIC_CMP_SWAP_I32 PSEUDO!"; 
    return;
    break;
  case 5:
    // ATOMIC_CMP_SWAP_I64
    O << " ATOMIC_CMP_SWAP_I64 PSEUDO!"; 
    return;
    break;
  case 6:
    // ATOMIC_CMP_SWAP_I8
    O << " ATOMIC_CMP_SWAP_I8 PSEUDO!"; 
    return;
    break;
  case 7:
    // ATOMIC_LOAD_ADD_I16
    O << " ATOMIC_LOAD_ADD_I16 PSEUDO!"; 
    return;
    break;
  case 8:
    // ATOMIC_LOAD_ADD_I32
    O << " ATOMIC_LOAD_ADD_I32 PSEUDO!"; 
    return;
    break;
  case 9:
    // ATOMIC_LOAD_ADD_I64
    O << " ATOMIC_LOAD_ADD_I64 PSEUDO!"; 
    return;
    break;
  case 10:
    // ATOMIC_LOAD_ADD_I8
    O << " ATOMIC_LOAD_ADD_I8 PSEUDO!"; 
    return;
    break;
  case 11:
    // ATOMIC_LOAD_AND_I16
    O << " ATOMIC_LOAD_AND_I16 PSEUDO!"; 
    return;
    break;
  case 12:
    // ATOMIC_LOAD_AND_I32
    O << " ATOMIC_LOAD_AND_I32 PSEUDO!"; 
    return;
    break;
  case 13:
    // ATOMIC_LOAD_AND_I64
    O << " ATOMIC_LOAD_AND_I64 PSEUDO!"; 
    return;
    break;
  case 14:
    // ATOMIC_LOAD_AND_I8
    O << " ATOMIC_LOAD_AND_I8 PSEUDO!"; 
    return;
    break;
  case 15:
    // ATOMIC_LOAD_NAND_I16
    O << " ATOMIC_LOAD_NAND_I16 PSEUDO!"; 
    return;
    break;
  case 16:
    // ATOMIC_LOAD_NAND_I32
    O << " ATOMIC_LOAD_NAND_I32 PSEUDO!"; 
    return;
    break;
  case 17:
    // ATOMIC_LOAD_NAND_I64
    O << " ATOMIC_LOAD_NAND_I64 PSEUDO!"; 
    return;
    break;
  case 18:
    // ATOMIC_LOAD_NAND_I8
    O << " ATOMIC_LOAD_NAND_I8 PSEUDO!"; 
    return;
    break;
  case 19:
    // ATOMIC_LOAD_OR_I16
    O << " ATOMIC_LOAD_OR_I16 PSEUDO!"; 
    return;
    break;
  case 20:
    // ATOMIC_LOAD_OR_I32
    O << " ATOMIC_LOAD_OR_I32 PSEUDO!"; 
    return;
    break;
  case 21:
    // ATOMIC_LOAD_OR_I64
    O << " ATOMIC_LOAD_OR_I64 PSEUDO!"; 
    return;
    break;
  case 22:
    // ATOMIC_LOAD_OR_I8
    O << " ATOMIC_LOAD_OR_I8 PSEUDO!"; 
    return;
    break;
  case 23:
    // ATOMIC_LOAD_SUB_I16
    O << " ATOMIC_LOAD_SUB_I16 PSEUDO!"; 
    return;
    break;
  case 24:
    // ATOMIC_LOAD_SUB_I32
    O << " ATOMIC_LOAD_SUB_I32 PSEUDO!"; 
    return;
    break;
  case 25:
    // ATOMIC_LOAD_SUB_I64
    O << " ATOMIC_LOAD_SUB_I64 PSEUDO!"; 
    return;
    break;
  case 26:
    // ATOMIC_LOAD_SUB_I8
    O << " ATOMIC_LOAD_SUB_I8 PSEUDO!"; 
    return;
    break;
  case 27:
    // ATOMIC_LOAD_XOR_I16
    O << " ATOMIC_LOAD_XOR_I16 PSEUDO!"; 
    return;
    break;
  case 28:
    // ATOMIC_LOAD_XOR_I32
    O << " ATOMIC_LOAD_XOR_I32 PSEUDO!"; 
    return;
    break;
  case 29:
    // ATOMIC_LOAD_XOR_I64
    O << " ATOMIC_LOAD_XOR_I64 PSEUDO!"; 
    return;
    break;
  case 30:
    // ATOMIC_LOAD_XOR_I8
    O << " ATOMIC_LOAD_XOR_I8 PSEUDO!"; 
    return;
    break;
  case 31:
    // ATOMIC_SWAP_I16
    O << " ATOMIC_SWAP_I16 PSEUDO!"; 
    return;
    break;
  case 32:
    // ATOMIC_SWAP_I32
    O << " ATOMIC_SWAP_I32 PSEUDO!"; 
    return;
    break;
  case 33:
    // ATOMIC_SWAP_I64
    O << " ATOMIC_SWAP_I64 PSEUDO!"; 
    return;
    break;
  case 34:
    // ATOMIC_SWAP_I8
    O << " ATOMIC_SWAP_I8 PSEUDO!"; 
    return;
    break;
  case 35:
    // BCC, TCRETURNai, TCRETURNai8, TCRETURNdi, TCRETURNdi8, TCRETURNri, TCR...
    O << ' '; 
    break;
  case 36:
    // BL8_Darwin, BL8_ELF, BLA8_Darwin, BLA8_ELF, BLA_Darwin, BLA_SVR4, BL_D...
    return;
    break;
  case 37:
    // BLR
    O << "lr "; 
    printPredicateOperand(MI, 0, "reg"); 
    return;
    break;
  case 38:
    // DYNALLOC
    O << " DYNALLOC "; 
    printOperand(MI, 0); 
    O << ", "; 
    printOperand(MI, 1); 
    O << ", "; 
    printMemRegImm(MI, 2); 
    return;
    break;
  case 39:
    // DYNALLOC8
    O << " DYNALLOC8 "; 
    printOperand(MI, 0); 
    O << ", "; 
    printOperand(MI, 1); 
    O << ", "; 
    printMemRegImm(MI, 2); 
    return;
    break;
  case 40:
    // LDinto_toc
    O << ')'; 
    return;
    break;
  case 41:
    // MFVRSAVE
    O << ", 256"; 
    return;
    break;
  case 42:
    // MTFSF
    printOperand(MI, 2); 
    return;
    break;
  case 43:
    // SELECT_CC_F4, SELECT_CC_F8, SELECT_CC_I4, SELECT_CC_I8, SELECT_CC_VRRC
    O << " SELECT_CC PSEUDO!"; 
    return;
    break;
  case 44:
    // SPILL_CR
    O << " SPILL_CR "; 
    printOperand(MI, 0); 
    O << ' '; 
    printMemRegImm(MI, 1); 
    return;
    break;
  case 45:
    // STBU, STBU8, STFDU, STFSU, STHU, STHU8, STWU
    printSymbolLo(MI, 2); 
    O << '('; 
    printOperand(MI, 3); 
    O << ')'; 
    return;
    break;
  case 46:
    // STDU
    printS16X4ImmOperand(MI, 2); 
    O << '('; 
    printOperand(MI, 3); 
    O << ')'; 
    return;
    break;
  }


  // Fragment 2 encoded into 4 bits for 15 unique commands.
  switch ((Bits >> 18) & 15) {
  default:   // unreachable.
  case 0:
    // ADD4, ADD8, ADDC, ADDC8, ADDE, ADDE8, ADDI, ADDI8, ADDIC, ADDIC8, ADDI...
    printOperand(MI, 1); 
    break;
  case 1:
    // BCC
    printPredicateOperand(MI, 0, "reg"); 
    O << ", "; 
    printBranchOperand(MI, 2); 
    return;
    break;
  case 2:
    // CRSET, V_SET0
    printOperand(MI, 0); 
    O << ", "; 
    printOperand(MI, 0); 
    return;
    break;
  case 3:
    // LA, LHAU8
    printSymbolLo(MI, 2); 
    O << '('; 
    break;
  case 4:
    // LBZ, LBZ8, LFD, LFS, LHA, LHA8, LHZ, LHZ8, LWZ, LWZ8, STB, STB8, STFD,...
    printMemRegImm(MI, 1); 
    return;
    break;
  case 5:
    // LBZU, LBZU8, LFDU, LFSU, LHAU, LHZU, LHZU8, LWZU, LWZU8
    printMemRegImm(MI, 2); 
    return;
    break;
  case 6:
    // LBZX, LBZX8, LDARX, LDX, LFDX, LFSX, LHAX, LHAX8, LHBRX, LHZX, LHZX8, ...
    printMemRegReg(MI, 1); 
    return;
    break;
  case 7:
    // LD, LWA, STD, STD_32
    printMemRegImmShifted(MI, 1); 
    return;
    break;
  case 8:
    // LDU
    printMemRegImmShifted(MI, 2); 
    return;
    break;
  case 9:
    // LDtoc
    printTOCEntryLabel(MI, 1); 
    O << '('; 
    printOperand(MI, 2); 
    O << ')'; 
    return;
    break;
  case 10:
    // LI, LI8
    printSymbolLo(MI, 1); 
    return;
    break;
  case 11:
    // LIS, LIS8
    printSymbolHi(MI, 1); 
    return;
    break;
  case 12:
    // MFOCRF
    printcrbitm(MI, 1); 
    return;
    break;
  case 13:
    // RLDIMI, RLWIMI, VCFSX, VCFUX, VCTSXS, VCTUXS, VSPLTB, VSPLTH, VSPLTW
    printOperand(MI, 2); 
    O << ", "; 
    break;
  case 14:
    // VSPLTISB, VSPLTISH, VSPLTISW
    printS5ImmOperand(MI, 1); 
    return;
    break;
  }


  // Fragment 3 encoded into 3 bits for 7 unique commands.
  switch ((Bits >> 15) & 7) {
  default:   // unreachable.
  case 0:
    // ADD4, ADD8, ADDC, ADDC8, ADDE, ADDE8, ADDI, ADDI8, ADDIC, ADDIC8, ADDI...
    O << ", "; 
    break;
  case 1:
    // ADDME, ADDME8, ADDZE, ADDZE8, CNTLZD, CNTLZW, EXTSB, EXTSB8, EXTSH, EX...
    return;
    break;
  case 2:
    // LA
    printOperand(MI, 1); 
    O << ')'; 
    return;
    break;
  case 3:
    // LHAU8
    printOperand(MI, 3); 
    O << ')'; 
    return;
    break;
  case 4:
    // RLDIMI
    printU6ImmOperand(MI, 3); 
    O << ", "; 
    printU6ImmOperand(MI, 4); 
    return;
    break;
  case 5:
    // RLWIMI
    printU5ImmOperand(MI, 3); 
    O << ", "; 
    printU5ImmOperand(MI, 4); 
    O << ", "; 
    printU5ImmOperand(MI, 5); 
    return;
    break;
  case 6:
    // VCFSX, VCFUX, VCTSXS, VCTUXS, VSPLTB, VSPLTH, VSPLTW
    printU5ImmOperand(MI, 1); 
    return;
    break;
  }


  // Fragment 4 encoded into 3 bits for 6 unique commands.
  switch ((Bits >> 12) & 7) {
  default:   // unreachable.
  case 0:
    // ADD4, ADD8, ADDC, ADDC8, ADDE, ADDE8, AND, AND8, ANDC, ANDC8, CMPD, CM...
    printOperand(MI, 2); 
    break;
  case 1:
    // ADDI, ADDI8, ADDIC, ADDIC8, ADDICo, CMPDI, CMPWI, MULLI, SUBFIC, SUBFI...
    printS16ImmOperand(MI, 2); 
    return;
    break;
  case 2:
    // ADDIS, ADDIS8
    printSymbolHi(MI, 2); 
    return;
    break;
  case 3:
    // ANDISo, ANDISo8, ANDIo, ANDIo8, CMPLDI, CMPLWI, ORI, ORI8, ORIS, ORIS8...
    printU16ImmOperand(MI, 2); 
    return;
    break;
  case 4:
    // RLDICL, RLDICR, SRADI
    printU6ImmOperand(MI, 2); 
    break;
  case 5:
    // RLWINM, RLWINMo, SRAWI
    printU5ImmOperand(MI, 2); 
    break;
  }

  switch (MI->getOpcode()) {
  case PPC::ADD4:
  case PPC::ADD8:
  case PPC::ADDC:
  case PPC::ADDC8:
  case PPC::ADDE:
  case PPC::ADDE8:
  case PPC::AND:
  case PPC::AND8:
  case PPC::ANDC:
  case PPC::ANDC8:
  case PPC::CMPD:
  case PPC::CMPLD:
  case PPC::CMPLW:
  case PPC::CMPW:
  case PPC::CREQV:
  case PPC::CROR:
  case PPC::DIVD:
  case PPC::DIVDU:
  case PPC::DIVW:
  case PPC::DIVWU:
  case PPC::EQV:
  case PPC::EQV8:
  case PPC::FADD:
  case PPC::FADDS:
  case PPC::FADDrtz:
  case PPC::FCMPUD:
  case PPC::FCMPUS:
  case PPC::FDIV:
  case PPC::FDIVS:
  case PPC::FMUL:
  case PPC::FMULS:
  case PPC::FSUB:
  case PPC::FSUBS:
  case PPC::MULHD:
  case PPC::MULHDU:
  case PPC::MULHW:
  case PPC::MULHWU:
  case PPC::MULLD:
  case PPC::MULLW:
  case PPC::NAND:
  case PPC::NAND8:
  case PPC::NOR:
  case PPC::NOR8:
  case PPC::OR:
  case PPC::OR4To8:
  case PPC::OR8:
  case PPC::OR8To4:
  case PPC::ORC:
  case PPC::ORC8:
  case PPC::SLD:
  case PPC::SLW:
  case PPC::SRAD:
  case PPC::SRADI:
  case PPC::SRAW:
  case PPC::SRAWI:
  case PPC::SRD:
  case PPC::SRW:
  case PPC::STWUX:
  case PPC::SUBF:
  case PPC::SUBF8:
  case PPC::SUBFC:
  case PPC::SUBFC8:
  case PPC::SUBFE:
  case PPC::SUBFE8:
  case PPC::VADDCUW:
  case PPC::VADDFP:
  case PPC::VADDSBS:
  case PPC::VADDSHS:
  case PPC::VADDSWS:
  case PPC::VADDUBM:
  case PPC::VADDUBS:
  case PPC::VADDUHM:
  case PPC::VADDUHS:
  case PPC::VADDUWM:
  case PPC::VADDUWS:
  case PPC::VAND:
  case PPC::VANDC:
  case PPC::VAVGSB:
  case PPC::VAVGSH:
  case PPC::VAVGSW:
  case PPC::VAVGUB:
  case PPC::VAVGUH:
  case PPC::VAVGUW:
  case PPC::VCMPBFP:
  case PPC::VCMPBFPo:
  case PPC::VCMPEQFP:
  case PPC::VCMPEQFPo:
  case PPC::VCMPEQUB:
  case PPC::VCMPEQUBo:
  case PPC::VCMPEQUH:
  case PPC::VCMPEQUHo:
  case PPC::VCMPEQUW:
  case PPC::VCMPEQUWo:
  case PPC::VCMPGEFP:
  case PPC::VCMPGEFPo:
  case PPC::VCMPGTFP:
  case PPC::VCMPGTFPo:
  case PPC::VCMPGTSB:
  case PPC::VCMPGTSBo:
  case PPC::VCMPGTSH:
  case PPC::VCMPGTSHo:
  case PPC::VCMPGTSW:
  case PPC::VCMPGTSWo:
  case PPC::VCMPGTUB:
  case PPC::VCMPGTUBo:
  case PPC::VCMPGTUH:
  case PPC::VCMPGTUHo:
  case PPC::VCMPGTUW:
  case PPC::VCMPGTUWo:
  case PPC::VMAXFP:
  case PPC::VMAXSB:
  case PPC::VMAXSH:
  case PPC::VMAXSW:
  case PPC::VMAXUB:
  case PPC::VMAXUH:
  case PPC::VMAXUW:
  case PPC::VMINFP:
  case PPC::VMINSB:
  case PPC::VMINSH:
  case PPC::VMINSW:
  case PPC::VMINUB:
  case PPC::VMINUH:
  case PPC::VMINUW:
  case PPC::VMRGHB:
  case PPC::VMRGHH:
  case PPC::VMRGHW:
  case PPC::VMRGLB:
  case PPC::VMRGLH:
  case PPC::VMRGLW:
  case PPC::VMULESB:
  case PPC::VMULESH:
  case PPC::VMULEUB:
  case PPC::VMULEUH:
  case PPC::VMULOSB:
  case PPC::VMULOSH:
  case PPC::VMULOUB:
  case PPC::VMULOUH:
  case PPC::VNOR:
  case PPC::VOR:
  case PPC::VPKPX:
  case PPC::VPKSHSS:
  case PPC::VPKSHUS:
  case PPC::VPKSWSS:
  case PPC::VPKSWUS:
  case PPC::VPKUHUM:
  case PPC::VPKUHUS:
  case PPC::VPKUWUM:
  case PPC::VPKUWUS:
  case PPC::VRLB:
  case PPC::VRLH:
  case PPC::VRLW:
  case PPC::VSL:
  case PPC::VSLB:
  case PPC::VSLH:
  case PPC::VSLO:
  case PPC::VSLW:
  case PPC::VSR:
  case PPC::VSRAB:
  case PPC::VSRAH:
  case PPC::VSRAW:
  case PPC::VSRB:
  case PPC::VSRH:
  case PPC::VSRO:
  case PPC::VSRW:
  case PPC::VSUBCUW:
  case PPC::VSUBFP:
  case PPC::VSUBSBS:
  case PPC::VSUBSHS:
  case PPC::VSUBSWS:
  case PPC::VSUBUBM:
  case PPC::VSUBUBS:
  case PPC::VSUBUHM:
  case PPC::VSUBUHS:
  case PPC::VSUBUWM:
  case PPC::VSUBUWS:
  case PPC::VSUM2SWS:
  case PPC::VSUM4SBS:
  case PPC::VSUM4SHS:
  case PPC::VSUM4UBS:
  case PPC::VSUMSWS:
  case PPC::VXOR:
  case PPC::XOR:
  case PPC::XOR8:
    return;
    break;
  case PPC::FMADD:
  case PPC::FMADDS:
  case PPC::FMSUB:
  case PPC::FMSUBS:
  case PPC::FNMADD:
  case PPC::FNMADDS:
  case PPC::FNMSUB:
  case PPC::FNMSUBS:
  case PPC::FSELD:
  case PPC::FSELS:
  case PPC::RLDCL:
  case PPC::RLDICL:
  case PPC::RLDICR:
  case PPC::VMADDFP:
  case PPC::VMHADDSHS:
  case PPC::VMHRADDSHS:
  case PPC::VMLADDUHM:
  case PPC::VMSUMMBM:
  case PPC::VMSUMSHM:
  case PPC::VMSUMSHS:
  case PPC::VMSUMUBM:
  case PPC::VMSUMUHM:
  case PPC::VMSUMUHS:
  case PPC::VNMSUBFP:
  case PPC::VPERM:
  case PPC::VSEL:
  case PPC::VSLDOI:
    O << ", "; 
    switch (MI->getOpcode()) {
    case PPC::FMADD: 
    case PPC::FMADDS: 
    case PPC::FMSUB: 
    case PPC::FMSUBS: 
    case PPC::FNMADD: 
    case PPC::FNMADDS: 
    case PPC::FNMSUB: 
    case PPC::FNMSUBS: 
    case PPC::FSELD: 
    case PPC::FSELS: 
    case PPC::VMADDFP: 
    case PPC::VMHADDSHS: 
    case PPC::VMHRADDSHS: 
    case PPC::VMLADDUHM: 
    case PPC::VMSUMMBM: 
    case PPC::VMSUMSHM: 
    case PPC::VMSUMSHS: 
    case PPC::VMSUMUBM: 
    case PPC::VMSUMUHM: 
    case PPC::VMSUMUHS: 
    case PPC::VNMSUBFP: 
    case PPC::VPERM: 
    case PPC::VSEL: printOperand(MI, 3); break;
    case PPC::RLDCL: 
    case PPC::RLDICL: 
    case PPC::RLDICR: printU6ImmOperand(MI, 3); break;
    case PPC::VSLDOI: printU5ImmOperand(MI, 3); break;
    }
    return;
    break;
  case PPC::RLWINM:
  case PPC::RLWINMo:
  case PPC::RLWNM:
    O << ", "; 
    printU5ImmOperand(MI, 3); 
    O << ", "; 
    printU5ImmOperand(MI, 4); 
    return;
    break;
  }
  return;
}


/// getRegisterName - This method is automatically generated by tblgen
/// from the register set description.  This returns the assembler name
/// for the specified register.
const char *PPCAsmPrinter::getRegisterName(unsigned RegNo) {
  assert(RegNo && RegNo < 176 && "Invalid register number!");

  static const unsigned RegAsmOffset[] = {
    0, 3, 7, 9, 11, 13, 15, 19, 21, 23, 25, 27, 31, 34, 
    36, 38, 41, 45, 48, 51, 54, 57, 61, 64, 67, 70, 73, 77, 
    80, 83, 86, 89, 93, 96, 99, 102, 105, 109, 112, 115, 118, 121, 
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    342, 346, 349, 352, 355, 358, 361, 0
  };

  const char *AsmStrs =
    "ca\000cr0\0002\0001\0000\0003\000cr1\0006\0005\0004\0007\000cr2\00010\000"
    "9\0008\00011\000cr3\00014\00013\00012\00015\000cr4\00018\00017\00016\000"
    "19\000cr5\00022\00021\00020\00023\000cr6\00026\00025\00024\00027\000cr7"
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    "2\000r23\000r24\000r25\000r26\000r27\000r28\000r29\000r3\000r30\000r31\000"
    "r4\000r5\000r6\000r7\000r8\000r9\000**ROUNDING MODE**\000v0\000v1\000v1"
    "0\000v11\000v12\000v13\000v14\000v15\000v16\000v17\000v18\000v19\000v2\000"
    "v20\000v21\000v22\000v23\000v24\000v25\000v26\000v27\000v28\000v29\000v"
    "3\000v30\000v31\000v4\000v5\000v6\000v7\000v8\000v9\000VRsave\000";
  return AsmStrs+RegAsmOffset[RegNo-1];
}


#ifdef GET_INSTRUCTION_NAME
#undef GET_INSTRUCTION_NAME

/// getInstructionName: This method is automatically generated by tblgen
/// from the instruction set description.  This returns the enum name of the
/// specified instruction.
const char *PPCAsmPrinter::getInstructionName(unsigned Opcode) {
  assert(Opcode < 519 && "Invalid instruction number!");

  static const unsigned InstAsmOffset[] = {
    0, 4, 14, 24, 33, 42, 47, 62, 76, 89, 103, 120, 130, 135, 
    140, 145, 151, 156, 162, 167, 173, 179, 186, 193, 199, 206, 212, 219, 
    225, 232, 249, 264, 268, 273, 278, 284, 291, 299, 305, 312, 332, 352, 
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    3975, 0
  };

  const char *Strs =
    "PHI\000INLINEASM\000DBG_LABEL\000EH_LABEL\000GC_LABEL\000KILL\000EXTRAC"
    "T_SUBREG\000INSERT_SUBREG\000IMPLICIT_DEF\000SUBREG_TO_REG\000COPY_TO_R"
    "EGCLASS\000DBG_VALUE\000ADD4\000ADD8\000ADDC\000ADDC8\000ADDE\000ADDE8\000"
    "ADDI\000ADDI8\000ADDIC\000ADDIC8\000ADDICo\000ADDIS\000ADDIS8\000ADDME\000"
    "ADDME8\000ADDZE\000ADDZE8\000ADJCALLSTACKDOWN\000ADJCALLSTACKUP\000AND\000"
    "AND8\000ANDC\000ANDC8\000ANDISo\000ANDISo8\000ANDIo\000ANDIo8\000ATOMIC"
    "_CMP_SWAP_I16\000ATOMIC_CMP_SWAP_I32\000ATOMIC_CMP_SWAP_I64\000ATOMIC_C"
    "MP_SWAP_I8\000ATOMIC_LOAD_ADD_I16\000ATOMIC_LOAD_ADD_I32\000ATOMIC_LOAD"
    "_ADD_I64\000ATOMIC_LOAD_ADD_I8\000ATOMIC_LOAD_AND_I16\000ATOMIC_LOAD_AN"
    "D_I32\000ATOMIC_LOAD_AND_I64\000ATOMIC_LOAD_AND_I8\000ATOMIC_LOAD_NAND_"
    "I16\000ATOMIC_LOAD_NAND_I32\000ATOMIC_LOAD_NAND_I64\000ATOMIC_LOAD_NAND"
    "_I8\000ATOMIC_LOAD_OR_I16\000ATOMIC_LOAD_OR_I32\000ATOMIC_LOAD_OR_I64\000"
    "ATOMIC_LOAD_OR_I8\000ATOMIC_LOAD_SUB_I16\000ATOMIC_LOAD_SUB_I32\000ATOM"
    "IC_LOAD_SUB_I64\000ATOMIC_LOAD_SUB_I8\000ATOMIC_LOAD_XOR_I16\000ATOMIC_"
    "LOAD_XOR_I32\000ATOMIC_LOAD_XOR_I64\000ATOMIC_LOAD_XOR_I8\000ATOMIC_SWA"
    "P_I16\000ATOMIC_SWAP_I32\000ATOMIC_SWAP_I64\000ATOMIC_SWAP_I8\000B\000B"
    "CC\000BCTR\000BCTRL8_Darwin\000BCTRL8_ELF\000BCTRL_Darwin\000BCTRL_SVR4"
    "\000BL8_Darwin\000BL8_ELF\000BLA8_Darwin\000BLA8_ELF\000BLA_Darwin\000B"
    "LA_SVR4\000BLR\000BL_Darwin\000BL_SVR4\000CMPD\000CMPDI\000CMPLD\000CMP"
    "LDI\000CMPLW\000CMPLWI\000CMPW\000CMPWI\000CNTLZD\000CNTLZW\000CREQV\000"
    "CROR\000CRSET\000DCBA\000DCBF\000DCBI\000DCBST\000DCBT\000DCBTST\000DCB"
    "Z\000DCBZL\000DIVD\000DIVDU\000DIVW\000DIVWU\000DSS\000DSSALL\000DST\000"
    "DST64\000DSTST\000DSTST64\000DSTSTT\000DSTSTT64\000DSTT\000DSTT64\000DY"
    "NALLOC\000DYNALLOC8\000EQV\000EQV8\000EXTSB\000EXTSB8\000EXTSH\000EXTSH"
    "8\000EXTSW\000EXTSW_32\000EXTSW_32_64\000FABSD\000FABSS\000FADD\000FADD"
    "S\000FADDrtz\000FCFID\000FCMPUD\000FCMPUS\000FCTIDZ\000FCTIWZ\000FDIV\000"
    "FDIVS\000FMADD\000FMADDS\000FMR\000FMRSD\000FMSUB\000FMSUBS\000FMUL\000"
    "FMULS\000FNABSD\000FNABSS\000FNEGD\000FNEGS\000FNMADD\000FNMADDS\000FNM"
    "SUB\000FNMSUBS\000FRSP\000FSELD\000FSELS\000FSQRT\000FSQRTS\000FSUB\000"
    "FSUBS\000LA\000LBZ\000LBZ8\000LBZU\000LBZU8\000LBZX\000LBZX8\000LD\000L"
    "DARX\000LDU\000LDX\000LDinto_toc\000LDtoc\000LDtoc_restore\000LFD\000LF"
    "DU\000LFDX\000LFS\000LFSU\000LFSX\000LHA\000LHA8\000LHAU\000LHAU8\000LH"
    "AX\000LHAX8\000LHBRX\000LHZ\000LHZ8\000LHZU\000LHZU8\000LHZX\000LHZX8\000"
    "LI\000LI8\000LIS\000LIS8\000LVEBX\000LVEHX\000LVEWX\000LVSL\000LVSR\000"
    "LVX\000LVXL\000LWA\000LWARX\000LWAX\000LWBRX\000LWZ\000LWZ8\000LWZU\000"
    "LWZU8\000LWZX\000LWZX8\000MCRF\000MFCR\000MFCTR\000MFCTR8\000MFFS\000MF"
    "LR\000MFLR8\000MFOCRF\000MFVRSAVE\000MFVSCR\000MTCRF\000MTCTR\000MTCTR8"
    "\000MTFSB0\000MTFSB1\000MTFSF\000MTLR\000MTLR8\000MTVRSAVE\000MTVSCR\000"
    "MULHD\000MULHDU\000MULHW\000MULHWU\000MULLD\000MULLI\000MULLW\000MovePC"
    "toLR\000MovePCtoLR8\000NAND\000NAND8\000NEG\000NEG8\000NOP\000NOR\000NO"
    "R8\000OR\000OR4To8\000OR8\000OR8To4\000ORC\000ORC8\000ORI\000ORI8\000OR"
    "IS\000ORIS8\000RLDCL\000RLDICL\000RLDICR\000RLDIMI\000RLWIMI\000RLWINM\000"
    "RLWINMo\000RLWNM\000SELECT_CC_F4\000SELECT_CC_F8\000SELECT_CC_I4\000SEL"
    "ECT_CC_I8\000SELECT_CC_VRRC\000SLD\000SLW\000SPILL_CR\000SRAD\000SRADI\000"
    "SRAW\000SRAWI\000SRD\000SRW\000STB\000STB8\000STBU\000STBU8\000STBX\000"
    "STBX8\000STD\000STDCX\000STDU\000STDUX\000STDX\000STDX_32\000STD_32\000"
    "STFD\000STFDU\000STFDX\000STFIWX\000STFS\000STFSU\000STFSX\000STH\000ST"
    "H8\000STHBRX\000STHU\000STHU8\000STHX\000STHX8\000STVEBX\000STVEHX\000S"
    "TVEWX\000STVX\000STVXL\000STW\000STW8\000STWBRX\000STWCX\000STWU\000STW"
    "UX\000STWX\000STWX8\000SUBF\000SUBF8\000SUBFC\000SUBFC8\000SUBFE\000SUB"
    "FE8\000SUBFIC\000SUBFIC8\000SUBFME\000SUBFME8\000SUBFZE\000SUBFZE8\000S"
    "YNC\000TAILB\000TAILB8\000TAILBA\000TAILBA8\000TAILBCTR\000TAILBCTR8\000"
    "TCRETURNai\000TCRETURNai8\000TCRETURNdi\000TCRETURNdi8\000TCRETURNri\000"
    "TCRETURNri8\000TRAP\000UPDATE_VRSAVE\000VADDCUW\000VADDFP\000VADDSBS\000"
    "VADDSHS\000VADDSWS\000VADDUBM\000VADDUBS\000VADDUHM\000VADDUHS\000VADDU"
    "WM\000VADDUWS\000VAND\000VANDC\000VAVGSB\000VAVGSH\000VAVGSW\000VAVGUB\000"
    "VAVGUH\000VAVGUW\000VCFSX\000VCFUX\000VCMPBFP\000VCMPBFPo\000VCMPEQFP\000"
    "VCMPEQFPo\000VCMPEQUB\000VCMPEQUBo\000VCMPEQUH\000VCMPEQUHo\000VCMPEQUW"
    "\000VCMPEQUWo\000VCMPGEFP\000VCMPGEFPo\000VCMPGTFP\000VCMPGTFPo\000VCMP"
    "GTSB\000VCMPGTSBo\000VCMPGTSH\000VCMPGTSHo\000VCMPGTSW\000VCMPGTSWo\000"
    "VCMPGTUB\000VCMPGTUBo\000VCMPGTUH\000VCMPGTUHo\000VCMPGTUW\000VCMPGTUWo"
    "\000VCTSXS\000VCTUXS\000VEXPTEFP\000VLOGEFP\000VMADDFP\000VMAXFP\000VMA"
    "XSB\000VMAXSH\000VMAXSW\000VMAXUB\000VMAXUH\000VMAXUW\000VMHADDSHS\000V"
    "MHRADDSHS\000VMINFP\000VMINSB\000VMINSH\000VMINSW\000VMINUB\000VMINUH\000"
    "VMINUW\000VMLADDUHM\000VMRGHB\000VMRGHH\000VMRGHW\000VMRGLB\000VMRGLH\000"
    "VMRGLW\000VMSUMMBM\000VMSUMSHM\000VMSUMSHS\000VMSUMUBM\000VMSUMUHM\000V"
    "MSUMUHS\000VMULESB\000VMULESH\000VMULEUB\000VMULEUH\000VMULOSB\000VMULO"
    "SH\000VMULOUB\000VMULOUH\000VNMSUBFP\000VNOR\000VOR\000VPERM\000VPKPX\000"
    "VPKSHSS\000VPKSHUS\000VPKSWSS\000VPKSWUS\000VPKUHUM\000VPKUHUS\000VPKUW"
    "UM\000VPKUWUS\000VREFP\000VRFIM\000VRFIN\000VRFIP\000VRFIZ\000VRLB\000V"
    "RLH\000VRLW\000VRSQRTEFP\000VSEL\000VSL\000VSLB\000VSLDOI\000VSLH\000VS"
    "LO\000VSLW\000VSPLTB\000VSPLTH\000VSPLTISB\000VSPLTISH\000VSPLTISW\000V"
    "SPLTW\000VSR\000VSRAB\000VSRAH\000VSRAW\000VSRB\000VSRH\000VSRO\000VSRW"
    "\000VSUBCUW\000VSUBFP\000VSUBSBS\000VSUBSHS\000VSUBSWS\000VSUBUBM\000VS"
    "UBUBS\000VSUBUHM\000VSUBUHS\000VSUBUWM\000VSUBUWS\000VSUM2SWS\000VSUM4S"
    "BS\000VSUM4SHS\000VSUM4UBS\000VSUMSWS\000VUPKHPX\000VUPKHSB\000VUPKHSH\000"
    "VUPKLPX\000VUPKLSB\000VUPKLSH\000VXOR\000V_SET0\000XOR\000XOR8\000XORI\000"
    "XORI8\000XORIS\000XORIS8\000";
  return Strs+InstAsmOffset[Opcode];
}

#endif
