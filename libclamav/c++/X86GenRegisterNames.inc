//===- TableGen'erated file -------------------------------------*- C++ -*-===//
//
// Target Register Enum Values
//
// Automatically generated file, do not edit!
//
//===----------------------------------------------------------------------===//

namespace llvm {

namespace X86 {
enum {
  NoRegister,
  AH, 	// 1
  AL, 	// 2
  AX, 	// 3
  BH, 	// 4
  BL, 	// 5
  BP, 	// 6
  BPL, 	// 7
  BX, 	// 8
  CH, 	// 9
  CL, 	// 10
  CR0, 	// 11
  CR1, 	// 12
  CR2, 	// 13
  CR3, 	// 14
  CR4, 	// 15
  CR5, 	// 16
  CR6, 	// 17
  CR7, 	// 18
  CR8, 	// 19
  CS, 	// 20
  CX, 	// 21
  DH, 	// 22
  DI, 	// 23
  DIL, 	// 24
  DL, 	// 25
  DR0, 	// 26
  DR1, 	// 27
  DR2, 	// 28
  DR3, 	// 29
  DR4, 	// 30
  DR5, 	// 31
  DR6, 	// 32
  DR7, 	// 33
  DS, 	// 34
  DX, 	// 35
  EAX, 	// 36
  EBP, 	// 37
  EBX, 	// 38
  ECX, 	// 39
  EDI, 	// 40
  EDX, 	// 41
  EFLAGS, 	// 42
  EIP, 	// 43
  EIZ, 	// 44
  ES, 	// 45
  ESI, 	// 46
  ESP, 	// 47
  FP0, 	// 48
  FP1, 	// 49
  FP2, 	// 50
  FP3, 	// 51
  FP4, 	// 52
  FP5, 	// 53
  FP6, 	// 54
  FS, 	// 55
  GS, 	// 56
  IP, 	// 57
  MM0, 	// 58
  MM1, 	// 59
  MM2, 	// 60
  MM3, 	// 61
  MM4, 	// 62
  MM5, 	// 63
  MM6, 	// 64
  MM7, 	// 65
  R8, 	// 66
  R8B, 	// 67
  R8D, 	// 68
  R8W, 	// 69
  R9, 	// 70
  R9B, 	// 71
  R9D, 	// 72
  R9W, 	// 73
  R10, 	// 74
  R10B, 	// 75
  R10D, 	// 76
  R10W, 	// 77
  R11, 	// 78
  R11B, 	// 79
  R11D, 	// 80
  R11W, 	// 81
  R12, 	// 82
  R12B, 	// 83
  R12D, 	// 84
  R12W, 	// 85
  R13, 	// 86
  R13B, 	// 87
  R13D, 	// 88
  R13W, 	// 89
  R14, 	// 90
  R14B, 	// 91
  R14D, 	// 92
  R14W, 	// 93
  R15, 	// 94
  R15B, 	// 95
  R15D, 	// 96
  R15W, 	// 97
  RAX, 	// 98
  RBP, 	// 99
  RBX, 	// 100
  RCX, 	// 101
  RDI, 	// 102
  RDX, 	// 103
  RIP, 	// 104
  RIZ, 	// 105
  RSI, 	// 106
  RSP, 	// 107
  SI, 	// 108
  SIL, 	// 109
  SP, 	// 110
  SPL, 	// 111
  SS, 	// 112
  ST0, 	// 113
  ST1, 	// 114
  ST2, 	// 115
  ST3, 	// 116
  ST4, 	// 117
  ST5, 	// 118
  ST6, 	// 119
  ST7, 	// 120
  XMM0, 	// 121
  XMM1, 	// 122
  XMM2, 	// 123
  XMM3, 	// 124
  XMM4, 	// 125
  XMM5, 	// 126
  XMM6, 	// 127
  XMM7, 	// 128
  XMM8, 	// 129
  XMM9, 	// 130
  XMM10, 	// 131
  XMM11, 	// 132
  XMM12, 	// 133
  XMM13, 	// 134
  XMM14, 	// 135
  XMM15, 	// 136
  YMM0, 	// 137
  YMM1, 	// 138
  YMM2, 	// 139
  YMM3, 	// 140
  YMM4, 	// 141
  YMM5, 	// 142
  YMM6, 	// 143
  YMM7, 	// 144
  YMM8, 	// 145
  YMM9, 	// 146
  YMM10, 	// 147
  YMM11, 	// 148
  YMM12, 	// 149
  YMM13, 	// 150
  YMM14, 	// 151
  YMM15, 	// 152
  NUM_TARGET_REGS 	// 153
};
}

// Subregister indices
namespace X86 {
enum {
  NoSubRegister,
  sub_8bit,	// 1
  sub_8bit_hi,	// 2
  sub_16bit,	// 3
  sub_32bit,	// 4
  sub_sd,	// 5
  sub_ss,	// 6
  sub_xmm,	// 7
  NUM_TARGET_SUBREGS = 8
};
}
} // End llvm namespace 
