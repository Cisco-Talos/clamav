//===- TableGen'erated file -------------------------------------*- C++ -*-===//
//
// Target Instruction Enum Values
//
// Automatically generated file, do not edit!
//
//===----------------------------------------------------------------------===//

namespace llvm {

namespace PPC {
  enum {
    PHI	= 0,
    INLINEASM	= 1,
    PROLOG_LABEL	= 2,
    EH_LABEL	= 3,
    GC_LABEL	= 4,
    KILL	= 5,
    EXTRACT_SUBREG	= 6,
    INSERT_SUBREG	= 7,
    IMPLICIT_DEF	= 8,
    SUBREG_TO_REG	= 9,
    COPY_TO_REGCLASS	= 10,
    DBG_VALUE	= 11,
    REG_SEQUENCE	= 12,
    COPY	= 13,
    ADD4	= 14,
    ADD8	= 15,
    ADDC	= 16,
    ADDC8	= 17,
    ADDE	= 18,
    ADDE8	= 19,
    ADDI	= 20,
    ADDI8	= 21,
    ADDIC	= 22,
    ADDIC8	= 23,
    ADDICo	= 24,
    ADDIS	= 25,
    ADDIS8	= 26,
    ADDME	= 27,
    ADDME8	= 28,
    ADDZE	= 29,
    ADDZE8	= 30,
    ADJCALLSTACKDOWN	= 31,
    ADJCALLSTACKUP	= 32,
    AND	= 33,
    AND8	= 34,
    ANDC	= 35,
    ANDC8	= 36,
    ANDISo	= 37,
    ANDISo8	= 38,
    ANDIo	= 39,
    ANDIo8	= 40,
    ATOMIC_CMP_SWAP_I16	= 41,
    ATOMIC_CMP_SWAP_I32	= 42,
    ATOMIC_CMP_SWAP_I64	= 43,
    ATOMIC_CMP_SWAP_I8	= 44,
    ATOMIC_LOAD_ADD_I16	= 45,
    ATOMIC_LOAD_ADD_I32	= 46,
    ATOMIC_LOAD_ADD_I64	= 47,
    ATOMIC_LOAD_ADD_I8	= 48,
    ATOMIC_LOAD_AND_I16	= 49,
    ATOMIC_LOAD_AND_I32	= 50,
    ATOMIC_LOAD_AND_I64	= 51,
    ATOMIC_LOAD_AND_I8	= 52,
    ATOMIC_LOAD_NAND_I16	= 53,
    ATOMIC_LOAD_NAND_I32	= 54,
    ATOMIC_LOAD_NAND_I64	= 55,
    ATOMIC_LOAD_NAND_I8	= 56,
    ATOMIC_LOAD_OR_I16	= 57,
    ATOMIC_LOAD_OR_I32	= 58,
    ATOMIC_LOAD_OR_I64	= 59,
    ATOMIC_LOAD_OR_I8	= 60,
    ATOMIC_LOAD_SUB_I16	= 61,
    ATOMIC_LOAD_SUB_I32	= 62,
    ATOMIC_LOAD_SUB_I64	= 63,
    ATOMIC_LOAD_SUB_I8	= 64,
    ATOMIC_LOAD_XOR_I16	= 65,
    ATOMIC_LOAD_XOR_I32	= 66,
    ATOMIC_LOAD_XOR_I64	= 67,
    ATOMIC_LOAD_XOR_I8	= 68,
    ATOMIC_SWAP_I16	= 69,
    ATOMIC_SWAP_I32	= 70,
    ATOMIC_SWAP_I64	= 71,
    ATOMIC_SWAP_I8	= 72,
    B	= 73,
    BCC	= 74,
    BCTR	= 75,
    BCTRL8_Darwin	= 76,
    BCTRL8_ELF	= 77,
    BCTRL_Darwin	= 78,
    BCTRL_SVR4	= 79,
    BL8_Darwin	= 80,
    BL8_ELF	= 81,
    BLA8_Darwin	= 82,
    BLA8_ELF	= 83,
    BLA_Darwin	= 84,
    BLA_SVR4	= 85,
    BLR	= 86,
    BL_Darwin	= 87,
    BL_SVR4	= 88,
    CMPD	= 89,
    CMPDI	= 90,
    CMPLD	= 91,
    CMPLDI	= 92,
    CMPLW	= 93,
    CMPLWI	= 94,
    CMPW	= 95,
    CMPWI	= 96,
    CNTLZD	= 97,
    CNTLZW	= 98,
    CREQV	= 99,
    CROR	= 100,
    CRSET	= 101,
    DCBA	= 102,
    DCBF	= 103,
    DCBI	= 104,
    DCBST	= 105,
    DCBT	= 106,
    DCBTST	= 107,
    DCBZ	= 108,
    DCBZL	= 109,
    DIVD	= 110,
    DIVDU	= 111,
    DIVW	= 112,
    DIVWU	= 113,
    DSS	= 114,
    DSSALL	= 115,
    DST	= 116,
    DST64	= 117,
    DSTST	= 118,
    DSTST64	= 119,
    DSTSTT	= 120,
    DSTSTT64	= 121,
    DSTT	= 122,
    DSTT64	= 123,
    DYNALLOC	= 124,
    DYNALLOC8	= 125,
    EQV	= 126,
    EQV8	= 127,
    EXTSB	= 128,
    EXTSB8	= 129,
    EXTSH	= 130,
    EXTSH8	= 131,
    EXTSW	= 132,
    EXTSW_32	= 133,
    EXTSW_32_64	= 134,
    FABSD	= 135,
    FABSS	= 136,
    FADD	= 137,
    FADDS	= 138,
    FADDrtz	= 139,
    FCFID	= 140,
    FCMPUD	= 141,
    FCMPUS	= 142,
    FCTIDZ	= 143,
    FCTIWZ	= 144,
    FDIV	= 145,
    FDIVS	= 146,
    FMADD	= 147,
    FMADDS	= 148,
    FMR	= 149,
    FMSUB	= 150,
    FMSUBS	= 151,
    FMUL	= 152,
    FMULS	= 153,
    FNABSD	= 154,
    FNABSS	= 155,
    FNEGD	= 156,
    FNEGS	= 157,
    FNMADD	= 158,
    FNMADDS	= 159,
    FNMSUB	= 160,
    FNMSUBS	= 161,
    FRSP	= 162,
    FSELD	= 163,
    FSELS	= 164,
    FSQRT	= 165,
    FSQRTS	= 166,
    FSUB	= 167,
    FSUBS	= 168,
    LA	= 169,
    LBZ	= 170,
    LBZ8	= 171,
    LBZU	= 172,
    LBZU8	= 173,
    LBZX	= 174,
    LBZX8	= 175,
    LD	= 176,
    LDARX	= 177,
    LDU	= 178,
    LDX	= 179,
    LDinto_toc	= 180,
    LDtoc	= 181,
    LDtoc_restore	= 182,
    LFD	= 183,
    LFDU	= 184,
    LFDX	= 185,
    LFS	= 186,
    LFSU	= 187,
    LFSX	= 188,
    LHA	= 189,
    LHA8	= 190,
    LHAU	= 191,
    LHAU8	= 192,
    LHAX	= 193,
    LHAX8	= 194,
    LHBRX	= 195,
    LHZ	= 196,
    LHZ8	= 197,
    LHZU	= 198,
    LHZU8	= 199,
    LHZX	= 200,
    LHZX8	= 201,
    LI	= 202,
    LI8	= 203,
    LIS	= 204,
    LIS8	= 205,
    LVEBX	= 206,
    LVEHX	= 207,
    LVEWX	= 208,
    LVSL	= 209,
    LVSR	= 210,
    LVX	= 211,
    LVXL	= 212,
    LWA	= 213,
    LWARX	= 214,
    LWAX	= 215,
    LWBRX	= 216,
    LWZ	= 217,
    LWZ8	= 218,
    LWZU	= 219,
    LWZU8	= 220,
    LWZX	= 221,
    LWZX8	= 222,
    MCRF	= 223,
    MFCRpseud	= 224,
    MFCTR	= 225,
    MFCTR8	= 226,
    MFFS	= 227,
    MFLR	= 228,
    MFLR8	= 229,
    MFOCRF	= 230,
    MFVRSAVE	= 231,
    MFVSCR	= 232,
    MTCRF	= 233,
    MTCTR	= 234,
    MTCTR8	= 235,
    MTFSB0	= 236,
    MTFSB1	= 237,
    MTFSF	= 238,
    MTLR	= 239,
    MTLR8	= 240,
    MTVRSAVE	= 241,
    MTVSCR	= 242,
    MULHD	= 243,
    MULHDU	= 244,
    MULHW	= 245,
    MULHWU	= 246,
    MULLD	= 247,
    MULLI	= 248,
    MULLW	= 249,
    MovePCtoLR	= 250,
    MovePCtoLR8	= 251,
    NAND	= 252,
    NAND8	= 253,
    NEG	= 254,
    NEG8	= 255,
    NOP	= 256,
    NOR	= 257,
    NOR8	= 258,
    OR	= 259,
    OR4To8	= 260,
    OR8	= 261,
    OR8To4	= 262,
    ORC	= 263,
    ORC8	= 264,
    ORI	= 265,
    ORI8	= 266,
    ORIS	= 267,
    ORIS8	= 268,
    RLDCL	= 269,
    RLDICL	= 270,
    RLDICR	= 271,
    RLDIMI	= 272,
    RLWIMI	= 273,
    RLWINM	= 274,
    RLWINMo	= 275,
    RLWNM	= 276,
    SELECT_CC_F4	= 277,
    SELECT_CC_F8	= 278,
    SELECT_CC_I4	= 279,
    SELECT_CC_I8	= 280,
    SELECT_CC_VRRC	= 281,
    SLD	= 282,
    SLW	= 283,
    SPILL_CR	= 284,
    SRAD	= 285,
    SRADI	= 286,
    SRAW	= 287,
    SRAWI	= 288,
    SRD	= 289,
    SRW	= 290,
    STB	= 291,
    STB8	= 292,
    STBU	= 293,
    STBU8	= 294,
    STBX	= 295,
    STBX8	= 296,
    STD	= 297,
    STDCX	= 298,
    STDU	= 299,
    STDUX	= 300,
    STDX	= 301,
    STDX_32	= 302,
    STD_32	= 303,
    STFD	= 304,
    STFDU	= 305,
    STFDX	= 306,
    STFIWX	= 307,
    STFS	= 308,
    STFSU	= 309,
    STFSX	= 310,
    STH	= 311,
    STH8	= 312,
    STHBRX	= 313,
    STHU	= 314,
    STHU8	= 315,
    STHX	= 316,
    STHX8	= 317,
    STVEBX	= 318,
    STVEHX	= 319,
    STVEWX	= 320,
    STVX	= 321,
    STVXL	= 322,
    STW	= 323,
    STW8	= 324,
    STWBRX	= 325,
    STWCX	= 326,
    STWU	= 327,
    STWUX	= 328,
    STWX	= 329,
    STWX8	= 330,
    SUBF	= 331,
    SUBF8	= 332,
    SUBFC	= 333,
    SUBFC8	= 334,
    SUBFE	= 335,
    SUBFE8	= 336,
    SUBFIC	= 337,
    SUBFIC8	= 338,
    SUBFME	= 339,
    SUBFME8	= 340,
    SUBFZE	= 341,
    SUBFZE8	= 342,
    SYNC	= 343,
    TAILB	= 344,
    TAILB8	= 345,
    TAILBA	= 346,
    TAILBA8	= 347,
    TAILBCTR	= 348,
    TAILBCTR8	= 349,
    TCRETURNai	= 350,
    TCRETURNai8	= 351,
    TCRETURNdi	= 352,
    TCRETURNdi8	= 353,
    TCRETURNri	= 354,
    TCRETURNri8	= 355,
    TRAP	= 356,
    UPDATE_VRSAVE	= 357,
    VADDCUW	= 358,
    VADDFP	= 359,
    VADDSBS	= 360,
    VADDSHS	= 361,
    VADDSWS	= 362,
    VADDUBM	= 363,
    VADDUBS	= 364,
    VADDUHM	= 365,
    VADDUHS	= 366,
    VADDUWM	= 367,
    VADDUWS	= 368,
    VAND	= 369,
    VANDC	= 370,
    VAVGSB	= 371,
    VAVGSH	= 372,
    VAVGSW	= 373,
    VAVGUB	= 374,
    VAVGUH	= 375,
    VAVGUW	= 376,
    VCFSX	= 377,
    VCFUX	= 378,
    VCMPBFP	= 379,
    VCMPBFPo	= 380,
    VCMPEQFP	= 381,
    VCMPEQFPo	= 382,
    VCMPEQUB	= 383,
    VCMPEQUBo	= 384,
    VCMPEQUH	= 385,
    VCMPEQUHo	= 386,
    VCMPEQUW	= 387,
    VCMPEQUWo	= 388,
    VCMPGEFP	= 389,
    VCMPGEFPo	= 390,
    VCMPGTFP	= 391,
    VCMPGTFPo	= 392,
    VCMPGTSB	= 393,
    VCMPGTSBo	= 394,
    VCMPGTSH	= 395,
    VCMPGTSHo	= 396,
    VCMPGTSW	= 397,
    VCMPGTSWo	= 398,
    VCMPGTUB	= 399,
    VCMPGTUBo	= 400,
    VCMPGTUH	= 401,
    VCMPGTUHo	= 402,
    VCMPGTUW	= 403,
    VCMPGTUWo	= 404,
    VCTSXS	= 405,
    VCTUXS	= 406,
    VEXPTEFP	= 407,
    VLOGEFP	= 408,
    VMADDFP	= 409,
    VMAXFP	= 410,
    VMAXSB	= 411,
    VMAXSH	= 412,
    VMAXSW	= 413,
    VMAXUB	= 414,
    VMAXUH	= 415,
    VMAXUW	= 416,
    VMHADDSHS	= 417,
    VMHRADDSHS	= 418,
    VMINFP	= 419,
    VMINSB	= 420,
    VMINSH	= 421,
    VMINSW	= 422,
    VMINUB	= 423,
    VMINUH	= 424,
    VMINUW	= 425,
    VMLADDUHM	= 426,
    VMRGHB	= 427,
    VMRGHH	= 428,
    VMRGHW	= 429,
    VMRGLB	= 430,
    VMRGLH	= 431,
    VMRGLW	= 432,
    VMSUMMBM	= 433,
    VMSUMSHM	= 434,
    VMSUMSHS	= 435,
    VMSUMUBM	= 436,
    VMSUMUHM	= 437,
    VMSUMUHS	= 438,
    VMULESB	= 439,
    VMULESH	= 440,
    VMULEUB	= 441,
    VMULEUH	= 442,
    VMULOSB	= 443,
    VMULOSH	= 444,
    VMULOUB	= 445,
    VMULOUH	= 446,
    VNMSUBFP	= 447,
    VNOR	= 448,
    VOR	= 449,
    VPERM	= 450,
    VPKPX	= 451,
    VPKSHSS	= 452,
    VPKSHUS	= 453,
    VPKSWSS	= 454,
    VPKSWUS	= 455,
    VPKUHUM	= 456,
    VPKUHUS	= 457,
    VPKUWUM	= 458,
    VPKUWUS	= 459,
    VREFP	= 460,
    VRFIM	= 461,
    VRFIN	= 462,
    VRFIP	= 463,
    VRFIZ	= 464,
    VRLB	= 465,
    VRLH	= 466,
    VRLW	= 467,
    VRSQRTEFP	= 468,
    VSEL	= 469,
    VSL	= 470,
    VSLB	= 471,
    VSLDOI	= 472,
    VSLH	= 473,
    VSLO	= 474,
    VSLW	= 475,
    VSPLTB	= 476,
    VSPLTH	= 477,
    VSPLTISB	= 478,
    VSPLTISH	= 479,
    VSPLTISW	= 480,
    VSPLTW	= 481,
    VSR	= 482,
    VSRAB	= 483,
    VSRAH	= 484,
    VSRAW	= 485,
    VSRB	= 486,
    VSRH	= 487,
    VSRO	= 488,
    VSRW	= 489,
    VSUBCUW	= 490,
    VSUBFP	= 491,
    VSUBSBS	= 492,
    VSUBSHS	= 493,
    VSUBSWS	= 494,
    VSUBUBM	= 495,
    VSUBUBS	= 496,
    VSUBUHM	= 497,
    VSUBUHS	= 498,
    VSUBUWM	= 499,
    VSUBUWS	= 500,
    VSUM2SWS	= 501,
    VSUM4SBS	= 502,
    VSUM4SHS	= 503,
    VSUM4UBS	= 504,
    VSUMSWS	= 505,
    VUPKHPX	= 506,
    VUPKHSB	= 507,
    VUPKHSH	= 508,
    VUPKLPX	= 509,
    VUPKLSB	= 510,
    VUPKLSH	= 511,
    VXOR	= 512,
    V_SET0	= 513,
    XOR	= 514,
    XOR8	= 515,
    XORI	= 516,
    XORI8	= 517,
    XORIS	= 518,
    XORIS8	= 519,
    INSTRUCTION_LIST_END = 520
  };
}
} // End llvm namespace 
