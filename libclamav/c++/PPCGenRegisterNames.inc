//===- TableGen'erated file -------------------------------------*- C++ -*-===//
//
// Target Register Enum Values
//
// Automatically generated file, do not edit!
//
//===----------------------------------------------------------------------===//

namespace llvm {

namespace PPC {
enum {
  NoRegister,
  CARRY, 	// 1
  CR0, 	// 2
  CR0EQ, 	// 3
  CR0GT, 	// 4
  CR0LT, 	// 5
  CR0UN, 	// 6
  CR1, 	// 7
  CR1EQ, 	// 8
  CR1GT, 	// 9
  CR1LT, 	// 10
  CR1UN, 	// 11
  CR2, 	// 12
  CR2EQ, 	// 13
  CR2GT, 	// 14
  CR2LT, 	// 15
  CR2UN, 	// 16
  CR3, 	// 17
  CR3EQ, 	// 18
  CR3GT, 	// 19
  CR3LT, 	// 20
  CR3UN, 	// 21
  CR4, 	// 22
  CR4EQ, 	// 23
  CR4GT, 	// 24
  CR4LT, 	// 25
  CR4UN, 	// 26
  CR5, 	// 27
  CR5EQ, 	// 28
  CR5GT, 	// 29
  CR5LT, 	// 30
  CR5UN, 	// 31
  CR6, 	// 32
  CR6EQ, 	// 33
  CR6GT, 	// 34
  CR6LT, 	// 35
  CR6UN, 	// 36
  CR7, 	// 37
  CR7EQ, 	// 38
  CR7GT, 	// 39
  CR7LT, 	// 40
  CR7UN, 	// 41
  CTR, 	// 42
  CTR8, 	// 43
  F0, 	// 44
  F1, 	// 45
  F2, 	// 46
  F3, 	// 47
  F4, 	// 48
  F5, 	// 49
  F6, 	// 50
  F7, 	// 51
  F8, 	// 52
  F9, 	// 53
  F10, 	// 54
  F11, 	// 55
  F12, 	// 56
  F13, 	// 57
  F14, 	// 58
  F15, 	// 59
  F16, 	// 60
  F17, 	// 61
  F18, 	// 62
  F19, 	// 63
  F20, 	// 64
  F21, 	// 65
  F22, 	// 66
  F23, 	// 67
  F24, 	// 68
  F25, 	// 69
  F26, 	// 70
  F27, 	// 71
  F28, 	// 72
  F29, 	// 73
  F30, 	// 74
  F31, 	// 75
  LR, 	// 76
  LR8, 	// 77
  R0, 	// 78
  R1, 	// 79
  R2, 	// 80
  R3, 	// 81
  R4, 	// 82
  R5, 	// 83
  R6, 	// 84
  R7, 	// 85
  R8, 	// 86
  R9, 	// 87
  R10, 	// 88
  R11, 	// 89
  R12, 	// 90
  R13, 	// 91
  R14, 	// 92
  R15, 	// 93
  R16, 	// 94
  R17, 	// 95
  R18, 	// 96
  R19, 	// 97
  R20, 	// 98
  R21, 	// 99
  R22, 	// 100
  R23, 	// 101
  R24, 	// 102
  R25, 	// 103
  R26, 	// 104
  R27, 	// 105
  R28, 	// 106
  R29, 	// 107
  R30, 	// 108
  R31, 	// 109
  RM, 	// 110
  V0, 	// 111
  V1, 	// 112
  V2, 	// 113
  V3, 	// 114
  V4, 	// 115
  V5, 	// 116
  V6, 	// 117
  V7, 	// 118
  V8, 	// 119
  V9, 	// 120
  V10, 	// 121
  V11, 	// 122
  V12, 	// 123
  V13, 	// 124
  V14, 	// 125
  V15, 	// 126
  V16, 	// 127
  V17, 	// 128
  V18, 	// 129
  V19, 	// 130
  V20, 	// 131
  V21, 	// 132
  V22, 	// 133
  V23, 	// 134
  V24, 	// 135
  V25, 	// 136
  V26, 	// 137
  V27, 	// 138
  V28, 	// 139
  V29, 	// 140
  V30, 	// 141
  V31, 	// 142
  VRSAVE, 	// 143
  X0, 	// 144
  X1, 	// 145
  X2, 	// 146
  X3, 	// 147
  X4, 	// 148
  X5, 	// 149
  X6, 	// 150
  X7, 	// 151
  X8, 	// 152
  X9, 	// 153
  X10, 	// 154
  X11, 	// 155
  X12, 	// 156
  X13, 	// 157
  X14, 	// 158
  X15, 	// 159
  X16, 	// 160
  X17, 	// 161
  X18, 	// 162
  X19, 	// 163
  X20, 	// 164
  X21, 	// 165
  X22, 	// 166
  X23, 	// 167
  X24, 	// 168
  X25, 	// 169
  X26, 	// 170
  X27, 	// 171
  X28, 	// 172
  X29, 	// 173
  X30, 	// 174
  X31, 	// 175
  NUM_TARGET_REGS 	// 176
};
}

// Subregister indices
namespace PPC {
enum {
  NoSubRegister,
  sub_32,	// 1
  sub_eq,	// 2
  sub_gt,	// 3
  sub_lt,	// 4
  sub_un,	// 5
  NUM_TARGET_SUBREGS = 6
};
}
} // End llvm namespace 
