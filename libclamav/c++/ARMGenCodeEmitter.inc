//===- TableGen'erated file -------------------------------------*- C++ -*-===//
//
// Machine Code Emitter
//
// Automatically generated file, do not edit!
//
//===----------------------------------------------------------------------===//

unsigned ARMCodeEmitter::getBinaryCodeForInstr(const MachineInstr &MI) {
  static const unsigned InstBits[] = {
    0U,
    0U,
    0U,
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    48912U,	// tYIELD
    0U
  };
  const unsigned opcode = MI.getOpcode();
  unsigned Value = InstBits[opcode];
  unsigned op = 0;
  op = op;  // suppress warning
  switch (opcode) {
    case ARM::ADCSSri:
    case ARM::ADCSSrr:
    case ARM::ADCSSrs:
    case ARM::ADCri:
    case ARM::ADCrr:
    case ARM::ADCrs:
    case ARM::ADDSri:
    case ARM::ADDSrr:
    case ARM::ADDSrs:
    case ARM::ADDri:
    case ARM::ADDrr:
    case ARM::ADDrs:
    case ARM::ADJCALLSTACKDOWN:
    case ARM::ADJCALLSTACKUP:
    case ARM::ANDri:
    case ARM::ANDrr:
    case ARM::ANDrs:
    case ARM::ATOMIC_CMP_SWAP_I16:
    case ARM::ATOMIC_CMP_SWAP_I32:
    case ARM::ATOMIC_CMP_SWAP_I8:
    case ARM::ATOMIC_LOAD_ADD_I16:
    case ARM::ATOMIC_LOAD_ADD_I32:
    case ARM::ATOMIC_LOAD_ADD_I8:
    case ARM::ATOMIC_LOAD_AND_I16:
    case ARM::ATOMIC_LOAD_AND_I32:
    case ARM::ATOMIC_LOAD_AND_I8:
    case ARM::ATOMIC_LOAD_NAND_I16:
    case ARM::ATOMIC_LOAD_NAND_I32:
    case ARM::ATOMIC_LOAD_NAND_I8:
    case ARM::ATOMIC_LOAD_OR_I16:
    case ARM::ATOMIC_LOAD_OR_I32:
    case ARM::ATOMIC_LOAD_OR_I8:
    case ARM::ATOMIC_LOAD_SUB_I16:
    case ARM::ATOMIC_LOAD_SUB_I32:
    case ARM::ATOMIC_LOAD_SUB_I8:
    case ARM::ATOMIC_LOAD_XOR_I16:
    case ARM::ATOMIC_LOAD_XOR_I32:
    case ARM::ATOMIC_LOAD_XOR_I8:
    case ARM::ATOMIC_SWAP_I16:
    case ARM::ATOMIC_SWAP_I32:
    case ARM::ATOMIC_SWAP_I8:
    case ARM::B:
    case ARM::BFC:
    case ARM::BFI:
    case ARM::BICri:
    case ARM::BICrr:
    case ARM::BICrs:
    case ARM::BKPT:
    case ARM::BL:
    case ARM::BLX:
    case ARM::BLXr9:
    case ARM::BL_pred:
    case ARM::BLr9:
    case ARM::BLr9_pred:
    case ARM::BMOVPCRX:
    case ARM::BMOVPCRXr9:
    case ARM::BRIND:
    case ARM::BR_JTadd:
    case ARM::BR_JTm:
    case ARM::BR_JTr:
    case ARM::BX:
    case ARM::BXJ:
    case ARM::BX_RET:
    case ARM::BXr9:
    case ARM::Bcc:
    case ARM::CDP:
    case ARM::CDP2:
    case ARM::CLREX:
    case ARM::CLZ:
    case ARM::CMNzri:
    case ARM::CMNzrr:
    case ARM::CMNzrs:
    case ARM::CMPri:
    case ARM::CMPrr:
    case ARM::CMPrs:
    case ARM::CMPzri:
    case ARM::CMPzrr:
    case ARM::CMPzrs:
    case ARM::CONSTPOOL_ENTRY:
    case ARM::CPS:
    case ARM::DBG:
    case ARM::DMBish:
    case ARM::DMBishst:
    case ARM::DMBnsh:
    case ARM::DMBnshst:
    case ARM::DMBosh:
    case ARM::DMBoshst:
    case ARM::DMBst:
    case ARM::DSBish:
    case ARM::DSBishst:
    case ARM::DSBnsh:
    case ARM::DSBnshst:
    case ARM::DSBosh:
    case ARM::DSBoshst:
    case ARM::DSBst:
    case ARM::EORri:
    case ARM::EORrr:
    case ARM::EORrs:
    case ARM::FCONSTD:
    case ARM::FCONSTS:
    case ARM::FMSTAT:
    case ARM::ISBsy:
    case ARM::Int_MemBarrierV6:
    case ARM::Int_MemBarrierV7:
    case ARM::Int_SyncBarrierV6:
    case ARM::Int_SyncBarrierV7:
    case ARM::Int_eh_sjlj_setjmp:
    case ARM::LDC2L_OFFSET:
    case ARM::LDC2L_OPTION:
    case ARM::LDC2L_POST:
    case ARM::LDC2L_PRE:
    case ARM::LDC2_OFFSET:
    case ARM::LDC2_OPTION:
    case ARM::LDC2_POST:
    case ARM::LDC2_PRE:
    case ARM::LDCL_OFFSET:
    case ARM::LDCL_OPTION:
    case ARM::LDCL_POST:
    case ARM::LDCL_PRE:
    case ARM::LDC_OFFSET:
    case ARM::LDC_OPTION:
    case ARM::LDC_POST:
    case ARM::LDC_PRE:
    case ARM::LDM:
    case ARM::LDM_RET:
    case ARM::LDR:
    case ARM::LDRB:
    case ARM::LDRBT:
    case ARM::LDRB_POST:
    case ARM::LDRB_PRE:
    case ARM::LDRD:
    case ARM::LDRD_POST:
    case ARM::LDRD_PRE:
    case ARM::LDREX:
    case ARM::LDREXB:
    case ARM::LDREXD:
    case ARM::LDREXH:
    case ARM::LDRH:
    case ARM::LDRHT:
    case ARM::LDRH_POST:
    case ARM::LDRH_PRE:
    case ARM::LDRSB:
    case ARM::LDRSBT:
    case ARM::LDRSB_POST:
    case ARM::LDRSB_PRE:
    case ARM::LDRSH:
    case ARM::LDRSHT:
    case ARM::LDRSH_POST:
    case ARM::LDRSH_PRE:
    case ARM::LDRT:
    case ARM::LDR_POST:
    case ARM::LDR_PRE:
    case ARM::LDRcp:
    case ARM::LEApcrel:
    case ARM::LEApcrelJT:
    case ARM::MCR:
    case ARM::MCR2:
    case ARM::MCRR:
    case ARM::MCRR2:
    case ARM::MLA:
    case ARM::MLS:
    case ARM::MOVCCi:
    case ARM::MOVCCr:
    case ARM::MOVCCs:
    case ARM::MOVPCLR:
    case ARM::MOVPCRX:
    case ARM::MOVTi16:
    case ARM::MOVi:
    case ARM::MOVi16:
    case ARM::MOVi2pieces:
    case ARM::MOVi32imm:
    case ARM::MOVr:
    case ARM::MOVrx:
    case ARM::MOVs:
    case ARM::MOVsra_flag:
    case ARM::MOVsrl_flag:
    case ARM::MRC:
    case ARM::MRC2:
    case ARM::MRRC:
    case ARM::MRRC2:
    case ARM::MRS:
    case ARM::MRSsys:
    case ARM::MSR:
    case ARM::MSRi:
    case ARM::MSRsys:
    case ARM::MSRsysi:
    case ARM::MUL:
    case ARM::MVNi:
    case ARM::MVNr:
    case ARM::MVNs:
    case ARM::NOP:
    case ARM::ORRri:
    case ARM::ORRrr:
    case ARM::ORRrs:
    case ARM::PICADD:
    case ARM::PICLDR:
    case ARM::PICLDRB:
    case ARM::PICLDRH:
    case ARM::PICLDRSB:
    case ARM::PICLDRSH:
    case ARM::PICSTR:
    case ARM::PICSTRB:
    case ARM::PICSTRH:
    case ARM::PKHBT:
    case ARM::PKHTB:
    case ARM::PLDWi:
    case ARM::PLDWr:
    case ARM::PLDi:
    case ARM::PLDr:
    case ARM::PLIi:
    case ARM::PLIr:
    case ARM::QADD:
    case ARM::QADD16:
    case ARM::QADD8:
    case ARM::QASX:
    case ARM::QDADD:
    case ARM::QDSUB:
    case ARM::QSAX:
    case ARM::QSUB:
    case ARM::QSUB16:
    case ARM::QSUB8:
    case ARM::RBIT:
    case ARM::REV:
    case ARM::REV16:
    case ARM::REVSH:
    case ARM::RFE:
    case ARM::RFEW:
    case ARM::RSBSri:
    case ARM::RSBSrs:
    case ARM::RSBri:
    case ARM::RSBrs:
    case ARM::RSCSri:
    case ARM::RSCSrs:
    case ARM::RSCri:
    case ARM::RSCrs:
    case ARM::SADD16:
    case ARM::SADD8:
    case ARM::SASX:
    case ARM::SBCSSri:
    case ARM::SBCSSrr:
    case ARM::SBCSSrs:
    case ARM::SBCri:
    case ARM::SBCrr:
    case ARM::SBCrs:
    case ARM::SBFX:
    case ARM::SEL:
    case ARM::SETENDBE:
    case ARM::SETENDLE:
    case ARM::SEV:
    case ARM::SHADD16:
    case ARM::SHADD8:
    case ARM::SHASX:
    case ARM::SHSAX:
    case ARM::SHSUB16:
    case ARM::SHSUB8:
    case ARM::SMC:
    case ARM::SMLABB:
    case ARM::SMLABT:
    case ARM::SMLAD:
    case ARM::SMLADX:
    case ARM::SMLAL:
    case ARM::SMLALBB:
    case ARM::SMLALBT:
    case ARM::SMLALD:
    case ARM::SMLALDX:
    case ARM::SMLALTB:
    case ARM::SMLALTT:
    case ARM::SMLATB:
    case ARM::SMLATT:
    case ARM::SMLAWB:
    case ARM::SMLAWT:
    case ARM::SMLSD:
    case ARM::SMLSDX:
    case ARM::SMLSLD:
    case ARM::SMLSLDX:
    case ARM::SMMLA:
    case ARM::SMMLAR:
    case ARM::SMMLS:
    case ARM::SMMLSR:
    case ARM::SMMUL:
    case ARM::SMMULR:
    case ARM::SMUAD:
    case ARM::SMUADX:
    case ARM::SMULBB:
    case ARM::SMULBT:
    case ARM::SMULL:
    case ARM::SMULTB:
    case ARM::SMULTT:
    case ARM::SMULWB:
    case ARM::SMULWT:
    case ARM::SMUSD:
    case ARM::SMUSDX:
    case ARM::SRS:
    case ARM::SRSW:
    case ARM::SSAT16:
    case ARM::SSATasr:
    case ARM::SSATlsl:
    case ARM::SSAX:
    case ARM::SSUB16:
    case ARM::SSUB8:
    case ARM::STC2L_OFFSET:
    case ARM::STC2L_OPTION:
    case ARM::STC2L_POST:
    case ARM::STC2L_PRE:
    case ARM::STC2_OFFSET:
    case ARM::STC2_OPTION:
    case ARM::STC2_POST:
    case ARM::STC2_PRE:
    case ARM::STCL_OFFSET:
    case ARM::STCL_OPTION:
    case ARM::STCL_POST:
    case ARM::STCL_PRE:
    case ARM::STC_OFFSET:
    case ARM::STC_OPTION:
    case ARM::STC_POST:
    case ARM::STC_PRE:
    case ARM::STM:
    case ARM::STR:
    case ARM::STRB:
    case ARM::STRBT:
    case ARM::STRB_POST:
    case ARM::STRB_PRE:
    case ARM::STRD:
    case ARM::STRD_POST:
    case ARM::STRD_PRE:
    case ARM::STREX:
    case ARM::STREXB:
    case ARM::STREXD:
    case ARM::STREXH:
    case ARM::STRH:
    case ARM::STRHT:
    case ARM::STRH_POST:
    case ARM::STRH_PRE:
    case ARM::STRT:
    case ARM::STR_POST:
    case ARM::STR_PRE:
    case ARM::SUBSri:
    case ARM::SUBSrr:
    case ARM::SUBSrs:
    case ARM::SUBri:
    case ARM::SUBrr:
    case ARM::SUBrs:
    case ARM::SVC:
    case ARM::SWP:
    case ARM::SWPB:
    case ARM::SXTAB16rr:
    case ARM::SXTAB16rr_rot:
    case ARM::SXTABrr:
    case ARM::SXTABrr_rot:
    case ARM::SXTAHrr:
    case ARM::SXTAHrr_rot:
    case ARM::SXTB16r:
    case ARM::SXTB16r_rot:
    case ARM::SXTBr:
    case ARM::SXTBr_rot:
    case ARM::SXTHr:
    case ARM::SXTHr_rot:
    case ARM::TEQri:
    case ARM::TEQrr:
    case ARM::TEQrs:
    case ARM::TPsoft:
    case ARM::TRAP:
    case ARM::TSTri:
    case ARM::TSTrr:
    case ARM::TSTrs:
    case ARM::UADD16:
    case ARM::UADD8:
    case ARM::UASX:
    case ARM::UBFX:
    case ARM::UHADD16:
    case ARM::UHADD8:
    case ARM::UHASX:
    case ARM::UHSAX:
    case ARM::UHSUB16:
    case ARM::UHSUB8:
    case ARM::UMAAL:
    case ARM::UMLAL:
    case ARM::UMULL:
    case ARM::UQADD16:
    case ARM::UQADD8:
    case ARM::UQASX:
    case ARM::UQSAX:
    case ARM::UQSUB16:
    case ARM::UQSUB8:
    case ARM::USAD8:
    case ARM::USADA8:
    case ARM::USAT16:
    case ARM::USATasr:
    case ARM::USATlsl:
    case ARM::USAX:
    case ARM::USUB16:
    case ARM::USUB8:
    case ARM::UXTAB16rr:
    case ARM::UXTAB16rr_rot:
    case ARM::UXTABrr:
    case ARM::UXTABrr_rot:
    case ARM::UXTAHrr:
    case ARM::UXTAHrr_rot:
    case ARM::UXTB16r:
    case ARM::UXTB16r_rot:
    case ARM::UXTBr:
    case ARM::UXTBr_rot:
    case ARM::UXTHr:
    case ARM::UXTHr_rot:
    case ARM::VABALsv2i64:
    case ARM::VABALsv4i32:
    case ARM::VABALsv8i16:
    case ARM::VABALuv2i64:
    case ARM::VABALuv4i32:
    case ARM::VABALuv8i16:
    case ARM::VABAsv16i8:
    case ARM::VABAsv2i32:
    case ARM::VABAsv4i16:
    case ARM::VABAsv4i32:
    case ARM::VABAsv8i16:
    case ARM::VABAsv8i8:
    case ARM::VABAuv16i8:
    case ARM::VABAuv2i32:
    case ARM::VABAuv4i16:
    case ARM::VABAuv4i32:
    case ARM::VABAuv8i16:
    case ARM::VABAuv8i8:
    case ARM::VABDLsv2i64:
    case ARM::VABDLsv4i32:
    case ARM::VABDLsv8i16:
    case ARM::VABDLuv2i64:
    case ARM::VABDLuv4i32:
    case ARM::VABDLuv8i16:
    case ARM::VABDfd:
    case ARM::VABDfq:
    case ARM::VABDsv16i8:
    case ARM::VABDsv2i32:
    case ARM::VABDsv4i16:
    case ARM::VABDsv4i32:
    case ARM::VABDsv8i16:
    case ARM::VABDsv8i8:
    case ARM::VABDuv16i8:
    case ARM::VABDuv2i32:
    case ARM::VABDuv4i16:
    case ARM::VABDuv4i32:
    case ARM::VABDuv8i16:
    case ARM::VABDuv8i8:
    case ARM::VABSD:
    case ARM::VABSS:
    case ARM::VABSfd:
    case ARM::VABSfd_sfp:
    case ARM::VABSfq:
    case ARM::VABSv16i8:
    case ARM::VABSv2i32:
    case ARM::VABSv4i16:
    case ARM::VABSv4i32:
    case ARM::VABSv8i16:
    case ARM::VABSv8i8:
    case ARM::VACGEd:
    case ARM::VACGEq:
    case ARM::VACGTd:
    case ARM::VACGTq:
    case ARM::VADDD:
    case ARM::VADDHNv2i32:
    case ARM::VADDHNv4i16:
    case ARM::VADDHNv8i8:
    case ARM::VADDLsv2i64:
    case ARM::VADDLsv4i32:
    case ARM::VADDLsv8i16:
    case ARM::VADDLuv2i64:
    case ARM::VADDLuv4i32:
    case ARM::VADDLuv8i16:
    case ARM::VADDS:
    case ARM::VADDWsv2i64:
    case ARM::VADDWsv4i32:
    case ARM::VADDWsv8i16:
    case ARM::VADDWuv2i64:
    case ARM::VADDWuv4i32:
    case ARM::VADDWuv8i16:
    case ARM::VADDfd:
    case ARM::VADDfd_sfp:
    case ARM::VADDfq:
    case ARM::VADDv16i8:
    case ARM::VADDv1i64:
    case ARM::VADDv2i32:
    case ARM::VADDv2i64:
    case ARM::VADDv4i16:
    case ARM::VADDv4i32:
    case ARM::VADDv8i16:
    case ARM::VADDv8i8:
    case ARM::VANDd:
    case ARM::VANDq:
    case ARM::VBICd:
    case ARM::VBICq:
    case ARM::VBIFd:
    case ARM::VBIFq:
    case ARM::VBITd:
    case ARM::VBITq:
    case ARM::VBSLd:
    case ARM::VBSLq:
    case ARM::VCEQfd:
    case ARM::VCEQfq:
    case ARM::VCEQv16i8:
    case ARM::VCEQv2i32:
    case ARM::VCEQv4i16:
    case ARM::VCEQv4i32:
    case ARM::VCEQv8i16:
    case ARM::VCEQv8i8:
    case ARM::VCEQzv16i8:
    case ARM::VCEQzv2f32:
    case ARM::VCEQzv2i32:
    case ARM::VCEQzv4f32:
    case ARM::VCEQzv4i16:
    case ARM::VCEQzv4i32:
    case ARM::VCEQzv8i16:
    case ARM::VCEQzv8i8:
    case ARM::VCGEfd:
    case ARM::VCGEfq:
    case ARM::VCGEsv16i8:
    case ARM::VCGEsv2i32:
    case ARM::VCGEsv4i16:
    case ARM::VCGEsv4i32:
    case ARM::VCGEsv8i16:
    case ARM::VCGEsv8i8:
    case ARM::VCGEuv16i8:
    case ARM::VCGEuv2i32:
    case ARM::VCGEuv4i16:
    case ARM::VCGEuv4i32:
    case ARM::VCGEuv8i16:
    case ARM::VCGEuv8i8:
    case ARM::VCGEzv16i8:
    case ARM::VCGEzv2f32:
    case ARM::VCGEzv2i32:
    case ARM::VCGEzv4f32:
    case ARM::VCGEzv4i16:
    case ARM::VCGEzv4i32:
    case ARM::VCGEzv8i16:
    case ARM::VCGEzv8i8:
    case ARM::VCGTfd:
    case ARM::VCGTfq:
    case ARM::VCGTsv16i8:
    case ARM::VCGTsv2i32:
    case ARM::VCGTsv4i16:
    case ARM::VCGTsv4i32:
    case ARM::VCGTsv8i16:
    case ARM::VCGTsv8i8:
    case ARM::VCGTuv16i8:
    case ARM::VCGTuv2i32:
    case ARM::VCGTuv4i16:
    case ARM::VCGTuv4i32:
    case ARM::VCGTuv8i16:
    case ARM::VCGTuv8i8:
    case ARM::VCGTzv16i8:
    case ARM::VCGTzv2f32:
    case ARM::VCGTzv2i32:
    case ARM::VCGTzv4f32:
    case ARM::VCGTzv4i16:
    case ARM::VCGTzv4i32:
    case ARM::VCGTzv8i16:
    case ARM::VCGTzv8i8:
    case ARM::VCLEzv16i8:
    case ARM::VCLEzv2f32:
    case ARM::VCLEzv2i32:
    case ARM::VCLEzv4f32:
    case ARM::VCLEzv4i16:
    case ARM::VCLEzv4i32:
    case ARM::VCLEzv8i16:
    case ARM::VCLEzv8i8:
    case ARM::VCLSv16i8:
    case ARM::VCLSv2i32:
    case ARM::VCLSv4i16:
    case ARM::VCLSv4i32:
    case ARM::VCLSv8i16:
    case ARM::VCLSv8i8:
    case ARM::VCLTzv16i8:
    case ARM::VCLTzv2f32:
    case ARM::VCLTzv2i32:
    case ARM::VCLTzv4f32:
    case ARM::VCLTzv4i16:
    case ARM::VCLTzv4i32:
    case ARM::VCLTzv8i16:
    case ARM::VCLTzv8i8:
    case ARM::VCLZv16i8:
    case ARM::VCLZv2i32:
    case ARM::VCLZv4i16:
    case ARM::VCLZv4i32:
    case ARM::VCLZv8i16:
    case ARM::VCLZv8i8:
    case ARM::VCMPD:
    case ARM::VCMPED:
    case ARM::VCMPES:
    case ARM::VCMPEZD:
    case ARM::VCMPEZS:
    case ARM::VCMPS:
    case ARM::VCMPZD:
    case ARM::VCMPZS:
    case ARM::VCNTd:
    case ARM::VCNTq:
    case ARM::VCVTBHS:
    case ARM::VCVTBSH:
    case ARM::VCVTDS:
    case ARM::VCVTSD:
    case ARM::VCVTTHS:
    case ARM::VCVTTSH:
    case ARM::VCVTf2sd:
    case ARM::VCVTf2sd_sfp:
    case ARM::VCVTf2sq:
    case ARM::VCVTf2ud:
    case ARM::VCVTf2ud_sfp:
    case ARM::VCVTf2uq:
    case ARM::VCVTf2xsd:
    case ARM::VCVTf2xsq:
    case ARM::VCVTf2xud:
    case ARM::VCVTf2xuq:
    case ARM::VCVTs2fd:
    case ARM::VCVTs2fd_sfp:
    case ARM::VCVTs2fq:
    case ARM::VCVTu2fd:
    case ARM::VCVTu2fd_sfp:
    case ARM::VCVTu2fq:
    case ARM::VCVTxs2fd:
    case ARM::VCVTxs2fq:
    case ARM::VCVTxu2fd:
    case ARM::VCVTxu2fq:
    case ARM::VDIVD:
    case ARM::VDIVS:
    case ARM::VDUP16d:
    case ARM::VDUP16q:
    case ARM::VDUP32d:
    case ARM::VDUP32q:
    case ARM::VDUP8d:
    case ARM::VDUP8q:
    case ARM::VDUPLN16d:
    case ARM::VDUPLN16q:
    case ARM::VDUPLN32d:
    case ARM::VDUPLN32q:
    case ARM::VDUPLN8d:
    case ARM::VDUPLN8q:
    case ARM::VDUPLNfd:
    case ARM::VDUPLNfq:
    case ARM::VDUPfd:
    case ARM::VDUPfdf:
    case ARM::VDUPfq:
    case ARM::VDUPfqf:
    case ARM::VEORd:
    case ARM::VEORq:
    case ARM::VEXTd16:
    case ARM::VEXTd32:
    case ARM::VEXTd8:
    case ARM::VEXTdf:
    case ARM::VEXTq16:
    case ARM::VEXTq32:
    case ARM::VEXTq8:
    case ARM::VEXTqf:
    case ARM::VGETLNi32:
    case ARM::VGETLNs16:
    case ARM::VGETLNs8:
    case ARM::VGETLNu16:
    case ARM::VGETLNu8:
    case ARM::VHADDsv16i8:
    case ARM::VHADDsv2i32:
    case ARM::VHADDsv4i16:
    case ARM::VHADDsv4i32:
    case ARM::VHADDsv8i16:
    case ARM::VHADDsv8i8:
    case ARM::VHADDuv16i8:
    case ARM::VHADDuv2i32:
    case ARM::VHADDuv4i16:
    case ARM::VHADDuv4i32:
    case ARM::VHADDuv8i16:
    case ARM::VHADDuv8i8:
    case ARM::VHSUBsv16i8:
    case ARM::VHSUBsv2i32:
    case ARM::VHSUBsv4i16:
    case ARM::VHSUBsv4i32:
    case ARM::VHSUBsv8i16:
    case ARM::VHSUBsv8i8:
    case ARM::VHSUBuv16i8:
    case ARM::VHSUBuv2i32:
    case ARM::VHSUBuv4i16:
    case ARM::VHSUBuv4i32:
    case ARM::VHSUBuv8i16:
    case ARM::VHSUBuv8i8:
    case ARM::VLD1d16:
    case ARM::VLD1d16Q:
    case ARM::VLD1d16T:
    case ARM::VLD1d32:
    case ARM::VLD1d32Q:
    case ARM::VLD1d32T:
    case ARM::VLD1d64:
    case ARM::VLD1d8:
    case ARM::VLD1d8Q:
    case ARM::VLD1d8T:
    case ARM::VLD1df:
    case ARM::VLD1q16:
    case ARM::VLD1q32:
    case ARM::VLD1q64:
    case ARM::VLD1q8:
    case ARM::VLD1qf:
    case ARM::VLD2LNd16:
    case ARM::VLD2LNd32:
    case ARM::VLD2LNd8:
    case ARM::VLD2LNq16a:
    case ARM::VLD2LNq16b:
    case ARM::VLD2LNq32a:
    case ARM::VLD2LNq32b:
    case ARM::VLD2d16:
    case ARM::VLD2d16D:
    case ARM::VLD2d32:
    case ARM::VLD2d32D:
    case ARM::VLD2d64:
    case ARM::VLD2d8:
    case ARM::VLD2d8D:
    case ARM::VLD2q16:
    case ARM::VLD2q32:
    case ARM::VLD2q8:
    case ARM::VLD3LNd16:
    case ARM::VLD3LNd32:
    case ARM::VLD3LNd8:
    case ARM::VLD3LNq16a:
    case ARM::VLD3LNq16b:
    case ARM::VLD3LNq32a:
    case ARM::VLD3LNq32b:
    case ARM::VLD3d16:
    case ARM::VLD3d32:
    case ARM::VLD3d64:
    case ARM::VLD3d8:
    case ARM::VLD3q16a:
    case ARM::VLD3q16b:
    case ARM::VLD3q32a:
    case ARM::VLD3q32b:
    case ARM::VLD3q8a:
    case ARM::VLD3q8b:
    case ARM::VLD4LNd16:
    case ARM::VLD4LNd32:
    case ARM::VLD4LNd8:
    case ARM::VLD4LNq16a:
    case ARM::VLD4LNq16b:
    case ARM::VLD4LNq32a:
    case ARM::VLD4LNq32b:
    case ARM::VLD4d16:
    case ARM::VLD4d32:
    case ARM::VLD4d64:
    case ARM::VLD4d8:
    case ARM::VLD4q16a:
    case ARM::VLD4q16b:
    case ARM::VLD4q32a:
    case ARM::VLD4q32b:
    case ARM::VLD4q8a:
    case ARM::VLD4q8b:
    case ARM::VLDMD:
    case ARM::VLDMS:
    case ARM::VLDRD:
    case ARM::VLDRQ:
    case ARM::VLDRS:
    case ARM::VMAXfd:
    case ARM::VMAXfd_sfp:
    case ARM::VMAXfq:
    case ARM::VMAXsv16i8:
    case ARM::VMAXsv2i32:
    case ARM::VMAXsv4i16:
    case ARM::VMAXsv4i32:
    case ARM::VMAXsv8i16:
    case ARM::VMAXsv8i8:
    case ARM::VMAXuv16i8:
    case ARM::VMAXuv2i32:
    case ARM::VMAXuv4i16:
    case ARM::VMAXuv4i32:
    case ARM::VMAXuv8i16:
    case ARM::VMAXuv8i8:
    case ARM::VMINfd:
    case ARM::VMINfd_sfp:
    case ARM::VMINfq:
    case ARM::VMINsv16i8:
    case ARM::VMINsv2i32:
    case ARM::VMINsv4i16:
    case ARM::VMINsv4i32:
    case ARM::VMINsv8i16:
    case ARM::VMINsv8i8:
    case ARM::VMINuv16i8:
    case ARM::VMINuv2i32:
    case ARM::VMINuv4i16:
    case ARM::VMINuv4i32:
    case ARM::VMINuv8i16:
    case ARM::VMINuv8i8:
    case ARM::VMLAD:
    case ARM::VMLALslsv2i32:
    case ARM::VMLALslsv4i16:
    case ARM::VMLALsluv2i32:
    case ARM::VMLALsluv4i16:
    case ARM::VMLALsv2i64:
    case ARM::VMLALsv4i32:
    case ARM::VMLALsv8i16:
    case ARM::VMLALuv2i64:
    case ARM::VMLALuv4i32:
    case ARM::VMLALuv8i16:
    case ARM::VMLAS:
    case ARM::VMLAfd:
    case ARM::VMLAfq:
    case ARM::VMLAslfd:
    case ARM::VMLAslfq:
    case ARM::VMLAslv2i32:
    case ARM::VMLAslv4i16:
    case ARM::VMLAslv4i32:
    case ARM::VMLAslv8i16:
    case ARM::VMLAv16i8:
    case ARM::VMLAv2i32:
    case ARM::VMLAv4i16:
    case ARM::VMLAv4i32:
    case ARM::VMLAv8i16:
    case ARM::VMLAv8i8:
    case ARM::VMLSD:
    case ARM::VMLSLslsv2i32:
    case ARM::VMLSLslsv4i16:
    case ARM::VMLSLsluv2i32:
    case ARM::VMLSLsluv4i16:
    case ARM::VMLSLsv2i64:
    case ARM::VMLSLsv4i32:
    case ARM::VMLSLsv8i16:
    case ARM::VMLSLuv2i64:
    case ARM::VMLSLuv4i32:
    case ARM::VMLSLuv8i16:
    case ARM::VMLSS:
    case ARM::VMLSfd:
    case ARM::VMLSfq:
    case ARM::VMLSslfd:
    case ARM::VMLSslfq:
    case ARM::VMLSslv2i32:
    case ARM::VMLSslv4i16:
    case ARM::VMLSslv4i32:
    case ARM::VMLSslv8i16:
    case ARM::VMLSv16i8:
    case ARM::VMLSv2i32:
    case ARM::VMLSv4i16:
    case ARM::VMLSv4i32:
    case ARM::VMLSv8i16:
    case ARM::VMLSv8i8:
    case ARM::VMOVD:
    case ARM::VMOVDRR:
    case ARM::VMOVDcc:
    case ARM::VMOVDneon:
    case ARM::VMOVLsv2i64:
    case ARM::VMOVLsv4i32:
    case ARM::VMOVLsv8i16:
    case ARM::VMOVLuv2i64:
    case ARM::VMOVLuv4i32:
    case ARM::VMOVLuv8i16:
    case ARM::VMOVNv2i32:
    case ARM::VMOVNv4i16:
    case ARM::VMOVNv8i8:
    case ARM::VMOVQ:
    case ARM::VMOVRRD:
    case ARM::VMOVRRS:
    case ARM::VMOVRS:
    case ARM::VMOVS:
    case ARM::VMOVSR:
    case ARM::VMOVSRR:
    case ARM::VMOVScc:
    case ARM::VMOVv16i8:
    case ARM::VMOVv1i64:
    case ARM::VMOVv2i32:
    case ARM::VMOVv2i64:
    case ARM::VMOVv4i16:
    case ARM::VMOVv4i32:
    case ARM::VMOVv8i16:
    case ARM::VMOVv8i8:
    case ARM::VMRS:
    case ARM::VMSR:
    case ARM::VMULD:
    case ARM::VMULLp:
    case ARM::VMULLslsv2i32:
    case ARM::VMULLslsv4i16:
    case ARM::VMULLsluv2i32:
    case ARM::VMULLsluv4i16:
    case ARM::VMULLsv2i64:
    case ARM::VMULLsv4i32:
    case ARM::VMULLsv8i16:
    case ARM::VMULLuv2i64:
    case ARM::VMULLuv4i32:
    case ARM::VMULLuv8i16:
    case ARM::VMULS:
    case ARM::VMULfd:
    case ARM::VMULfd_sfp:
    case ARM::VMULfq:
    case ARM::VMULpd:
    case ARM::VMULpq:
    case ARM::VMULslfd:
    case ARM::VMULslfq:
    case ARM::VMULslv2i32:
    case ARM::VMULslv4i16:
    case ARM::VMULslv4i32:
    case ARM::VMULslv8i16:
    case ARM::VMULv16i8:
    case ARM::VMULv2i32:
    case ARM::VMULv4i16:
    case ARM::VMULv4i32:
    case ARM::VMULv8i16:
    case ARM::VMULv8i8:
    case ARM::VMVNd:
    case ARM::VMVNq:
    case ARM::VNEGD:
    case ARM::VNEGDcc:
    case ARM::VNEGS:
    case ARM::VNEGScc:
    case ARM::VNEGf32q:
    case ARM::VNEGfd:
    case ARM::VNEGfd_sfp:
    case ARM::VNEGs16d:
    case ARM::VNEGs16q:
    case ARM::VNEGs32d:
    case ARM::VNEGs32q:
    case ARM::VNEGs8d:
    case ARM::VNEGs8q:
    case ARM::VNMLAD:
    case ARM::VNMLAS:
    case ARM::VNMLSD:
    case ARM::VNMLSS:
    case ARM::VNMULD:
    case ARM::VNMULS:
    case ARM::VORNd:
    case ARM::VORNq:
    case ARM::VORRd:
    case ARM::VORRq:
    case ARM::VPADALsv16i8:
    case ARM::VPADALsv2i32:
    case ARM::VPADALsv4i16:
    case ARM::VPADALsv4i32:
    case ARM::VPADALsv8i16:
    case ARM::VPADALsv8i8:
    case ARM::VPADALuv16i8:
    case ARM::VPADALuv2i32:
    case ARM::VPADALuv4i16:
    case ARM::VPADALuv4i32:
    case ARM::VPADALuv8i16:
    case ARM::VPADALuv8i8:
    case ARM::VPADDLsv16i8:
    case ARM::VPADDLsv2i32:
    case ARM::VPADDLsv4i16:
    case ARM::VPADDLsv4i32:
    case ARM::VPADDLsv8i16:
    case ARM::VPADDLsv8i8:
    case ARM::VPADDLuv16i8:
    case ARM::VPADDLuv2i32:
    case ARM::VPADDLuv4i16:
    case ARM::VPADDLuv4i32:
    case ARM::VPADDLuv8i16:
    case ARM::VPADDLuv8i8:
    case ARM::VPADDf:
    case ARM::VPADDi16:
    case ARM::VPADDi32:
    case ARM::VPADDi8:
    case ARM::VPMAXf:
    case ARM::VPMAXs16:
    case ARM::VPMAXs32:
    case ARM::VPMAXs8:
    case ARM::VPMAXu16:
    case ARM::VPMAXu32:
    case ARM::VPMAXu8:
    case ARM::VPMINf:
    case ARM::VPMINs16:
    case ARM::VPMINs32:
    case ARM::VPMINs8:
    case ARM::VPMINu16:
    case ARM::VPMINu32:
    case ARM::VPMINu8:
    case ARM::VQABSv16i8:
    case ARM::VQABSv2i32:
    case ARM::VQABSv4i16:
    case ARM::VQABSv4i32:
    case ARM::VQABSv8i16:
    case ARM::VQABSv8i8:
    case ARM::VQADDsv16i8:
    case ARM::VQADDsv1i64:
    case ARM::VQADDsv2i32:
    case ARM::VQADDsv2i64:
    case ARM::VQADDsv4i16:
    case ARM::VQADDsv4i32:
    case ARM::VQADDsv8i16:
    case ARM::VQADDsv8i8:
    case ARM::VQADDuv16i8:
    case ARM::VQADDuv1i64:
    case ARM::VQADDuv2i32:
    case ARM::VQADDuv2i64:
    case ARM::VQADDuv4i16:
    case ARM::VQADDuv4i32:
    case ARM::VQADDuv8i16:
    case ARM::VQADDuv8i8:
    case ARM::VQDMLALslv2i32:
    case ARM::VQDMLALslv4i16:
    case ARM::VQDMLALv2i64:
    case ARM::VQDMLALv4i32:
    case ARM::VQDMLSLslv2i32:
    case ARM::VQDMLSLslv4i16:
    case ARM::VQDMLSLv2i64:
    case ARM::VQDMLSLv4i32:
    case ARM::VQDMULHslv2i32:
    case ARM::VQDMULHslv4i16:
    case ARM::VQDMULHslv4i32:
    case ARM::VQDMULHslv8i16:
    case ARM::VQDMULHv2i32:
    case ARM::VQDMULHv4i16:
    case ARM::VQDMULHv4i32:
    case ARM::VQDMULHv8i16:
    case ARM::VQDMULLslv2i32:
    case ARM::VQDMULLslv4i16:
    case ARM::VQDMULLv2i64:
    case ARM::VQDMULLv4i32:
    case ARM::VQMOVNsuv2i32:
    case ARM::VQMOVNsuv4i16:
    case ARM::VQMOVNsuv8i8:
    case ARM::VQMOVNsv2i32:
    case ARM::VQMOVNsv4i16:
    case ARM::VQMOVNsv8i8:
    case ARM::VQMOVNuv2i32:
    case ARM::VQMOVNuv4i16:
    case ARM::VQMOVNuv8i8:
    case ARM::VQNEGv16i8:
    case ARM::VQNEGv2i32:
    case ARM::VQNEGv4i16:
    case ARM::VQNEGv4i32:
    case ARM::VQNEGv8i16:
    case ARM::VQNEGv8i8:
    case ARM::VQRDMULHslv2i32:
    case ARM::VQRDMULHslv4i16:
    case ARM::VQRDMULHslv4i32:
    case ARM::VQRDMULHslv8i16:
    case ARM::VQRDMULHv2i32:
    case ARM::VQRDMULHv4i16:
    case ARM::VQRDMULHv4i32:
    case ARM::VQRDMULHv8i16:
    case ARM::VQRSHLsv16i8:
    case ARM::VQRSHLsv1i64:
    case ARM::VQRSHLsv2i32:
    case ARM::VQRSHLsv2i64:
    case ARM::VQRSHLsv4i16:
    case ARM::VQRSHLsv4i32:
    case ARM::VQRSHLsv8i16:
    case ARM::VQRSHLsv8i8:
    case ARM::VQRSHLuv16i8:
    case ARM::VQRSHLuv1i64:
    case ARM::VQRSHLuv2i32:
    case ARM::VQRSHLuv2i64:
    case ARM::VQRSHLuv4i16:
    case ARM::VQRSHLuv4i32:
    case ARM::VQRSHLuv8i16:
    case ARM::VQRSHLuv8i8:
    case ARM::VQRSHRNsv2i32:
    case ARM::VQRSHRNsv4i16:
    case ARM::VQRSHRNsv8i8:
    case ARM::VQRSHRNuv2i32:
    case ARM::VQRSHRNuv4i16:
    case ARM::VQRSHRNuv8i8:
    case ARM::VQRSHRUNv2i32:
    case ARM::VQRSHRUNv4i16:
    case ARM::VQRSHRUNv8i8:
    case ARM::VQSHLsiv16i8:
    case ARM::VQSHLsiv1i64:
    case ARM::VQSHLsiv2i32:
    case ARM::VQSHLsiv2i64:
    case ARM::VQSHLsiv4i16:
    case ARM::VQSHLsiv4i32:
    case ARM::VQSHLsiv8i16:
    case ARM::VQSHLsiv8i8:
    case ARM::VQSHLsuv16i8:
    case ARM::VQSHLsuv1i64:
    case ARM::VQSHLsuv2i32:
    case ARM::VQSHLsuv2i64:
    case ARM::VQSHLsuv4i16:
    case ARM::VQSHLsuv4i32:
    case ARM::VQSHLsuv8i16:
    case ARM::VQSHLsuv8i8:
    case ARM::VQSHLsv16i8:
    case ARM::VQSHLsv1i64:
    case ARM::VQSHLsv2i32:
    case ARM::VQSHLsv2i64:
    case ARM::VQSHLsv4i16:
    case ARM::VQSHLsv4i32:
    case ARM::VQSHLsv8i16:
    case ARM::VQSHLsv8i8:
    case ARM::VQSHLuiv16i8:
    case ARM::VQSHLuiv1i64:
    case ARM::VQSHLuiv2i32:
    case ARM::VQSHLuiv2i64:
    case ARM::VQSHLuiv4i16:
    case ARM::VQSHLuiv4i32:
    case ARM::VQSHLuiv8i16:
    case ARM::VQSHLuiv8i8:
    case ARM::VQSHLuv16i8:
    case ARM::VQSHLuv1i64:
    case ARM::VQSHLuv2i32:
    case ARM::VQSHLuv2i64:
    case ARM::VQSHLuv4i16:
    case ARM::VQSHLuv4i32:
    case ARM::VQSHLuv8i16:
    case ARM::VQSHLuv8i8:
    case ARM::VQSHRNsv2i32:
    case ARM::VQSHRNsv4i16:
    case ARM::VQSHRNsv8i8:
    case ARM::VQSHRNuv2i32:
    case ARM::VQSHRNuv4i16:
    case ARM::VQSHRNuv8i8:
    case ARM::VQSHRUNv2i32:
    case ARM::VQSHRUNv4i16:
    case ARM::VQSHRUNv8i8:
    case ARM::VQSUBsv16i8:
    case ARM::VQSUBsv1i64:
    case ARM::VQSUBsv2i32:
    case ARM::VQSUBsv2i64:
    case ARM::VQSUBsv4i16:
    case ARM::VQSUBsv4i32:
    case ARM::VQSUBsv8i16:
    case ARM::VQSUBsv8i8:
    case ARM::VQSUBuv16i8:
    case ARM::VQSUBuv1i64:
    case ARM::VQSUBuv2i32:
    case ARM::VQSUBuv2i64:
    case ARM::VQSUBuv4i16:
    case ARM::VQSUBuv4i32:
    case ARM::VQSUBuv8i16:
    case ARM::VQSUBuv8i8:
    case ARM::VRADDHNv2i32:
    case ARM::VRADDHNv4i16:
    case ARM::VRADDHNv8i8:
    case ARM::VRECPEd:
    case ARM::VRECPEfd:
    case ARM::VRECPEfq:
    case ARM::VRECPEq:
    case ARM::VRECPSfd:
    case ARM::VRECPSfq:
    case ARM::VREV16d8:
    case ARM::VREV16q8:
    case ARM::VREV32d16:
    case ARM::VREV32d8:
    case ARM::VREV32q16:
    case ARM::VREV32q8:
    case ARM::VREV64d16:
    case ARM::VREV64d32:
    case ARM::VREV64d8:
    case ARM::VREV64df:
    case ARM::VREV64q16:
    case ARM::VREV64q32:
    case ARM::VREV64q8:
    case ARM::VREV64qf:
    case ARM::VRHADDsv16i8:
    case ARM::VRHADDsv2i32:
    case ARM::VRHADDsv4i16:
    case ARM::VRHADDsv4i32:
    case ARM::VRHADDsv8i16:
    case ARM::VRHADDsv8i8:
    case ARM::VRHADDuv16i8:
    case ARM::VRHADDuv2i32:
    case ARM::VRHADDuv4i16:
    case ARM::VRHADDuv4i32:
    case ARM::VRHADDuv8i16:
    case ARM::VRHADDuv8i8:
    case ARM::VRSHLsv16i8:
    case ARM::VRSHLsv1i64:
    case ARM::VRSHLsv2i32:
    case ARM::VRSHLsv2i64:
    case ARM::VRSHLsv4i16:
    case ARM::VRSHLsv4i32:
    case ARM::VRSHLsv8i16:
    case ARM::VRSHLsv8i8:
    case ARM::VRSHLuv16i8:
    case ARM::VRSHLuv1i64:
    case ARM::VRSHLuv2i32:
    case ARM::VRSHLuv2i64:
    case ARM::VRSHLuv4i16:
    case ARM::VRSHLuv4i32:
    case ARM::VRSHLuv8i16:
    case ARM::VRSHLuv8i8:
    case ARM::VRSHRNv2i32:
    case ARM::VRSHRNv4i16:
    case ARM::VRSHRNv8i8:
    case ARM::VRSHRsv16i8:
    case ARM::VRSHRsv1i64:
    case ARM::VRSHRsv2i32:
    case ARM::VRSHRsv2i64:
    case ARM::VRSHRsv4i16:
    case ARM::VRSHRsv4i32:
    case ARM::VRSHRsv8i16:
    case ARM::VRSHRsv8i8:
    case ARM::VRSHRuv16i8:
    case ARM::VRSHRuv1i64:
    case ARM::VRSHRuv2i32:
    case ARM::VRSHRuv2i64:
    case ARM::VRSHRuv4i16:
    case ARM::VRSHRuv4i32:
    case ARM::VRSHRuv8i16:
    case ARM::VRSHRuv8i8:
    case ARM::VRSQRTEd:
    case ARM::VRSQRTEfd:
    case ARM::VRSQRTEfq:
    case ARM::VRSQRTEq:
    case ARM::VRSQRTSfd:
    case ARM::VRSQRTSfq:
    case ARM::VRSRAsv16i8:
    case ARM::VRSRAsv1i64:
    case ARM::VRSRAsv2i32:
    case ARM::VRSRAsv2i64:
    case ARM::VRSRAsv4i16:
    case ARM::VRSRAsv4i32:
    case ARM::VRSRAsv8i16:
    case ARM::VRSRAsv8i8:
    case ARM::VRSRAuv16i8:
    case ARM::VRSRAuv1i64:
    case ARM::VRSRAuv2i32:
    case ARM::VRSRAuv2i64:
    case ARM::VRSRAuv4i16:
    case ARM::VRSRAuv4i32:
    case ARM::VRSRAuv8i16:
    case ARM::VRSRAuv8i8:
    case ARM::VRSUBHNv2i32:
    case ARM::VRSUBHNv4i16:
    case ARM::VRSUBHNv8i8:
    case ARM::VSETLNi16:
    case ARM::VSETLNi32:
    case ARM::VSETLNi8:
    case ARM::VSHLLi16:
    case ARM::VSHLLi32:
    case ARM::VSHLLi8:
    case ARM::VSHLLsv2i64:
    case ARM::VSHLLsv4i32:
    case ARM::VSHLLsv8i16:
    case ARM::VSHLLuv2i64:
    case ARM::VSHLLuv4i32:
    case ARM::VSHLLuv8i16:
    case ARM::VSHLiv16i8:
    case ARM::VSHLiv1i64:
    case ARM::VSHLiv2i32:
    case ARM::VSHLiv2i64:
    case ARM::VSHLiv4i16:
    case ARM::VSHLiv4i32:
    case ARM::VSHLiv8i16:
    case ARM::VSHLiv8i8:
    case ARM::VSHLsv16i8:
    case ARM::VSHLsv1i64:
    case ARM::VSHLsv2i32:
    case ARM::VSHLsv2i64:
    case ARM::VSHLsv4i16:
    case ARM::VSHLsv4i32:
    case ARM::VSHLsv8i16:
    case ARM::VSHLsv8i8:
    case ARM::VSHLuv16i8:
    case ARM::VSHLuv1i64:
    case ARM::VSHLuv2i32:
    case ARM::VSHLuv2i64:
    case ARM::VSHLuv4i16:
    case ARM::VSHLuv4i32:
    case ARM::VSHLuv8i16:
    case ARM::VSHLuv8i8:
    case ARM::VSHRNv2i32:
    case ARM::VSHRNv4i16:
    case ARM::VSHRNv8i8:
    case ARM::VSHRsv16i8:
    case ARM::VSHRsv1i64:
    case ARM::VSHRsv2i32:
    case ARM::VSHRsv2i64:
    case ARM::VSHRsv4i16:
    case ARM::VSHRsv4i32:
    case ARM::VSHRsv8i16:
    case ARM::VSHRsv8i8:
    case ARM::VSHRuv16i8:
    case ARM::VSHRuv1i64:
    case ARM::VSHRuv2i32:
    case ARM::VSHRuv2i64:
    case ARM::VSHRuv4i16:
    case ARM::VSHRuv4i32:
    case ARM::VSHRuv8i16:
    case ARM::VSHRuv8i8:
    case ARM::VSHTOD:
    case ARM::VSHTOS:
    case ARM::VSITOD:
    case ARM::VSITOS:
    case ARM::VSLIv16i8:
    case ARM::VSLIv1i64:
    case ARM::VSLIv2i32:
    case ARM::VSLIv2i64:
    case ARM::VSLIv4i16:
    case ARM::VSLIv4i32:
    case ARM::VSLIv8i16:
    case ARM::VSLIv8i8:
    case ARM::VSLTOD:
    case ARM::VSLTOS:
    case ARM::VSQRTD:
    case ARM::VSQRTS:
    case ARM::VSRAsv16i8:
    case ARM::VSRAsv1i64:
    case ARM::VSRAsv2i32:
    case ARM::VSRAsv2i64:
    case ARM::VSRAsv4i16:
    case ARM::VSRAsv4i32:
    case ARM::VSRAsv8i16:
    case ARM::VSRAsv8i8:
    case ARM::VSRAuv16i8:
    case ARM::VSRAuv1i64:
    case ARM::VSRAuv2i32:
    case ARM::VSRAuv2i64:
    case ARM::VSRAuv4i16:
    case ARM::VSRAuv4i32:
    case ARM::VSRAuv8i16:
    case ARM::VSRAuv8i8:
    case ARM::VSRIv16i8:
    case ARM::VSRIv1i64:
    case ARM::VSRIv2i32:
    case ARM::VSRIv2i64:
    case ARM::VSRIv4i16:
    case ARM::VSRIv4i32:
    case ARM::VSRIv8i16:
    case ARM::VSRIv8i8:
    case ARM::VST1d16:
    case ARM::VST1d16Q:
    case ARM::VST1d16T:
    case ARM::VST1d32:
    case ARM::VST1d32Q:
    case ARM::VST1d32T:
    case ARM::VST1d64:
    case ARM::VST1d8:
    case ARM::VST1d8Q:
    case ARM::VST1d8T:
    case ARM::VST1df:
    case ARM::VST1q16:
    case ARM::VST1q32:
    case ARM::VST1q64:
    case ARM::VST1q8:
    case ARM::VST1qf:
    case ARM::VST2LNd16:
    case ARM::VST2LNd32:
    case ARM::VST2LNd8:
    case ARM::VST2LNq16a:
    case ARM::VST2LNq16b:
    case ARM::VST2LNq32a:
    case ARM::VST2LNq32b:
    case ARM::VST2d16:
    case ARM::VST2d16D:
    case ARM::VST2d32:
    case ARM::VST2d32D:
    case ARM::VST2d64:
    case ARM::VST2d8:
    case ARM::VST2d8D:
    case ARM::VST2q16:
    case ARM::VST2q32:
    case ARM::VST2q8:
    case ARM::VST3LNd16:
    case ARM::VST3LNd32:
    case ARM::VST3LNd8:
    case ARM::VST3LNq16a:
    case ARM::VST3LNq16b:
    case ARM::VST3LNq32a:
    case ARM::VST3LNq32b:
    case ARM::VST3d16:
    case ARM::VST3d32:
    case ARM::VST3d64:
    case ARM::VST3d8:
    case ARM::VST3q16a:
    case ARM::VST3q16b:
    case ARM::VST3q32a:
    case ARM::VST3q32b:
    case ARM::VST3q8a:
    case ARM::VST3q8b:
    case ARM::VST4LNd16:
    case ARM::VST4LNd32:
    case ARM::VST4LNd8:
    case ARM::VST4LNq16a:
    case ARM::VST4LNq16b:
    case ARM::VST4LNq32a:
    case ARM::VST4LNq32b:
    case ARM::VST4d16:
    case ARM::VST4d32:
    case ARM::VST4d64:
    case ARM::VST4d8:
    case ARM::VST4q16a:
    case ARM::VST4q16b:
    case ARM::VST4q32a:
    case ARM::VST4q32b:
    case ARM::VST4q8a:
    case ARM::VST4q8b:
    case ARM::VSTMD:
    case ARM::VSTMS:
    case ARM::VSTRD:
    case ARM::VSTRQ:
    case ARM::VSTRS:
    case ARM::VSUBD:
    case ARM::VSUBHNv2i32:
    case ARM::VSUBHNv4i16:
    case ARM::VSUBHNv8i8:
    case ARM::VSUBLsv2i64:
    case ARM::VSUBLsv4i32:
    case ARM::VSUBLsv8i16:
    case ARM::VSUBLuv2i64:
    case ARM::VSUBLuv4i32:
    case ARM::VSUBLuv8i16:
    case ARM::VSUBS:
    case ARM::VSUBWsv2i64:
    case ARM::VSUBWsv4i32:
    case ARM::VSUBWsv8i16:
    case ARM::VSUBWuv2i64:
    case ARM::VSUBWuv4i32:
    case ARM::VSUBWuv8i16:
    case ARM::VSUBfd:
    case ARM::VSUBfd_sfp:
    case ARM::VSUBfq:
    case ARM::VSUBv16i8:
    case ARM::VSUBv1i64:
    case ARM::VSUBv2i32:
    case ARM::VSUBv2i64:
    case ARM::VSUBv4i16:
    case ARM::VSUBv4i32:
    case ARM::VSUBv8i16:
    case ARM::VSUBv8i8:
    case ARM::VSWPd:
    case ARM::VSWPq:
    case ARM::VTBL1:
    case ARM::VTBL2:
    case ARM::VTBL3:
    case ARM::VTBL4:
    case ARM::VTBX1:
    case ARM::VTBX2:
    case ARM::VTBX3:
    case ARM::VTBX4:
    case ARM::VTOSHD:
    case ARM::VTOSHS:
    case ARM::VTOSIRD:
    case ARM::VTOSIRS:
    case ARM::VTOSIZD:
    case ARM::VTOSIZS:
    case ARM::VTOSLD:
    case ARM::VTOSLS:
    case ARM::VTOUHD:
    case ARM::VTOUHS:
    case ARM::VTOUIRD:
    case ARM::VTOUIRS:
    case ARM::VTOUIZD:
    case ARM::VTOUIZS:
    case ARM::VTOULD:
    case ARM::VTOULS:
    case ARM::VTRNd16:
    case ARM::VTRNd32:
    case ARM::VTRNd8:
    case ARM::VTRNq16:
    case ARM::VTRNq32:
    case ARM::VTRNq8:
    case ARM::VTSTv16i8:
    case ARM::VTSTv2i32:
    case ARM::VTSTv4i16:
    case ARM::VTSTv4i32:
    case ARM::VTSTv8i16:
    case ARM::VTSTv8i8:
    case ARM::VUHTOD:
    case ARM::VUHTOS:
    case ARM::VUITOD:
    case ARM::VUITOS:
    case ARM::VULTOD:
    case ARM::VULTOS:
    case ARM::VUZPd16:
    case ARM::VUZPd32:
    case ARM::VUZPd8:
    case ARM::VUZPq16:
    case ARM::VUZPq32:
    case ARM::VUZPq8:
    case ARM::VZIPd16:
    case ARM::VZIPd32:
    case ARM::VZIPd8:
    case ARM::VZIPq16:
    case ARM::VZIPq32:
    case ARM::VZIPq8:
    case ARM::WFE:
    case ARM::WFI:
    case ARM::YIELD:
    case ARM::t2ADCSri:
    case ARM::t2ADCSrr:
    case ARM::t2ADCSrs:
    case ARM::t2ADCri:
    case ARM::t2ADCrr:
    case ARM::t2ADCrs:
    case ARM::t2ADDSri:
    case ARM::t2ADDSrr:
    case ARM::t2ADDSrs:
    case ARM::t2ADDrSPi:
    case ARM::t2ADDrSPi12:
    case ARM::t2ADDrSPs:
    case ARM::t2ADDri:
    case ARM::t2ADDri12:
    case ARM::t2ADDrr:
    case ARM::t2ADDrs:
    case ARM::t2ANDri:
    case ARM::t2ANDrr:
    case ARM::t2ANDrs:
    case ARM::t2ASRri:
    case ARM::t2ASRrr:
    case ARM::t2B:
    case ARM::t2BFC:
    case ARM::t2BFI:
    case ARM::t2BICri:
    case ARM::t2BICrr:
    case ARM::t2BICrs:
    case ARM::t2BR_JT:
    case ARM::t2BXJ:
    case ARM::t2Bcc:
    case ARM::t2CLREX:
    case ARM::t2CLZ:
    case ARM::t2CMNzri:
    case ARM::t2CMNzrr:
    case ARM::t2CMNzrs:
    case ARM::t2CMPri:
    case ARM::t2CMPrr:
    case ARM::t2CMPrs:
    case ARM::t2CMPzri:
    case ARM::t2CMPzrr:
    case ARM::t2CMPzrs:
    case ARM::t2CPS:
    case ARM::t2DBG:
    case ARM::t2DMBish:
    case ARM::t2DMBishst:
    case ARM::t2DMBnsh:
    case ARM::t2DMBnshst:
    case ARM::t2DMBosh:
    case ARM::t2DMBoshst:
    case ARM::t2DMBst:
    case ARM::t2DSBish:
    case ARM::t2DSBishst:
    case ARM::t2DSBnsh:
    case ARM::t2DSBnshst:
    case ARM::t2DSBosh:
    case ARM::t2DSBoshst:
    case ARM::t2DSBst:
    case ARM::t2EORri:
    case ARM::t2EORrr:
    case ARM::t2EORrs:
    case ARM::t2ISBsy:
    case ARM::t2IT:
    case ARM::t2Int_MemBarrierV7:
    case ARM::t2Int_SyncBarrierV7:
    case ARM::t2Int_eh_sjlj_setjmp:
    case ARM::t2LDM:
    case ARM::t2LDM_RET:
    case ARM::t2LDRBT:
    case ARM::t2LDRB_POST:
    case ARM::t2LDRB_PRE:
    case ARM::t2LDRBi12:
    case ARM::t2LDRBi8:
    case ARM::t2LDRBpci:
    case ARM::t2LDRBs:
    case ARM::t2LDRDi8:
    case ARM::t2LDRDpci:
    case ARM::t2LDREX:
    case ARM::t2LDREXB:
    case ARM::t2LDREXD:
    case ARM::t2LDREXH:
    case ARM::t2LDRHT:
    case ARM::t2LDRH_POST:
    case ARM::t2LDRH_PRE:
    case ARM::t2LDRHi12:
    case ARM::t2LDRHi8:
    case ARM::t2LDRHpci:
    case ARM::t2LDRHs:
    case ARM::t2LDRSBT:
    case ARM::t2LDRSB_POST:
    case ARM::t2LDRSB_PRE:
    case ARM::t2LDRSBi12:
    case ARM::t2LDRSBi8:
    case ARM::t2LDRSBpci:
    case ARM::t2LDRSBs:
    case ARM::t2LDRSHT:
    case ARM::t2LDRSH_POST:
    case ARM::t2LDRSH_PRE:
    case ARM::t2LDRSHi12:
    case ARM::t2LDRSHi8:
    case ARM::t2LDRSHpci:
    case ARM::t2LDRSHs:
    case ARM::t2LDRT:
    case ARM::t2LDR_POST:
    case ARM::t2LDR_PRE:
    case ARM::t2LDRi12:
    case ARM::t2LDRi8:
    case ARM::t2LDRpci:
    case ARM::t2LDRpci_pic:
    case ARM::t2LDRs:
    case ARM::t2LEApcrel:
    case ARM::t2LEApcrelJT:
    case ARM::t2LSLri:
    case ARM::t2LSLrr:
    case ARM::t2LSRri:
    case ARM::t2LSRrr:
    case ARM::t2MLA:
    case ARM::t2MLS:
    case ARM::t2MOVCCasr:
    case ARM::t2MOVCCi:
    case ARM::t2MOVCClsl:
    case ARM::t2MOVCClsr:
    case ARM::t2MOVCCr:
    case ARM::t2MOVCCror:
    case ARM::t2MOVTi16:
    case ARM::t2MOVi:
    case ARM::t2MOVi16:
    case ARM::t2MOVi32imm:
    case ARM::t2MOVr:
    case ARM::t2MOVrx:
    case ARM::t2MOVsra_flag:
    case ARM::t2MOVsrl_flag:
    case ARM::t2MRS:
    case ARM::t2MRSsys:
    case ARM::t2MSR:
    case ARM::t2MSRsys:
    case ARM::t2MUL:
    case ARM::t2MVNi:
    case ARM::t2MVNr:
    case ARM::t2MVNs:
    case ARM::t2NOP:
    case ARM::t2ORNri:
    case ARM::t2ORNrr:
    case ARM::t2ORNrs:
    case ARM::t2ORRri:
    case ARM::t2ORRrr:
    case ARM::t2ORRrs:
    case ARM::t2PKHBT:
    case ARM::t2PKHTB:
    case ARM::t2PLDWi12:
    case ARM::t2PLDWi8:
    case ARM::t2PLDWpci:
    case ARM::t2PLDWr:
    case ARM::t2PLDWs:
    case ARM::t2PLDi12:
    case ARM::t2PLDi8:
    case ARM::t2PLDpci:
    case ARM::t2PLDr:
    case ARM::t2PLDs:
    case ARM::t2PLIi12:
    case ARM::t2PLIi8:
    case ARM::t2PLIpci:
    case ARM::t2PLIr:
    case ARM::t2PLIs:
    case ARM::t2QADD:
    case ARM::t2QADD16:
    case ARM::t2QADD8:
    case ARM::t2QASX:
    case ARM::t2QDADD:
    case ARM::t2QDSUB:
    case ARM::t2QSAX:
    case ARM::t2QSUB:
    case ARM::t2QSUB16:
    case ARM::t2QSUB8:
    case ARM::t2RBIT:
    case ARM::t2REV:
    case ARM::t2REV16:
    case ARM::t2REVSH:
    case ARM::t2RFEDB:
    case ARM::t2RFEDBW:
    case ARM::t2RFEIA:
    case ARM::t2RFEIAW:
    case ARM::t2RORri:
    case ARM::t2RORrr:
    case ARM::t2RSBSri:
    case ARM::t2RSBSrs:
    case ARM::t2RSBri:
    case ARM::t2RSBrs:
    case ARM::t2SADD16:
    case ARM::t2SADD8:
    case ARM::t2SASX:
    case ARM::t2SBCSri:
    case ARM::t2SBCSrr:
    case ARM::t2SBCSrs:
    case ARM::t2SBCri:
    case ARM::t2SBCrr:
    case ARM::t2SBCrs:
    case ARM::t2SBFX:
    case ARM::t2SDIV:
    case ARM::t2SEL:
    case ARM::t2SEV:
    case ARM::t2SHADD16:
    case ARM::t2SHADD8:
    case ARM::t2SHASX:
    case ARM::t2SHSAX:
    case ARM::t2SHSUB16:
    case ARM::t2SHSUB8:
    case ARM::t2SMC:
    case ARM::t2SMLABB:
    case ARM::t2SMLABT:
    case ARM::t2SMLAD:
    case ARM::t2SMLADX:
    case ARM::t2SMLAL:
    case ARM::t2SMLALBB:
    case ARM::t2SMLALBT:
    case ARM::t2SMLALD:
    case ARM::t2SMLALDX:
    case ARM::t2SMLALTB:
    case ARM::t2SMLALTT:
    case ARM::t2SMLATB:
    case ARM::t2SMLATT:
    case ARM::t2SMLAWB:
    case ARM::t2SMLAWT:
    case ARM::t2SMLSD:
    case ARM::t2SMLSDX:
    case ARM::t2SMLSLD:
    case ARM::t2SMLSLDX:
    case ARM::t2SMMLA:
    case ARM::t2SMMLAR:
    case ARM::t2SMMLS:
    case ARM::t2SMMLSR:
    case ARM::t2SMMUL:
    case ARM::t2SMMULR:
    case ARM::t2SMUAD:
    case ARM::t2SMUADX:
    case ARM::t2SMULBB:
    case ARM::t2SMULBT:
    case ARM::t2SMULL:
    case ARM::t2SMULTB:
    case ARM::t2SMULTT:
    case ARM::t2SMULWB:
    case ARM::t2SMULWT:
    case ARM::t2SMUSD:
    case ARM::t2SMUSDX:
    case ARM::t2SRSDB:
    case ARM::t2SRSDBW:
    case ARM::t2SRSIA:
    case ARM::t2SRSIAW:
    case ARM::t2SSAT16:
    case ARM::t2SSATasr:
    case ARM::t2SSATlsl:
    case ARM::t2SSAX:
    case ARM::t2SSUB16:
    case ARM::t2SSUB8:
    case ARM::t2STM:
    case ARM::t2STRBT:
    case ARM::t2STRB_POST:
    case ARM::t2STRB_PRE:
    case ARM::t2STRBi12:
    case ARM::t2STRBi8:
    case ARM::t2STRBs:
    case ARM::t2STRDi8:
    case ARM::t2STREX:
    case ARM::t2STREXB:
    case ARM::t2STREXD:
    case ARM::t2STREXH:
    case ARM::t2STRHT:
    case ARM::t2STRH_POST:
    case ARM::t2STRH_PRE:
    case ARM::t2STRHi12:
    case ARM::t2STRHi8:
    case ARM::t2STRHs:
    case ARM::t2STRT:
    case ARM::t2STR_POST:
    case ARM::t2STR_PRE:
    case ARM::t2STRi12:
    case ARM::t2STRi8:
    case ARM::t2STRs:
    case ARM::t2SUBSri:
    case ARM::t2SUBSrr:
    case ARM::t2SUBSrs:
    case ARM::t2SUBrSPi:
    case ARM::t2SUBrSPi12:
    case ARM::t2SUBrSPi12_:
    case ARM::t2SUBrSPi_:
    case ARM::t2SUBrSPs:
    case ARM::t2SUBrSPs_:
    case ARM::t2SUBri:
    case ARM::t2SUBri12:
    case ARM::t2SUBrr:
    case ARM::t2SUBrs:
    case ARM::t2SXTAB16rr:
    case ARM::t2SXTAB16rr_rot:
    case ARM::t2SXTABrr:
    case ARM::t2SXTABrr_rot:
    case ARM::t2SXTAHrr:
    case ARM::t2SXTAHrr_rot:
    case ARM::t2SXTB16r:
    case ARM::t2SXTB16r_rot:
    case ARM::t2SXTBr:
    case ARM::t2SXTBr_rot:
    case ARM::t2SXTHr:
    case ARM::t2SXTHr_rot:
    case ARM::t2TBB:
    case ARM::t2TBBgen:
    case ARM::t2TBH:
    case ARM::t2TBHgen:
    case ARM::t2TEQri:
    case ARM::t2TEQrr:
    case ARM::t2TEQrs:
    case ARM::t2TPsoft:
    case ARM::t2TSTri:
    case ARM::t2TSTrr:
    case ARM::t2TSTrs:
    case ARM::t2UADD16:
    case ARM::t2UADD8:
    case ARM::t2UASX:
    case ARM::t2UBFX:
    case ARM::t2UDIV:
    case ARM::t2UHADD16:
    case ARM::t2UHADD8:
    case ARM::t2UHASX:
    case ARM::t2UHSAX:
    case ARM::t2UHSUB16:
    case ARM::t2UHSUB8:
    case ARM::t2UMAAL:
    case ARM::t2UMLAL:
    case ARM::t2UMULL:
    case ARM::t2UQADD16:
    case ARM::t2UQADD8:
    case ARM::t2UQASX:
    case ARM::t2UQSAX:
    case ARM::t2UQSUB16:
    case ARM::t2UQSUB8:
    case ARM::t2USAD8:
    case ARM::t2USADA8:
    case ARM::t2USAT16:
    case ARM::t2USATasr:
    case ARM::t2USATlsl:
    case ARM::t2USAX:
    case ARM::t2USUB16:
    case ARM::t2USUB8:
    case ARM::t2UXTAB16rr:
    case ARM::t2UXTAB16rr_rot:
    case ARM::t2UXTABrr:
    case ARM::t2UXTABrr_rot:
    case ARM::t2UXTAHrr:
    case ARM::t2UXTAHrr_rot:
    case ARM::t2UXTB16r:
    case ARM::t2UXTB16r_rot:
    case ARM::t2UXTBr:
    case ARM::t2UXTBr_rot:
    case ARM::t2UXTHr:
    case ARM::t2UXTHr_rot:
    case ARM::t2WFE:
    case ARM::t2WFI:
    case ARM::t2YIELD:
    case ARM::tADC:
    case ARM::tADDhirr:
    case ARM::tADDi3:
    case ARM::tADDi8:
    case ARM::tADDrPCi:
    case ARM::tADDrSP:
    case ARM::tADDrSPi:
    case ARM::tADDrr:
    case ARM::tADDspi:
    case ARM::tADDspr:
    case ARM::tADDspr_:
    case ARM::tADJCALLSTACKDOWN:
    case ARM::tADJCALLSTACKUP:
    case ARM::tAND:
    case ARM::tANDsp:
    case ARM::tASRri:
    case ARM::tASRrr:
    case ARM::tB:
    case ARM::tBIC:
    case ARM::tBKPT:
    case ARM::tBL:
    case ARM::tBLXi:
    case ARM::tBLXi_r9:
    case ARM::tBLXr:
    case ARM::tBLXr_r9:
    case ARM::tBLr9:
    case ARM::tBRIND:
    case ARM::tBR_JTr:
    case ARM::tBX:
    case ARM::tBX_RET:
    case ARM::tBX_RET_vararg:
    case ARM::tBXr9:
    case ARM::tBcc:
    case ARM::tBfar:
    case ARM::tCBNZ:
    case ARM::tCBZ:
    case ARM::tCMNz:
    case ARM::tCMPhir:
    case ARM::tCMPi8:
    case ARM::tCMPr:
    case ARM::tCMPzhir:
    case ARM::tCMPzi8:
    case ARM::tCMPzr:
    case ARM::tCPS:
    case ARM::tEOR:
    case ARM::tInt_eh_sjlj_setjmp:
    case ARM::tLDM:
    case ARM::tLDR:
    case ARM::tLDRB:
    case ARM::tLDRBi:
    case ARM::tLDRH:
    case ARM::tLDRHi:
    case ARM::tLDRSB:
    case ARM::tLDRSH:
    case ARM::tLDRcp:
    case ARM::tLDRi:
    case ARM::tLDRpci:
    case ARM::tLDRpci_pic:
    case ARM::tLDRspi:
    case ARM::tLEApcrel:
    case ARM::tLEApcrelJT:
    case ARM::tLSLri:
    case ARM::tLSLrr:
    case ARM::tLSRri:
    case ARM::tLSRrr:
    case ARM::tMOVCCi:
    case ARM::tMOVCCr:
    case ARM::tMOVCCr_pseudo:
    case ARM::tMOVSr:
    case ARM::tMOVgpr2gpr:
    case ARM::tMOVgpr2tgpr:
    case ARM::tMOVi8:
    case ARM::tMOVr:
    case ARM::tMOVtgpr2gpr:
    case ARM::tMUL:
    case ARM::tMVN:
    case ARM::tNOP:
    case ARM::tORR:
    case ARM::tPICADD:
    case ARM::tPOP:
    case ARM::tPOP_RET:
    case ARM::tPUSH:
    case ARM::tREV:
    case ARM::tREV16:
    case ARM::tREVSH:
    case ARM::tROR:
    case ARM::tRSB:
    case ARM::tRestore:
    case ARM::tSBC:
    case ARM::tSETENDBE:
    case ARM::tSETENDLE:
    case ARM::tSEV:
    case ARM::tSTM:
    case ARM::tSTR:
    case ARM::tSTRB:
    case ARM::tSTRBi:
    case ARM::tSTRH:
    case ARM::tSTRHi:
    case ARM::tSTRi:
    case ARM::tSTRspi:
    case ARM::tSUBi3:
    case ARM::tSUBi8:
    case ARM::tSUBrr:
    case ARM::tSUBspi:
    case ARM::tSUBspi_:
    case ARM::tSVC:
    case ARM::tSXTB:
    case ARM::tSXTH:
    case ARM::tSpill:
    case ARM::tTPsoft:
    case ARM::tTRAP:
    case ARM::tTST:
    case ARM::tUXTB:
    case ARM::tUXTH:
    case ARM::tWFE:
    case ARM::tWFI:
    case ARM::tYIELD: {
      break;
    }
  default:
    std::string msg;
    raw_string_ostream Msg(msg);
    Msg << "Not supported instr: " << MI;
    llvm_report_error(Msg.str());
  }
  return Value;
}

