//===- TableGen'erated file -------------------------------------*- C++ -*-===//
//
// Target Instruction Enum Values
//
// Automatically generated file, do not edit!
//
//===----------------------------------------------------------------------===//

namespace llvm {

namespace ARM {
  enum {
    PHI	= 0,
    INLINEASM	= 1,
    DBG_LABEL	= 2,
    EH_LABEL	= 3,
    GC_LABEL	= 4,
    KILL	= 5,
    EXTRACT_SUBREG	= 6,
    INSERT_SUBREG	= 7,
    IMPLICIT_DEF	= 8,
    SUBREG_TO_REG	= 9,
    COPY_TO_REGCLASS	= 10,
    DBG_VALUE	= 11,
    ADCSSri	= 12,
    ADCSSrr	= 13,
    ADCSSrs	= 14,
    ADCri	= 15,
    ADCrr	= 16,
    ADCrs	= 17,
    ADDSri	= 18,
    ADDSrr	= 19,
    ADDSrs	= 20,
    ADDri	= 21,
    ADDrr	= 22,
    ADDrs	= 23,
    ADJCALLSTACKDOWN	= 24,
    ADJCALLSTACKUP	= 25,
    ANDri	= 26,
    ANDrr	= 27,
    ANDrs	= 28,
    ATOMIC_CMP_SWAP_I16	= 29,
    ATOMIC_CMP_SWAP_I32	= 30,
    ATOMIC_CMP_SWAP_I8	= 31,
    ATOMIC_LOAD_ADD_I16	= 32,
    ATOMIC_LOAD_ADD_I32	= 33,
    ATOMIC_LOAD_ADD_I8	= 34,
    ATOMIC_LOAD_AND_I16	= 35,
    ATOMIC_LOAD_AND_I32	= 36,
    ATOMIC_LOAD_AND_I8	= 37,
    ATOMIC_LOAD_NAND_I16	= 38,
    ATOMIC_LOAD_NAND_I32	= 39,
    ATOMIC_LOAD_NAND_I8	= 40,
    ATOMIC_LOAD_OR_I16	= 41,
    ATOMIC_LOAD_OR_I32	= 42,
    ATOMIC_LOAD_OR_I8	= 43,
    ATOMIC_LOAD_SUB_I16	= 44,
    ATOMIC_LOAD_SUB_I32	= 45,
    ATOMIC_LOAD_SUB_I8	= 46,
    ATOMIC_LOAD_XOR_I16	= 47,
    ATOMIC_LOAD_XOR_I32	= 48,
    ATOMIC_LOAD_XOR_I8	= 49,
    ATOMIC_SWAP_I16	= 50,
    ATOMIC_SWAP_I32	= 51,
    ATOMIC_SWAP_I8	= 52,
    B	= 53,
    BFC	= 54,
    BFI	= 55,
    BICri	= 56,
    BICrr	= 57,
    BICrs	= 58,
    BKPT	= 59,
    BL	= 60,
    BLX	= 61,
    BLXr9	= 62,
    BL_pred	= 63,
    BLr9	= 64,
    BLr9_pred	= 65,
    BMOVPCRX	= 66,
    BMOVPCRXr9	= 67,
    BRIND	= 68,
    BR_JTadd	= 69,
    BR_JTm	= 70,
    BR_JTr	= 71,
    BX	= 72,
    BXJ	= 73,
    BX_RET	= 74,
    BXr9	= 75,
    Bcc	= 76,
    CDP	= 77,
    CDP2	= 78,
    CLREX	= 79,
    CLZ	= 80,
    CMNzri	= 81,
    CMNzrr	= 82,
    CMNzrs	= 83,
    CMPri	= 84,
    CMPrr	= 85,
    CMPrs	= 86,
    CMPzri	= 87,
    CMPzrr	= 88,
    CMPzrs	= 89,
    CONSTPOOL_ENTRY	= 90,
    CPS	= 91,
    DBG	= 92,
    DMBish	= 93,
    DMBishst	= 94,
    DMBnsh	= 95,
    DMBnshst	= 96,
    DMBosh	= 97,
    DMBoshst	= 98,
    DMBst	= 99,
    DSBish	= 100,
    DSBishst	= 101,
    DSBnsh	= 102,
    DSBnshst	= 103,
    DSBosh	= 104,
    DSBoshst	= 105,
    DSBst	= 106,
    EORri	= 107,
    EORrr	= 108,
    EORrs	= 109,
    FCONSTD	= 110,
    FCONSTS	= 111,
    FMSTAT	= 112,
    ISBsy	= 113,
    Int_MemBarrierV6	= 114,
    Int_MemBarrierV7	= 115,
    Int_SyncBarrierV6	= 116,
    Int_SyncBarrierV7	= 117,
    Int_eh_sjlj_setjmp	= 118,
    LDC2L_OFFSET	= 119,
    LDC2L_OPTION	= 120,
    LDC2L_POST	= 121,
    LDC2L_PRE	= 122,
    LDC2_OFFSET	= 123,
    LDC2_OPTION	= 124,
    LDC2_POST	= 125,
    LDC2_PRE	= 126,
    LDCL_OFFSET	= 127,
    LDCL_OPTION	= 128,
    LDCL_POST	= 129,
    LDCL_PRE	= 130,
    LDC_OFFSET	= 131,
    LDC_OPTION	= 132,
    LDC_POST	= 133,
    LDC_PRE	= 134,
    LDM	= 135,
    LDM_RET	= 136,
    LDR	= 137,
    LDRB	= 138,
    LDRBT	= 139,
    LDRB_POST	= 140,
    LDRB_PRE	= 141,
    LDRD	= 142,
    LDRD_POST	= 143,
    LDRD_PRE	= 144,
    LDREX	= 145,
    LDREXB	= 146,
    LDREXD	= 147,
    LDREXH	= 148,
    LDRH	= 149,
    LDRHT	= 150,
    LDRH_POST	= 151,
    LDRH_PRE	= 152,
    LDRSB	= 153,
    LDRSBT	= 154,
    LDRSB_POST	= 155,
    LDRSB_PRE	= 156,
    LDRSH	= 157,
    LDRSHT	= 158,
    LDRSH_POST	= 159,
    LDRSH_PRE	= 160,
    LDRT	= 161,
    LDR_POST	= 162,
    LDR_PRE	= 163,
    LDRcp	= 164,
    LEApcrel	= 165,
    LEApcrelJT	= 166,
    MCR	= 167,
    MCR2	= 168,
    MCRR	= 169,
    MCRR2	= 170,
    MLA	= 171,
    MLS	= 172,
    MOVCCi	= 173,
    MOVCCr	= 174,
    MOVCCs	= 175,
    MOVPCLR	= 176,
    MOVPCRX	= 177,
    MOVTi16	= 178,
    MOVi	= 179,
    MOVi16	= 180,
    MOVi2pieces	= 181,
    MOVi32imm	= 182,
    MOVr	= 183,
    MOVrx	= 184,
    MOVs	= 185,
    MOVsra_flag	= 186,
    MOVsrl_flag	= 187,
    MRC	= 188,
    MRC2	= 189,
    MRRC	= 190,
    MRRC2	= 191,
    MRS	= 192,
    MRSsys	= 193,
    MSR	= 194,
    MSRi	= 195,
    MSRsys	= 196,
    MSRsysi	= 197,
    MUL	= 198,
    MVNi	= 199,
    MVNr	= 200,
    MVNs	= 201,
    NOP	= 202,
    ORRri	= 203,
    ORRrr	= 204,
    ORRrs	= 205,
    PICADD	= 206,
    PICLDR	= 207,
    PICLDRB	= 208,
    PICLDRH	= 209,
    PICLDRSB	= 210,
    PICLDRSH	= 211,
    PICSTR	= 212,
    PICSTRB	= 213,
    PICSTRH	= 214,
    PKHBT	= 215,
    PKHTB	= 216,
    PLDWi	= 217,
    PLDWr	= 218,
    PLDi	= 219,
    PLDr	= 220,
    PLIi	= 221,
    PLIr	= 222,
    QADD	= 223,
    QADD16	= 224,
    QADD8	= 225,
    QASX	= 226,
    QDADD	= 227,
    QDSUB	= 228,
    QSAX	= 229,
    QSUB	= 230,
    QSUB16	= 231,
    QSUB8	= 232,
    RBIT	= 233,
    REV	= 234,
    REV16	= 235,
    REVSH	= 236,
    RFE	= 237,
    RFEW	= 238,
    RSBSri	= 239,
    RSBSrs	= 240,
    RSBri	= 241,
    RSBrs	= 242,
    RSCSri	= 243,
    RSCSrs	= 244,
    RSCri	= 245,
    RSCrs	= 246,
    SADD16	= 247,
    SADD8	= 248,
    SASX	= 249,
    SBCSSri	= 250,
    SBCSSrr	= 251,
    SBCSSrs	= 252,
    SBCri	= 253,
    SBCrr	= 254,
    SBCrs	= 255,
    SBFX	= 256,
    SEL	= 257,
    SETENDBE	= 258,
    SETENDLE	= 259,
    SEV	= 260,
    SHADD16	= 261,
    SHADD8	= 262,
    SHASX	= 263,
    SHSAX	= 264,
    SHSUB16	= 265,
    SHSUB8	= 266,
    SMC	= 267,
    SMLABB	= 268,
    SMLABT	= 269,
    SMLAD	= 270,
    SMLADX	= 271,
    SMLAL	= 272,
    SMLALBB	= 273,
    SMLALBT	= 274,
    SMLALD	= 275,
    SMLALDX	= 276,
    SMLALTB	= 277,
    SMLALTT	= 278,
    SMLATB	= 279,
    SMLATT	= 280,
    SMLAWB	= 281,
    SMLAWT	= 282,
    SMLSD	= 283,
    SMLSDX	= 284,
    SMLSLD	= 285,
    SMLSLDX	= 286,
    SMMLA	= 287,
    SMMLAR	= 288,
    SMMLS	= 289,
    SMMLSR	= 290,
    SMMUL	= 291,
    SMMULR	= 292,
    SMUAD	= 293,
    SMUADX	= 294,
    SMULBB	= 295,
    SMULBT	= 296,
    SMULL	= 297,
    SMULTB	= 298,
    SMULTT	= 299,
    SMULWB	= 300,
    SMULWT	= 301,
    SMUSD	= 302,
    SMUSDX	= 303,
    SRS	= 304,
    SRSW	= 305,
    SSAT16	= 306,
    SSATasr	= 307,
    SSATlsl	= 308,
    SSAX	= 309,
    SSUB16	= 310,
    SSUB8	= 311,
    STC2L_OFFSET	= 312,
    STC2L_OPTION	= 313,
    STC2L_POST	= 314,
    STC2L_PRE	= 315,
    STC2_OFFSET	= 316,
    STC2_OPTION	= 317,
    STC2_POST	= 318,
    STC2_PRE	= 319,
    STCL_OFFSET	= 320,
    STCL_OPTION	= 321,
    STCL_POST	= 322,
    STCL_PRE	= 323,
    STC_OFFSET	= 324,
    STC_OPTION	= 325,
    STC_POST	= 326,
    STC_PRE	= 327,
    STM	= 328,
    STR	= 329,
    STRB	= 330,
    STRBT	= 331,
    STRB_POST	= 332,
    STRB_PRE	= 333,
    STRD	= 334,
    STRD_POST	= 335,
    STRD_PRE	= 336,
    STREX	= 337,
    STREXB	= 338,
    STREXD	= 339,
    STREXH	= 340,
    STRH	= 341,
    STRHT	= 342,
    STRH_POST	= 343,
    STRH_PRE	= 344,
    STRT	= 345,
    STR_POST	= 346,
    STR_PRE	= 347,
    SUBSri	= 348,
    SUBSrr	= 349,
    SUBSrs	= 350,
    SUBri	= 351,
    SUBrr	= 352,
    SUBrs	= 353,
    SVC	= 354,
    SWP	= 355,
    SWPB	= 356,
    SXTAB16rr	= 357,
    SXTAB16rr_rot	= 358,
    SXTABrr	= 359,
    SXTABrr_rot	= 360,
    SXTAHrr	= 361,
    SXTAHrr_rot	= 362,
    SXTB16r	= 363,
    SXTB16r_rot	= 364,
    SXTBr	= 365,
    SXTBr_rot	= 366,
    SXTHr	= 367,
    SXTHr_rot	= 368,
    TEQri	= 369,
    TEQrr	= 370,
    TEQrs	= 371,
    TPsoft	= 372,
    TRAP	= 373,
    TSTri	= 374,
    TSTrr	= 375,
    TSTrs	= 376,
    UADD16	= 377,
    UADD8	= 378,
    UASX	= 379,
    UBFX	= 380,
    UHADD16	= 381,
    UHADD8	= 382,
    UHASX	= 383,
    UHSAX	= 384,
    UHSUB16	= 385,
    UHSUB8	= 386,
    UMAAL	= 387,
    UMLAL	= 388,
    UMULL	= 389,
    UQADD16	= 390,
    UQADD8	= 391,
    UQASX	= 392,
    UQSAX	= 393,
    UQSUB16	= 394,
    UQSUB8	= 395,
    USAD8	= 396,
    USADA8	= 397,
    USAT16	= 398,
    USATasr	= 399,
    USATlsl	= 400,
    USAX	= 401,
    USUB16	= 402,
    USUB8	= 403,
    UXTAB16rr	= 404,
    UXTAB16rr_rot	= 405,
    UXTABrr	= 406,
    UXTABrr_rot	= 407,
    UXTAHrr	= 408,
    UXTAHrr_rot	= 409,
    UXTB16r	= 410,
    UXTB16r_rot	= 411,
    UXTBr	= 412,
    UXTBr_rot	= 413,
    UXTHr	= 414,
    UXTHr_rot	= 415,
    VABALsv2i64	= 416,
    VABALsv4i32	= 417,
    VABALsv8i16	= 418,
    VABALuv2i64	= 419,
    VABALuv4i32	= 420,
    VABALuv8i16	= 421,
    VABAsv16i8	= 422,
    VABAsv2i32	= 423,
    VABAsv4i16	= 424,
    VABAsv4i32	= 425,
    VABAsv8i16	= 426,
    VABAsv8i8	= 427,
    VABAuv16i8	= 428,
    VABAuv2i32	= 429,
    VABAuv4i16	= 430,
    VABAuv4i32	= 431,
    VABAuv8i16	= 432,
    VABAuv8i8	= 433,
    VABDLsv2i64	= 434,
    VABDLsv4i32	= 435,
    VABDLsv8i16	= 436,
    VABDLuv2i64	= 437,
    VABDLuv4i32	= 438,
    VABDLuv8i16	= 439,
    VABDfd	= 440,
    VABDfq	= 441,
    VABDsv16i8	= 442,
    VABDsv2i32	= 443,
    VABDsv4i16	= 444,
    VABDsv4i32	= 445,
    VABDsv8i16	= 446,
    VABDsv8i8	= 447,
    VABDuv16i8	= 448,
    VABDuv2i32	= 449,
    VABDuv4i16	= 450,
    VABDuv4i32	= 451,
    VABDuv8i16	= 452,
    VABDuv8i8	= 453,
    VABSD	= 454,
    VABSS	= 455,
    VABSfd	= 456,
    VABSfd_sfp	= 457,
    VABSfq	= 458,
    VABSv16i8	= 459,
    VABSv2i32	= 460,
    VABSv4i16	= 461,
    VABSv4i32	= 462,
    VABSv8i16	= 463,
    VABSv8i8	= 464,
    VACGEd	= 465,
    VACGEq	= 466,
    VACGTd	= 467,
    VACGTq	= 468,
    VADDD	= 469,
    VADDHNv2i32	= 470,
    VADDHNv4i16	= 471,
    VADDHNv8i8	= 472,
    VADDLsv2i64	= 473,
    VADDLsv4i32	= 474,
    VADDLsv8i16	= 475,
    VADDLuv2i64	= 476,
    VADDLuv4i32	= 477,
    VADDLuv8i16	= 478,
    VADDS	= 479,
    VADDWsv2i64	= 480,
    VADDWsv4i32	= 481,
    VADDWsv8i16	= 482,
    VADDWuv2i64	= 483,
    VADDWuv4i32	= 484,
    VADDWuv8i16	= 485,
    VADDfd	= 486,
    VADDfd_sfp	= 487,
    VADDfq	= 488,
    VADDv16i8	= 489,
    VADDv1i64	= 490,
    VADDv2i32	= 491,
    VADDv2i64	= 492,
    VADDv4i16	= 493,
    VADDv4i32	= 494,
    VADDv8i16	= 495,
    VADDv8i8	= 496,
    VANDd	= 497,
    VANDq	= 498,
    VBICd	= 499,
    VBICq	= 500,
    VBIFd	= 501,
    VBIFq	= 502,
    VBITd	= 503,
    VBITq	= 504,
    VBSLd	= 505,
    VBSLq	= 506,
    VCEQfd	= 507,
    VCEQfq	= 508,
    VCEQv16i8	= 509,
    VCEQv2i32	= 510,
    VCEQv4i16	= 511,
    VCEQv4i32	= 512,
    VCEQv8i16	= 513,
    VCEQv8i8	= 514,
    VCEQzv16i8	= 515,
    VCEQzv2f32	= 516,
    VCEQzv2i32	= 517,
    VCEQzv4f32	= 518,
    VCEQzv4i16	= 519,
    VCEQzv4i32	= 520,
    VCEQzv8i16	= 521,
    VCEQzv8i8	= 522,
    VCGEfd	= 523,
    VCGEfq	= 524,
    VCGEsv16i8	= 525,
    VCGEsv2i32	= 526,
    VCGEsv4i16	= 527,
    VCGEsv4i32	= 528,
    VCGEsv8i16	= 529,
    VCGEsv8i8	= 530,
    VCGEuv16i8	= 531,
    VCGEuv2i32	= 532,
    VCGEuv4i16	= 533,
    VCGEuv4i32	= 534,
    VCGEuv8i16	= 535,
    VCGEuv8i8	= 536,
    VCGEzv16i8	= 537,
    VCGEzv2f32	= 538,
    VCGEzv2i32	= 539,
    VCGEzv4f32	= 540,
    VCGEzv4i16	= 541,
    VCGEzv4i32	= 542,
    VCGEzv8i16	= 543,
    VCGEzv8i8	= 544,
    VCGTfd	= 545,
    VCGTfq	= 546,
    VCGTsv16i8	= 547,
    VCGTsv2i32	= 548,
    VCGTsv4i16	= 549,
    VCGTsv4i32	= 550,
    VCGTsv8i16	= 551,
    VCGTsv8i8	= 552,
    VCGTuv16i8	= 553,
    VCGTuv2i32	= 554,
    VCGTuv4i16	= 555,
    VCGTuv4i32	= 556,
    VCGTuv8i16	= 557,
    VCGTuv8i8	= 558,
    VCGTzv16i8	= 559,
    VCGTzv2f32	= 560,
    VCGTzv2i32	= 561,
    VCGTzv4f32	= 562,
    VCGTzv4i16	= 563,
    VCGTzv4i32	= 564,
    VCGTzv8i16	= 565,
    VCGTzv8i8	= 566,
    VCLEzv16i8	= 567,
    VCLEzv2f32	= 568,
    VCLEzv2i32	= 569,
    VCLEzv4f32	= 570,
    VCLEzv4i16	= 571,
    VCLEzv4i32	= 572,
    VCLEzv8i16	= 573,
    VCLEzv8i8	= 574,
    VCLSv16i8	= 575,
    VCLSv2i32	= 576,
    VCLSv4i16	= 577,
    VCLSv4i32	= 578,
    VCLSv8i16	= 579,
    VCLSv8i8	= 580,
    VCLTzv16i8	= 581,
    VCLTzv2f32	= 582,
    VCLTzv2i32	= 583,
    VCLTzv4f32	= 584,
    VCLTzv4i16	= 585,
    VCLTzv4i32	= 586,
    VCLTzv8i16	= 587,
    VCLTzv8i8	= 588,
    VCLZv16i8	= 589,
    VCLZv2i32	= 590,
    VCLZv4i16	= 591,
    VCLZv4i32	= 592,
    VCLZv8i16	= 593,
    VCLZv8i8	= 594,
    VCMPD	= 595,
    VCMPED	= 596,
    VCMPES	= 597,
    VCMPEZD	= 598,
    VCMPEZS	= 599,
    VCMPS	= 600,
    VCMPZD	= 601,
    VCMPZS	= 602,
    VCNTd	= 603,
    VCNTq	= 604,
    VCVTBHS	= 605,
    VCVTBSH	= 606,
    VCVTDS	= 607,
    VCVTSD	= 608,
    VCVTTHS	= 609,
    VCVTTSH	= 610,
    VCVTf2sd	= 611,
    VCVTf2sd_sfp	= 612,
    VCVTf2sq	= 613,
    VCVTf2ud	= 614,
    VCVTf2ud_sfp	= 615,
    VCVTf2uq	= 616,
    VCVTf2xsd	= 617,
    VCVTf2xsq	= 618,
    VCVTf2xud	= 619,
    VCVTf2xuq	= 620,
    VCVTs2fd	= 621,
    VCVTs2fd_sfp	= 622,
    VCVTs2fq	= 623,
    VCVTu2fd	= 624,
    VCVTu2fd_sfp	= 625,
    VCVTu2fq	= 626,
    VCVTxs2fd	= 627,
    VCVTxs2fq	= 628,
    VCVTxu2fd	= 629,
    VCVTxu2fq	= 630,
    VDIVD	= 631,
    VDIVS	= 632,
    VDUP16d	= 633,
    VDUP16q	= 634,
    VDUP32d	= 635,
    VDUP32q	= 636,
    VDUP8d	= 637,
    VDUP8q	= 638,
    VDUPLN16d	= 639,
    VDUPLN16q	= 640,
    VDUPLN32d	= 641,
    VDUPLN32q	= 642,
    VDUPLN8d	= 643,
    VDUPLN8q	= 644,
    VDUPLNfd	= 645,
    VDUPLNfq	= 646,
    VDUPfd	= 647,
    VDUPfdf	= 648,
    VDUPfq	= 649,
    VDUPfqf	= 650,
    VEORd	= 651,
    VEORq	= 652,
    VEXTd16	= 653,
    VEXTd32	= 654,
    VEXTd8	= 655,
    VEXTdf	= 656,
    VEXTq16	= 657,
    VEXTq32	= 658,
    VEXTq8	= 659,
    VEXTqf	= 660,
    VGETLNi32	= 661,
    VGETLNs16	= 662,
    VGETLNs8	= 663,
    VGETLNu16	= 664,
    VGETLNu8	= 665,
    VHADDsv16i8	= 666,
    VHADDsv2i32	= 667,
    VHADDsv4i16	= 668,
    VHADDsv4i32	= 669,
    VHADDsv8i16	= 670,
    VHADDsv8i8	= 671,
    VHADDuv16i8	= 672,
    VHADDuv2i32	= 673,
    VHADDuv4i16	= 674,
    VHADDuv4i32	= 675,
    VHADDuv8i16	= 676,
    VHADDuv8i8	= 677,
    VHSUBsv16i8	= 678,
    VHSUBsv2i32	= 679,
    VHSUBsv4i16	= 680,
    VHSUBsv4i32	= 681,
    VHSUBsv8i16	= 682,
    VHSUBsv8i8	= 683,
    VHSUBuv16i8	= 684,
    VHSUBuv2i32	= 685,
    VHSUBuv4i16	= 686,
    VHSUBuv4i32	= 687,
    VHSUBuv8i16	= 688,
    VHSUBuv8i8	= 689,
    VLD1d16	= 690,
    VLD1d16Q	= 691,
    VLD1d16T	= 692,
    VLD1d32	= 693,
    VLD1d32Q	= 694,
    VLD1d32T	= 695,
    VLD1d64	= 696,
    VLD1d8	= 697,
    VLD1d8Q	= 698,
    VLD1d8T	= 699,
    VLD1df	= 700,
    VLD1q16	= 701,
    VLD1q32	= 702,
    VLD1q64	= 703,
    VLD1q8	= 704,
    VLD1qf	= 705,
    VLD2LNd16	= 706,
    VLD2LNd32	= 707,
    VLD2LNd8	= 708,
    VLD2LNq16a	= 709,
    VLD2LNq16b	= 710,
    VLD2LNq32a	= 711,
    VLD2LNq32b	= 712,
    VLD2d16	= 713,
    VLD2d16D	= 714,
    VLD2d32	= 715,
    VLD2d32D	= 716,
    VLD2d64	= 717,
    VLD2d8	= 718,
    VLD2d8D	= 719,
    VLD2q16	= 720,
    VLD2q32	= 721,
    VLD2q8	= 722,
    VLD3LNd16	= 723,
    VLD3LNd32	= 724,
    VLD3LNd8	= 725,
    VLD3LNq16a	= 726,
    VLD3LNq16b	= 727,
    VLD3LNq32a	= 728,
    VLD3LNq32b	= 729,
    VLD3d16	= 730,
    VLD3d32	= 731,
    VLD3d64	= 732,
    VLD3d8	= 733,
    VLD3q16a	= 734,
    VLD3q16b	= 735,
    VLD3q32a	= 736,
    VLD3q32b	= 737,
    VLD3q8a	= 738,
    VLD3q8b	= 739,
    VLD4LNd16	= 740,
    VLD4LNd32	= 741,
    VLD4LNd8	= 742,
    VLD4LNq16a	= 743,
    VLD4LNq16b	= 744,
    VLD4LNq32a	= 745,
    VLD4LNq32b	= 746,
    VLD4d16	= 747,
    VLD4d32	= 748,
    VLD4d64	= 749,
    VLD4d8	= 750,
    VLD4q16a	= 751,
    VLD4q16b	= 752,
    VLD4q32a	= 753,
    VLD4q32b	= 754,
    VLD4q8a	= 755,
    VLD4q8b	= 756,
    VLDMD	= 757,
    VLDMS	= 758,
    VLDRD	= 759,
    VLDRQ	= 760,
    VLDRS	= 761,
    VMAXfd	= 762,
    VMAXfd_sfp	= 763,
    VMAXfq	= 764,
    VMAXsv16i8	= 765,
    VMAXsv2i32	= 766,
    VMAXsv4i16	= 767,
    VMAXsv4i32	= 768,
    VMAXsv8i16	= 769,
    VMAXsv8i8	= 770,
    VMAXuv16i8	= 771,
    VMAXuv2i32	= 772,
    VMAXuv4i16	= 773,
    VMAXuv4i32	= 774,
    VMAXuv8i16	= 775,
    VMAXuv8i8	= 776,
    VMINfd	= 777,
    VMINfd_sfp	= 778,
    VMINfq	= 779,
    VMINsv16i8	= 780,
    VMINsv2i32	= 781,
    VMINsv4i16	= 782,
    VMINsv4i32	= 783,
    VMINsv8i16	= 784,
    VMINsv8i8	= 785,
    VMINuv16i8	= 786,
    VMINuv2i32	= 787,
    VMINuv4i16	= 788,
    VMINuv4i32	= 789,
    VMINuv8i16	= 790,
    VMINuv8i8	= 791,
    VMLAD	= 792,
    VMLALslsv2i32	= 793,
    VMLALslsv4i16	= 794,
    VMLALsluv2i32	= 795,
    VMLALsluv4i16	= 796,
    VMLALsv2i64	= 797,
    VMLALsv4i32	= 798,
    VMLALsv8i16	= 799,
    VMLALuv2i64	= 800,
    VMLALuv4i32	= 801,
    VMLALuv8i16	= 802,
    VMLAS	= 803,
    VMLAfd	= 804,
    VMLAfq	= 805,
    VMLAslfd	= 806,
    VMLAslfq	= 807,
    VMLAslv2i32	= 808,
    VMLAslv4i16	= 809,
    VMLAslv4i32	= 810,
    VMLAslv8i16	= 811,
    VMLAv16i8	= 812,
    VMLAv2i32	= 813,
    VMLAv4i16	= 814,
    VMLAv4i32	= 815,
    VMLAv8i16	= 816,
    VMLAv8i8	= 817,
    VMLSD	= 818,
    VMLSLslsv2i32	= 819,
    VMLSLslsv4i16	= 820,
    VMLSLsluv2i32	= 821,
    VMLSLsluv4i16	= 822,
    VMLSLsv2i64	= 823,
    VMLSLsv4i32	= 824,
    VMLSLsv8i16	= 825,
    VMLSLuv2i64	= 826,
    VMLSLuv4i32	= 827,
    VMLSLuv8i16	= 828,
    VMLSS	= 829,
    VMLSfd	= 830,
    VMLSfq	= 831,
    VMLSslfd	= 832,
    VMLSslfq	= 833,
    VMLSslv2i32	= 834,
    VMLSslv4i16	= 835,
    VMLSslv4i32	= 836,
    VMLSslv8i16	= 837,
    VMLSv16i8	= 838,
    VMLSv2i32	= 839,
    VMLSv4i16	= 840,
    VMLSv4i32	= 841,
    VMLSv8i16	= 842,
    VMLSv8i8	= 843,
    VMOVD	= 844,
    VMOVDRR	= 845,
    VMOVDcc	= 846,
    VMOVDneon	= 847,
    VMOVLsv2i64	= 848,
    VMOVLsv4i32	= 849,
    VMOVLsv8i16	= 850,
    VMOVLuv2i64	= 851,
    VMOVLuv4i32	= 852,
    VMOVLuv8i16	= 853,
    VMOVNv2i32	= 854,
    VMOVNv4i16	= 855,
    VMOVNv8i8	= 856,
    VMOVQ	= 857,
    VMOVRRD	= 858,
    VMOVRRS	= 859,
    VMOVRS	= 860,
    VMOVS	= 861,
    VMOVSR	= 862,
    VMOVSRR	= 863,
    VMOVScc	= 864,
    VMOVv16i8	= 865,
    VMOVv1i64	= 866,
    VMOVv2i32	= 867,
    VMOVv2i64	= 868,
    VMOVv4i16	= 869,
    VMOVv4i32	= 870,
    VMOVv8i16	= 871,
    VMOVv8i8	= 872,
    VMRS	= 873,
    VMSR	= 874,
    VMULD	= 875,
    VMULLp	= 876,
    VMULLslsv2i32	= 877,
    VMULLslsv4i16	= 878,
    VMULLsluv2i32	= 879,
    VMULLsluv4i16	= 880,
    VMULLsv2i64	= 881,
    VMULLsv4i32	= 882,
    VMULLsv8i16	= 883,
    VMULLuv2i64	= 884,
    VMULLuv4i32	= 885,
    VMULLuv8i16	= 886,
    VMULS	= 887,
    VMULfd	= 888,
    VMULfd_sfp	= 889,
    VMULfq	= 890,
    VMULpd	= 891,
    VMULpq	= 892,
    VMULslfd	= 893,
    VMULslfq	= 894,
    VMULslv2i32	= 895,
    VMULslv4i16	= 896,
    VMULslv4i32	= 897,
    VMULslv8i16	= 898,
    VMULv16i8	= 899,
    VMULv2i32	= 900,
    VMULv4i16	= 901,
    VMULv4i32	= 902,
    VMULv8i16	= 903,
    VMULv8i8	= 904,
    VMVNd	= 905,
    VMVNq	= 906,
    VNEGD	= 907,
    VNEGDcc	= 908,
    VNEGS	= 909,
    VNEGScc	= 910,
    VNEGf32q	= 911,
    VNEGfd	= 912,
    VNEGfd_sfp	= 913,
    VNEGs16d	= 914,
    VNEGs16q	= 915,
    VNEGs32d	= 916,
    VNEGs32q	= 917,
    VNEGs8d	= 918,
    VNEGs8q	= 919,
    VNMLAD	= 920,
    VNMLAS	= 921,
    VNMLSD	= 922,
    VNMLSS	= 923,
    VNMULD	= 924,
    VNMULS	= 925,
    VORNd	= 926,
    VORNq	= 927,
    VORRd	= 928,
    VORRq	= 929,
    VPADALsv16i8	= 930,
    VPADALsv2i32	= 931,
    VPADALsv4i16	= 932,
    VPADALsv4i32	= 933,
    VPADALsv8i16	= 934,
    VPADALsv8i8	= 935,
    VPADALuv16i8	= 936,
    VPADALuv2i32	= 937,
    VPADALuv4i16	= 938,
    VPADALuv4i32	= 939,
    VPADALuv8i16	= 940,
    VPADALuv8i8	= 941,
    VPADDLsv16i8	= 942,
    VPADDLsv2i32	= 943,
    VPADDLsv4i16	= 944,
    VPADDLsv4i32	= 945,
    VPADDLsv8i16	= 946,
    VPADDLsv8i8	= 947,
    VPADDLuv16i8	= 948,
    VPADDLuv2i32	= 949,
    VPADDLuv4i16	= 950,
    VPADDLuv4i32	= 951,
    VPADDLuv8i16	= 952,
    VPADDLuv8i8	= 953,
    VPADDf	= 954,
    VPADDi16	= 955,
    VPADDi32	= 956,
    VPADDi8	= 957,
    VPMAXf	= 958,
    VPMAXs16	= 959,
    VPMAXs32	= 960,
    VPMAXs8	= 961,
    VPMAXu16	= 962,
    VPMAXu32	= 963,
    VPMAXu8	= 964,
    VPMINf	= 965,
    VPMINs16	= 966,
    VPMINs32	= 967,
    VPMINs8	= 968,
    VPMINu16	= 969,
    VPMINu32	= 970,
    VPMINu8	= 971,
    VQABSv16i8	= 972,
    VQABSv2i32	= 973,
    VQABSv4i16	= 974,
    VQABSv4i32	= 975,
    VQABSv8i16	= 976,
    VQABSv8i8	= 977,
    VQADDsv16i8	= 978,
    VQADDsv1i64	= 979,
    VQADDsv2i32	= 980,
    VQADDsv2i64	= 981,
    VQADDsv4i16	= 982,
    VQADDsv4i32	= 983,
    VQADDsv8i16	= 984,
    VQADDsv8i8	= 985,
    VQADDuv16i8	= 986,
    VQADDuv1i64	= 987,
    VQADDuv2i32	= 988,
    VQADDuv2i64	= 989,
    VQADDuv4i16	= 990,
    VQADDuv4i32	= 991,
    VQADDuv8i16	= 992,
    VQADDuv8i8	= 993,
    VQDMLALslv2i32	= 994,
    VQDMLALslv4i16	= 995,
    VQDMLALv2i64	= 996,
    VQDMLALv4i32	= 997,
    VQDMLSLslv2i32	= 998,
    VQDMLSLslv4i16	= 999,
    VQDMLSLv2i64	= 1000,
    VQDMLSLv4i32	= 1001,
    VQDMULHslv2i32	= 1002,
    VQDMULHslv4i16	= 1003,
    VQDMULHslv4i32	= 1004,
    VQDMULHslv8i16	= 1005,
    VQDMULHv2i32	= 1006,
    VQDMULHv4i16	= 1007,
    VQDMULHv4i32	= 1008,
    VQDMULHv8i16	= 1009,
    VQDMULLslv2i32	= 1010,
    VQDMULLslv4i16	= 1011,
    VQDMULLv2i64	= 1012,
    VQDMULLv4i32	= 1013,
    VQMOVNsuv2i32	= 1014,
    VQMOVNsuv4i16	= 1015,
    VQMOVNsuv8i8	= 1016,
    VQMOVNsv2i32	= 1017,
    VQMOVNsv4i16	= 1018,
    VQMOVNsv8i8	= 1019,
    VQMOVNuv2i32	= 1020,
    VQMOVNuv4i16	= 1021,
    VQMOVNuv8i8	= 1022,
    VQNEGv16i8	= 1023,
    VQNEGv2i32	= 1024,
    VQNEGv4i16	= 1025,
    VQNEGv4i32	= 1026,
    VQNEGv8i16	= 1027,
    VQNEGv8i8	= 1028,
    VQRDMULHslv2i32	= 1029,
    VQRDMULHslv4i16	= 1030,
    VQRDMULHslv4i32	= 1031,
    VQRDMULHslv8i16	= 1032,
    VQRDMULHv2i32	= 1033,
    VQRDMULHv4i16	= 1034,
    VQRDMULHv4i32	= 1035,
    VQRDMULHv8i16	= 1036,
    VQRSHLsv16i8	= 1037,
    VQRSHLsv1i64	= 1038,
    VQRSHLsv2i32	= 1039,
    VQRSHLsv2i64	= 1040,
    VQRSHLsv4i16	= 1041,
    VQRSHLsv4i32	= 1042,
    VQRSHLsv8i16	= 1043,
    VQRSHLsv8i8	= 1044,
    VQRSHLuv16i8	= 1045,
    VQRSHLuv1i64	= 1046,
    VQRSHLuv2i32	= 1047,
    VQRSHLuv2i64	= 1048,
    VQRSHLuv4i16	= 1049,
    VQRSHLuv4i32	= 1050,
    VQRSHLuv8i16	= 1051,
    VQRSHLuv8i8	= 1052,
    VQRSHRNsv2i32	= 1053,
    VQRSHRNsv4i16	= 1054,
    VQRSHRNsv8i8	= 1055,
    VQRSHRNuv2i32	= 1056,
    VQRSHRNuv4i16	= 1057,
    VQRSHRNuv8i8	= 1058,
    VQRSHRUNv2i32	= 1059,
    VQRSHRUNv4i16	= 1060,
    VQRSHRUNv8i8	= 1061,
    VQSHLsiv16i8	= 1062,
    VQSHLsiv1i64	= 1063,
    VQSHLsiv2i32	= 1064,
    VQSHLsiv2i64	= 1065,
    VQSHLsiv4i16	= 1066,
    VQSHLsiv4i32	= 1067,
    VQSHLsiv8i16	= 1068,
    VQSHLsiv8i8	= 1069,
    VQSHLsuv16i8	= 1070,
    VQSHLsuv1i64	= 1071,
    VQSHLsuv2i32	= 1072,
    VQSHLsuv2i64	= 1073,
    VQSHLsuv4i16	= 1074,
    VQSHLsuv4i32	= 1075,
    VQSHLsuv8i16	= 1076,
    VQSHLsuv8i8	= 1077,
    VQSHLsv16i8	= 1078,
    VQSHLsv1i64	= 1079,
    VQSHLsv2i32	= 1080,
    VQSHLsv2i64	= 1081,
    VQSHLsv4i16	= 1082,
    VQSHLsv4i32	= 1083,
    VQSHLsv8i16	= 1084,
    VQSHLsv8i8	= 1085,
    VQSHLuiv16i8	= 1086,
    VQSHLuiv1i64	= 1087,
    VQSHLuiv2i32	= 1088,
    VQSHLuiv2i64	= 1089,
    VQSHLuiv4i16	= 1090,
    VQSHLuiv4i32	= 1091,
    VQSHLuiv8i16	= 1092,
    VQSHLuiv8i8	= 1093,
    VQSHLuv16i8	= 1094,
    VQSHLuv1i64	= 1095,
    VQSHLuv2i32	= 1096,
    VQSHLuv2i64	= 1097,
    VQSHLuv4i16	= 1098,
    VQSHLuv4i32	= 1099,
    VQSHLuv8i16	= 1100,
    VQSHLuv8i8	= 1101,
    VQSHRNsv2i32	= 1102,
    VQSHRNsv4i16	= 1103,
    VQSHRNsv8i8	= 1104,
    VQSHRNuv2i32	= 1105,
    VQSHRNuv4i16	= 1106,
    VQSHRNuv8i8	= 1107,
    VQSHRUNv2i32	= 1108,
    VQSHRUNv4i16	= 1109,
    VQSHRUNv8i8	= 1110,
    VQSUBsv16i8	= 1111,
    VQSUBsv1i64	= 1112,
    VQSUBsv2i32	= 1113,
    VQSUBsv2i64	= 1114,
    VQSUBsv4i16	= 1115,
    VQSUBsv4i32	= 1116,
    VQSUBsv8i16	= 1117,
    VQSUBsv8i8	= 1118,
    VQSUBuv16i8	= 1119,
    VQSUBuv1i64	= 1120,
    VQSUBuv2i32	= 1121,
    VQSUBuv2i64	= 1122,
    VQSUBuv4i16	= 1123,
    VQSUBuv4i32	= 1124,
    VQSUBuv8i16	= 1125,
    VQSUBuv8i8	= 1126,
    VRADDHNv2i32	= 1127,
    VRADDHNv4i16	= 1128,
    VRADDHNv8i8	= 1129,
    VRECPEd	= 1130,
    VRECPEfd	= 1131,
    VRECPEfq	= 1132,
    VRECPEq	= 1133,
    VRECPSfd	= 1134,
    VRECPSfq	= 1135,
    VREV16d8	= 1136,
    VREV16q8	= 1137,
    VREV32d16	= 1138,
    VREV32d8	= 1139,
    VREV32q16	= 1140,
    VREV32q8	= 1141,
    VREV64d16	= 1142,
    VREV64d32	= 1143,
    VREV64d8	= 1144,
    VREV64df	= 1145,
    VREV64q16	= 1146,
    VREV64q32	= 1147,
    VREV64q8	= 1148,
    VREV64qf	= 1149,
    VRHADDsv16i8	= 1150,
    VRHADDsv2i32	= 1151,
    VRHADDsv4i16	= 1152,
    VRHADDsv4i32	= 1153,
    VRHADDsv8i16	= 1154,
    VRHADDsv8i8	= 1155,
    VRHADDuv16i8	= 1156,
    VRHADDuv2i32	= 1157,
    VRHADDuv4i16	= 1158,
    VRHADDuv4i32	= 1159,
    VRHADDuv8i16	= 1160,
    VRHADDuv8i8	= 1161,
    VRSHLsv16i8	= 1162,
    VRSHLsv1i64	= 1163,
    VRSHLsv2i32	= 1164,
    VRSHLsv2i64	= 1165,
    VRSHLsv4i16	= 1166,
    VRSHLsv4i32	= 1167,
    VRSHLsv8i16	= 1168,
    VRSHLsv8i8	= 1169,
    VRSHLuv16i8	= 1170,
    VRSHLuv1i64	= 1171,
    VRSHLuv2i32	= 1172,
    VRSHLuv2i64	= 1173,
    VRSHLuv4i16	= 1174,
    VRSHLuv4i32	= 1175,
    VRSHLuv8i16	= 1176,
    VRSHLuv8i8	= 1177,
    VRSHRNv2i32	= 1178,
    VRSHRNv4i16	= 1179,
    VRSHRNv8i8	= 1180,
    VRSHRsv16i8	= 1181,
    VRSHRsv1i64	= 1182,
    VRSHRsv2i32	= 1183,
    VRSHRsv2i64	= 1184,
    VRSHRsv4i16	= 1185,
    VRSHRsv4i32	= 1186,
    VRSHRsv8i16	= 1187,
    VRSHRsv8i8	= 1188,
    VRSHRuv16i8	= 1189,
    VRSHRuv1i64	= 1190,
    VRSHRuv2i32	= 1191,
    VRSHRuv2i64	= 1192,
    VRSHRuv4i16	= 1193,
    VRSHRuv4i32	= 1194,
    VRSHRuv8i16	= 1195,
    VRSHRuv8i8	= 1196,
    VRSQRTEd	= 1197,
    VRSQRTEfd	= 1198,
    VRSQRTEfq	= 1199,
    VRSQRTEq	= 1200,
    VRSQRTSfd	= 1201,
    VRSQRTSfq	= 1202,
    VRSRAsv16i8	= 1203,
    VRSRAsv1i64	= 1204,
    VRSRAsv2i32	= 1205,
    VRSRAsv2i64	= 1206,
    VRSRAsv4i16	= 1207,
    VRSRAsv4i32	= 1208,
    VRSRAsv8i16	= 1209,
    VRSRAsv8i8	= 1210,
    VRSRAuv16i8	= 1211,
    VRSRAuv1i64	= 1212,
    VRSRAuv2i32	= 1213,
    VRSRAuv2i64	= 1214,
    VRSRAuv4i16	= 1215,
    VRSRAuv4i32	= 1216,
    VRSRAuv8i16	= 1217,
    VRSRAuv8i8	= 1218,
    VRSUBHNv2i32	= 1219,
    VRSUBHNv4i16	= 1220,
    VRSUBHNv8i8	= 1221,
    VSETLNi16	= 1222,
    VSETLNi32	= 1223,
    VSETLNi8	= 1224,
    VSHLLi16	= 1225,
    VSHLLi32	= 1226,
    VSHLLi8	= 1227,
    VSHLLsv2i64	= 1228,
    VSHLLsv4i32	= 1229,
    VSHLLsv8i16	= 1230,
    VSHLLuv2i64	= 1231,
    VSHLLuv4i32	= 1232,
    VSHLLuv8i16	= 1233,
    VSHLiv16i8	= 1234,
    VSHLiv1i64	= 1235,
    VSHLiv2i32	= 1236,
    VSHLiv2i64	= 1237,
    VSHLiv4i16	= 1238,
    VSHLiv4i32	= 1239,
    VSHLiv8i16	= 1240,
    VSHLiv8i8	= 1241,
    VSHLsv16i8	= 1242,
    VSHLsv1i64	= 1243,
    VSHLsv2i32	= 1244,
    VSHLsv2i64	= 1245,
    VSHLsv4i16	= 1246,
    VSHLsv4i32	= 1247,
    VSHLsv8i16	= 1248,
    VSHLsv8i8	= 1249,
    VSHLuv16i8	= 1250,
    VSHLuv1i64	= 1251,
    VSHLuv2i32	= 1252,
    VSHLuv2i64	= 1253,
    VSHLuv4i16	= 1254,
    VSHLuv4i32	= 1255,
    VSHLuv8i16	= 1256,
    VSHLuv8i8	= 1257,
    VSHRNv2i32	= 1258,
    VSHRNv4i16	= 1259,
    VSHRNv8i8	= 1260,
    VSHRsv16i8	= 1261,
    VSHRsv1i64	= 1262,
    VSHRsv2i32	= 1263,
    VSHRsv2i64	= 1264,
    VSHRsv4i16	= 1265,
    VSHRsv4i32	= 1266,
    VSHRsv8i16	= 1267,
    VSHRsv8i8	= 1268,
    VSHRuv16i8	= 1269,
    VSHRuv1i64	= 1270,
    VSHRuv2i32	= 1271,
    VSHRuv2i64	= 1272,
    VSHRuv4i16	= 1273,
    VSHRuv4i32	= 1274,
    VSHRuv8i16	= 1275,
    VSHRuv8i8	= 1276,
    VSHTOD	= 1277,
    VSHTOS	= 1278,
    VSITOD	= 1279,
    VSITOS	= 1280,
    VSLIv16i8	= 1281,
    VSLIv1i64	= 1282,
    VSLIv2i32	= 1283,
    VSLIv2i64	= 1284,
    VSLIv4i16	= 1285,
    VSLIv4i32	= 1286,
    VSLIv8i16	= 1287,
    VSLIv8i8	= 1288,
    VSLTOD	= 1289,
    VSLTOS	= 1290,
    VSQRTD	= 1291,
    VSQRTS	= 1292,
    VSRAsv16i8	= 1293,
    VSRAsv1i64	= 1294,
    VSRAsv2i32	= 1295,
    VSRAsv2i64	= 1296,
    VSRAsv4i16	= 1297,
    VSRAsv4i32	= 1298,
    VSRAsv8i16	= 1299,
    VSRAsv8i8	= 1300,
    VSRAuv16i8	= 1301,
    VSRAuv1i64	= 1302,
    VSRAuv2i32	= 1303,
    VSRAuv2i64	= 1304,
    VSRAuv4i16	= 1305,
    VSRAuv4i32	= 1306,
    VSRAuv8i16	= 1307,
    VSRAuv8i8	= 1308,
    VSRIv16i8	= 1309,
    VSRIv1i64	= 1310,
    VSRIv2i32	= 1311,
    VSRIv2i64	= 1312,
    VSRIv4i16	= 1313,
    VSRIv4i32	= 1314,
    VSRIv8i16	= 1315,
    VSRIv8i8	= 1316,
    VST1d16	= 1317,
    VST1d16Q	= 1318,
    VST1d16T	= 1319,
    VST1d32	= 1320,
    VST1d32Q	= 1321,
    VST1d32T	= 1322,
    VST1d64	= 1323,
    VST1d8	= 1324,
    VST1d8Q	= 1325,
    VST1d8T	= 1326,
    VST1df	= 1327,
    VST1q16	= 1328,
    VST1q32	= 1329,
    VST1q64	= 1330,
    VST1q8	= 1331,
    VST1qf	= 1332,
    VST2LNd16	= 1333,
    VST2LNd32	= 1334,
    VST2LNd8	= 1335,
    VST2LNq16a	= 1336,
    VST2LNq16b	= 1337,
    VST2LNq32a	= 1338,
    VST2LNq32b	= 1339,
    VST2d16	= 1340,
    VST2d16D	= 1341,
    VST2d32	= 1342,
    VST2d32D	= 1343,
    VST2d64	= 1344,
    VST2d8	= 1345,
    VST2d8D	= 1346,
    VST2q16	= 1347,
    VST2q32	= 1348,
    VST2q8	= 1349,
    VST3LNd16	= 1350,
    VST3LNd32	= 1351,
    VST3LNd8	= 1352,
    VST3LNq16a	= 1353,
    VST3LNq16b	= 1354,
    VST3LNq32a	= 1355,
    VST3LNq32b	= 1356,
    VST3d16	= 1357,
    VST3d32	= 1358,
    VST3d64	= 1359,
    VST3d8	= 1360,
    VST3q16a	= 1361,
    VST3q16b	= 1362,
    VST3q32a	= 1363,
    VST3q32b	= 1364,
    VST3q8a	= 1365,
    VST3q8b	= 1366,
    VST4LNd16	= 1367,
    VST4LNd32	= 1368,
    VST4LNd8	= 1369,
    VST4LNq16a	= 1370,
    VST4LNq16b	= 1371,
    VST4LNq32a	= 1372,
    VST4LNq32b	= 1373,
    VST4d16	= 1374,
    VST4d32	= 1375,
    VST4d64	= 1376,
    VST4d8	= 1377,
    VST4q16a	= 1378,
    VST4q16b	= 1379,
    VST4q32a	= 1380,
    VST4q32b	= 1381,
    VST4q8a	= 1382,
    VST4q8b	= 1383,
    VSTMD	= 1384,
    VSTMS	= 1385,
    VSTRD	= 1386,
    VSTRQ	= 1387,
    VSTRS	= 1388,
    VSUBD	= 1389,
    VSUBHNv2i32	= 1390,
    VSUBHNv4i16	= 1391,
    VSUBHNv8i8	= 1392,
    VSUBLsv2i64	= 1393,
    VSUBLsv4i32	= 1394,
    VSUBLsv8i16	= 1395,
    VSUBLuv2i64	= 1396,
    VSUBLuv4i32	= 1397,
    VSUBLuv8i16	= 1398,
    VSUBS	= 1399,
    VSUBWsv2i64	= 1400,
    VSUBWsv4i32	= 1401,
    VSUBWsv8i16	= 1402,
    VSUBWuv2i64	= 1403,
    VSUBWuv4i32	= 1404,
    VSUBWuv8i16	= 1405,
    VSUBfd	= 1406,
    VSUBfd_sfp	= 1407,
    VSUBfq	= 1408,
    VSUBv16i8	= 1409,
    VSUBv1i64	= 1410,
    VSUBv2i32	= 1411,
    VSUBv2i64	= 1412,
    VSUBv4i16	= 1413,
    VSUBv4i32	= 1414,
    VSUBv8i16	= 1415,
    VSUBv8i8	= 1416,
    VSWPd	= 1417,
    VSWPq	= 1418,
    VTBL1	= 1419,
    VTBL2	= 1420,
    VTBL3	= 1421,
    VTBL4	= 1422,
    VTBX1	= 1423,
    VTBX2	= 1424,
    VTBX3	= 1425,
    VTBX4	= 1426,
    VTOSHD	= 1427,
    VTOSHS	= 1428,
    VTOSIRD	= 1429,
    VTOSIRS	= 1430,
    VTOSIZD	= 1431,
    VTOSIZS	= 1432,
    VTOSLD	= 1433,
    VTOSLS	= 1434,
    VTOUHD	= 1435,
    VTOUHS	= 1436,
    VTOUIRD	= 1437,
    VTOUIRS	= 1438,
    VTOUIZD	= 1439,
    VTOUIZS	= 1440,
    VTOULD	= 1441,
    VTOULS	= 1442,
    VTRNd16	= 1443,
    VTRNd32	= 1444,
    VTRNd8	= 1445,
    VTRNq16	= 1446,
    VTRNq32	= 1447,
    VTRNq8	= 1448,
    VTSTv16i8	= 1449,
    VTSTv2i32	= 1450,
    VTSTv4i16	= 1451,
    VTSTv4i32	= 1452,
    VTSTv8i16	= 1453,
    VTSTv8i8	= 1454,
    VUHTOD	= 1455,
    VUHTOS	= 1456,
    VUITOD	= 1457,
    VUITOS	= 1458,
    VULTOD	= 1459,
    VULTOS	= 1460,
    VUZPd16	= 1461,
    VUZPd32	= 1462,
    VUZPd8	= 1463,
    VUZPq16	= 1464,
    VUZPq32	= 1465,
    VUZPq8	= 1466,
    VZIPd16	= 1467,
    VZIPd32	= 1468,
    VZIPd8	= 1469,
    VZIPq16	= 1470,
    VZIPq32	= 1471,
    VZIPq8	= 1472,
    WFE	= 1473,
    WFI	= 1474,
    YIELD	= 1475,
    t2ADCSri	= 1476,
    t2ADCSrr	= 1477,
    t2ADCSrs	= 1478,
    t2ADCri	= 1479,
    t2ADCrr	= 1480,
    t2ADCrs	= 1481,
    t2ADDSri	= 1482,
    t2ADDSrr	= 1483,
    t2ADDSrs	= 1484,
    t2ADDrSPi	= 1485,
    t2ADDrSPi12	= 1486,
    t2ADDrSPs	= 1487,
    t2ADDri	= 1488,
    t2ADDri12	= 1489,
    t2ADDrr	= 1490,
    t2ADDrs	= 1491,
    t2ANDri	= 1492,
    t2ANDrr	= 1493,
    t2ANDrs	= 1494,
    t2ASRri	= 1495,
    t2ASRrr	= 1496,
    t2B	= 1497,
    t2BFC	= 1498,
    t2BFI	= 1499,
    t2BICri	= 1500,
    t2BICrr	= 1501,
    t2BICrs	= 1502,
    t2BR_JT	= 1503,
    t2BXJ	= 1504,
    t2Bcc	= 1505,
    t2CLREX	= 1506,
    t2CLZ	= 1507,
    t2CMNzri	= 1508,
    t2CMNzrr	= 1509,
    t2CMNzrs	= 1510,
    t2CMPri	= 1511,
    t2CMPrr	= 1512,
    t2CMPrs	= 1513,
    t2CMPzri	= 1514,
    t2CMPzrr	= 1515,
    t2CMPzrs	= 1516,
    t2CPS	= 1517,
    t2DBG	= 1518,
    t2DMBish	= 1519,
    t2DMBishst	= 1520,
    t2DMBnsh	= 1521,
    t2DMBnshst	= 1522,
    t2DMBosh	= 1523,
    t2DMBoshst	= 1524,
    t2DMBst	= 1525,
    t2DSBish	= 1526,
    t2DSBishst	= 1527,
    t2DSBnsh	= 1528,
    t2DSBnshst	= 1529,
    t2DSBosh	= 1530,
    t2DSBoshst	= 1531,
    t2DSBst	= 1532,
    t2EORri	= 1533,
    t2EORrr	= 1534,
    t2EORrs	= 1535,
    t2ISBsy	= 1536,
    t2IT	= 1537,
    t2Int_MemBarrierV7	= 1538,
    t2Int_SyncBarrierV7	= 1539,
    t2Int_eh_sjlj_setjmp	= 1540,
    t2LDM	= 1541,
    t2LDM_RET	= 1542,
    t2LDRBT	= 1543,
    t2LDRB_POST	= 1544,
    t2LDRB_PRE	= 1545,
    t2LDRBi12	= 1546,
    t2LDRBi8	= 1547,
    t2LDRBpci	= 1548,
    t2LDRBs	= 1549,
    t2LDRDi8	= 1550,
    t2LDRDpci	= 1551,
    t2LDREX	= 1552,
    t2LDREXB	= 1553,
    t2LDREXD	= 1554,
    t2LDREXH	= 1555,
    t2LDRHT	= 1556,
    t2LDRH_POST	= 1557,
    t2LDRH_PRE	= 1558,
    t2LDRHi12	= 1559,
    t2LDRHi8	= 1560,
    t2LDRHpci	= 1561,
    t2LDRHs	= 1562,
    t2LDRSBT	= 1563,
    t2LDRSB_POST	= 1564,
    t2LDRSB_PRE	= 1565,
    t2LDRSBi12	= 1566,
    t2LDRSBi8	= 1567,
    t2LDRSBpci	= 1568,
    t2LDRSBs	= 1569,
    t2LDRSHT	= 1570,
    t2LDRSH_POST	= 1571,
    t2LDRSH_PRE	= 1572,
    t2LDRSHi12	= 1573,
    t2LDRSHi8	= 1574,
    t2LDRSHpci	= 1575,
    t2LDRSHs	= 1576,
    t2LDRT	= 1577,
    t2LDR_POST	= 1578,
    t2LDR_PRE	= 1579,
    t2LDRi12	= 1580,
    t2LDRi8	= 1581,
    t2LDRpci	= 1582,
    t2LDRpci_pic	= 1583,
    t2LDRs	= 1584,
    t2LEApcrel	= 1585,
    t2LEApcrelJT	= 1586,
    t2LSLri	= 1587,
    t2LSLrr	= 1588,
    t2LSRri	= 1589,
    t2LSRrr	= 1590,
    t2MLA	= 1591,
    t2MLS	= 1592,
    t2MOVCCasr	= 1593,
    t2MOVCCi	= 1594,
    t2MOVCClsl	= 1595,
    t2MOVCClsr	= 1596,
    t2MOVCCr	= 1597,
    t2MOVCCror	= 1598,
    t2MOVTi16	= 1599,
    t2MOVi	= 1600,
    t2MOVi16	= 1601,
    t2MOVi32imm	= 1602,
    t2MOVr	= 1603,
    t2MOVrx	= 1604,
    t2MOVsra_flag	= 1605,
    t2MOVsrl_flag	= 1606,
    t2MRS	= 1607,
    t2MRSsys	= 1608,
    t2MSR	= 1609,
    t2MSRsys	= 1610,
    t2MUL	= 1611,
    t2MVNi	= 1612,
    t2MVNr	= 1613,
    t2MVNs	= 1614,
    t2NOP	= 1615,
    t2ORNri	= 1616,
    t2ORNrr	= 1617,
    t2ORNrs	= 1618,
    t2ORRri	= 1619,
    t2ORRrr	= 1620,
    t2ORRrs	= 1621,
    t2PKHBT	= 1622,
    t2PKHTB	= 1623,
    t2PLDWi12	= 1624,
    t2PLDWi8	= 1625,
    t2PLDWpci	= 1626,
    t2PLDWr	= 1627,
    t2PLDWs	= 1628,
    t2PLDi12	= 1629,
    t2PLDi8	= 1630,
    t2PLDpci	= 1631,
    t2PLDr	= 1632,
    t2PLDs	= 1633,
    t2PLIi12	= 1634,
    t2PLIi8	= 1635,
    t2PLIpci	= 1636,
    t2PLIr	= 1637,
    t2PLIs	= 1638,
    t2QADD	= 1639,
    t2QADD16	= 1640,
    t2QADD8	= 1641,
    t2QASX	= 1642,
    t2QDADD	= 1643,
    t2QDSUB	= 1644,
    t2QSAX	= 1645,
    t2QSUB	= 1646,
    t2QSUB16	= 1647,
    t2QSUB8	= 1648,
    t2RBIT	= 1649,
    t2REV	= 1650,
    t2REV16	= 1651,
    t2REVSH	= 1652,
    t2RFEDB	= 1653,
    t2RFEDBW	= 1654,
    t2RFEIA	= 1655,
    t2RFEIAW	= 1656,
    t2RORri	= 1657,
    t2RORrr	= 1658,
    t2RSBSri	= 1659,
    t2RSBSrs	= 1660,
    t2RSBri	= 1661,
    t2RSBrs	= 1662,
    t2SADD16	= 1663,
    t2SADD8	= 1664,
    t2SASX	= 1665,
    t2SBCSri	= 1666,
    t2SBCSrr	= 1667,
    t2SBCSrs	= 1668,
    t2SBCri	= 1669,
    t2SBCrr	= 1670,
    t2SBCrs	= 1671,
    t2SBFX	= 1672,
    t2SDIV	= 1673,
    t2SEL	= 1674,
    t2SEV	= 1675,
    t2SHADD16	= 1676,
    t2SHADD8	= 1677,
    t2SHASX	= 1678,
    t2SHSAX	= 1679,
    t2SHSUB16	= 1680,
    t2SHSUB8	= 1681,
    t2SMC	= 1682,
    t2SMLABB	= 1683,
    t2SMLABT	= 1684,
    t2SMLAD	= 1685,
    t2SMLADX	= 1686,
    t2SMLAL	= 1687,
    t2SMLALBB	= 1688,
    t2SMLALBT	= 1689,
    t2SMLALD	= 1690,
    t2SMLALDX	= 1691,
    t2SMLALTB	= 1692,
    t2SMLALTT	= 1693,
    t2SMLATB	= 1694,
    t2SMLATT	= 1695,
    t2SMLAWB	= 1696,
    t2SMLAWT	= 1697,
    t2SMLSD	= 1698,
    t2SMLSDX	= 1699,
    t2SMLSLD	= 1700,
    t2SMLSLDX	= 1701,
    t2SMMLA	= 1702,
    t2SMMLAR	= 1703,
    t2SMMLS	= 1704,
    t2SMMLSR	= 1705,
    t2SMMUL	= 1706,
    t2SMMULR	= 1707,
    t2SMUAD	= 1708,
    t2SMUADX	= 1709,
    t2SMULBB	= 1710,
    t2SMULBT	= 1711,
    t2SMULL	= 1712,
    t2SMULTB	= 1713,
    t2SMULTT	= 1714,
    t2SMULWB	= 1715,
    t2SMULWT	= 1716,
    t2SMUSD	= 1717,
    t2SMUSDX	= 1718,
    t2SRSDB	= 1719,
    t2SRSDBW	= 1720,
    t2SRSIA	= 1721,
    t2SRSIAW	= 1722,
    t2SSAT16	= 1723,
    t2SSATasr	= 1724,
    t2SSATlsl	= 1725,
    t2SSAX	= 1726,
    t2SSUB16	= 1727,
    t2SSUB8	= 1728,
    t2STM	= 1729,
    t2STRBT	= 1730,
    t2STRB_POST	= 1731,
    t2STRB_PRE	= 1732,
    t2STRBi12	= 1733,
    t2STRBi8	= 1734,
    t2STRBs	= 1735,
    t2STRDi8	= 1736,
    t2STREX	= 1737,
    t2STREXB	= 1738,
    t2STREXD	= 1739,
    t2STREXH	= 1740,
    t2STRHT	= 1741,
    t2STRH_POST	= 1742,
    t2STRH_PRE	= 1743,
    t2STRHi12	= 1744,
    t2STRHi8	= 1745,
    t2STRHs	= 1746,
    t2STRT	= 1747,
    t2STR_POST	= 1748,
    t2STR_PRE	= 1749,
    t2STRi12	= 1750,
    t2STRi8	= 1751,
    t2STRs	= 1752,
    t2SUBSri	= 1753,
    t2SUBSrr	= 1754,
    t2SUBSrs	= 1755,
    t2SUBrSPi	= 1756,
    t2SUBrSPi12	= 1757,
    t2SUBrSPi12_	= 1758,
    t2SUBrSPi_	= 1759,
    t2SUBrSPs	= 1760,
    t2SUBrSPs_	= 1761,
    t2SUBri	= 1762,
    t2SUBri12	= 1763,
    t2SUBrr	= 1764,
    t2SUBrs	= 1765,
    t2SXTAB16rr	= 1766,
    t2SXTAB16rr_rot	= 1767,
    t2SXTABrr	= 1768,
    t2SXTABrr_rot	= 1769,
    t2SXTAHrr	= 1770,
    t2SXTAHrr_rot	= 1771,
    t2SXTB16r	= 1772,
    t2SXTB16r_rot	= 1773,
    t2SXTBr	= 1774,
    t2SXTBr_rot	= 1775,
    t2SXTHr	= 1776,
    t2SXTHr_rot	= 1777,
    t2TBB	= 1778,
    t2TBBgen	= 1779,
    t2TBH	= 1780,
    t2TBHgen	= 1781,
    t2TEQri	= 1782,
    t2TEQrr	= 1783,
    t2TEQrs	= 1784,
    t2TPsoft	= 1785,
    t2TSTri	= 1786,
    t2TSTrr	= 1787,
    t2TSTrs	= 1788,
    t2UADD16	= 1789,
    t2UADD8	= 1790,
    t2UASX	= 1791,
    t2UBFX	= 1792,
    t2UDIV	= 1793,
    t2UHADD16	= 1794,
    t2UHADD8	= 1795,
    t2UHASX	= 1796,
    t2UHSAX	= 1797,
    t2UHSUB16	= 1798,
    t2UHSUB8	= 1799,
    t2UMAAL	= 1800,
    t2UMLAL	= 1801,
    t2UMULL	= 1802,
    t2UQADD16	= 1803,
    t2UQADD8	= 1804,
    t2UQASX	= 1805,
    t2UQSAX	= 1806,
    t2UQSUB16	= 1807,
    t2UQSUB8	= 1808,
    t2USAD8	= 1809,
    t2USADA8	= 1810,
    t2USAT16	= 1811,
    t2USATasr	= 1812,
    t2USATlsl	= 1813,
    t2USAX	= 1814,
    t2USUB16	= 1815,
    t2USUB8	= 1816,
    t2UXTAB16rr	= 1817,
    t2UXTAB16rr_rot	= 1818,
    t2UXTABrr	= 1819,
    t2UXTABrr_rot	= 1820,
    t2UXTAHrr	= 1821,
    t2UXTAHrr_rot	= 1822,
    t2UXTB16r	= 1823,
    t2UXTB16r_rot	= 1824,
    t2UXTBr	= 1825,
    t2UXTBr_rot	= 1826,
    t2UXTHr	= 1827,
    t2UXTHr_rot	= 1828,
    t2WFE	= 1829,
    t2WFI	= 1830,
    t2YIELD	= 1831,
    tADC	= 1832,
    tADDhirr	= 1833,
    tADDi3	= 1834,
    tADDi8	= 1835,
    tADDrPCi	= 1836,
    tADDrSP	= 1837,
    tADDrSPi	= 1838,
    tADDrr	= 1839,
    tADDspi	= 1840,
    tADDspr	= 1841,
    tADDspr_	= 1842,
    tADJCALLSTACKDOWN	= 1843,
    tADJCALLSTACKUP	= 1844,
    tAND	= 1845,
    tANDsp	= 1846,
    tASRri	= 1847,
    tASRrr	= 1848,
    tB	= 1849,
    tBIC	= 1850,
    tBKPT	= 1851,
    tBL	= 1852,
    tBLXi	= 1853,
    tBLXi_r9	= 1854,
    tBLXr	= 1855,
    tBLXr_r9	= 1856,
    tBLr9	= 1857,
    tBRIND	= 1858,
    tBR_JTr	= 1859,
    tBX	= 1860,
    tBX_RET	= 1861,
    tBX_RET_vararg	= 1862,
    tBXr9	= 1863,
    tBcc	= 1864,
    tBfar	= 1865,
    tCBNZ	= 1866,
    tCBZ	= 1867,
    tCMNz	= 1868,
    tCMPhir	= 1869,
    tCMPi8	= 1870,
    tCMPr	= 1871,
    tCMPzhir	= 1872,
    tCMPzi8	= 1873,
    tCMPzr	= 1874,
    tCPS	= 1875,
    tEOR	= 1876,
    tInt_eh_sjlj_setjmp	= 1877,
    tLDM	= 1878,
    tLDR	= 1879,
    tLDRB	= 1880,
    tLDRBi	= 1881,
    tLDRH	= 1882,
    tLDRHi	= 1883,
    tLDRSB	= 1884,
    tLDRSH	= 1885,
    tLDRcp	= 1886,
    tLDRi	= 1887,
    tLDRpci	= 1888,
    tLDRpci_pic	= 1889,
    tLDRspi	= 1890,
    tLEApcrel	= 1891,
    tLEApcrelJT	= 1892,
    tLSLri	= 1893,
    tLSLrr	= 1894,
    tLSRri	= 1895,
    tLSRrr	= 1896,
    tMOVCCi	= 1897,
    tMOVCCr	= 1898,
    tMOVCCr_pseudo	= 1899,
    tMOVSr	= 1900,
    tMOVgpr2gpr	= 1901,
    tMOVgpr2tgpr	= 1902,
    tMOVi8	= 1903,
    tMOVr	= 1904,
    tMOVtgpr2gpr	= 1905,
    tMUL	= 1906,
    tMVN	= 1907,
    tNOP	= 1908,
    tORR	= 1909,
    tPICADD	= 1910,
    tPOP	= 1911,
    tPOP_RET	= 1912,
    tPUSH	= 1913,
    tREV	= 1914,
    tREV16	= 1915,
    tREVSH	= 1916,
    tROR	= 1917,
    tRSB	= 1918,
    tRestore	= 1919,
    tSBC	= 1920,
    tSETENDBE	= 1921,
    tSETENDLE	= 1922,
    tSEV	= 1923,
    tSTM	= 1924,
    tSTR	= 1925,
    tSTRB	= 1926,
    tSTRBi	= 1927,
    tSTRH	= 1928,
    tSTRHi	= 1929,
    tSTRi	= 1930,
    tSTRspi	= 1931,
    tSUBi3	= 1932,
    tSUBi8	= 1933,
    tSUBrr	= 1934,
    tSUBspi	= 1935,
    tSUBspi_	= 1936,
    tSVC	= 1937,
    tSXTB	= 1938,
    tSXTH	= 1939,
    tSpill	= 1940,
    tTPsoft	= 1941,
    tTRAP	= 1942,
    tTST	= 1943,
    tUXTB	= 1944,
    tUXTH	= 1945,
    tWFE	= 1946,
    tWFI	= 1947,
    tYIELD	= 1948,
    INSTRUCTION_LIST_END = 1949
  };
}
} // End llvm namespace 
